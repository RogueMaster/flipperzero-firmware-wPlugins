#include <furi.h>
#include <furi_hal.h>
#include <furi_hal_gpio.h>
#include <furi_hal_serial.h>
#include <furi_hal_serial_control.h>

#include <gui/gui.h>
#include <gui/elements.h>
#include <gui/modules/submenu.h>
#include <gui/modules/text_input.h>
#include <gui/view_dispatcher.h>
#include <gui/view_port.h>
#include <input/input.h>
#include <notification/notification.h>
#include <notification/notification_messages.h>
#include <power/power_service/power.h>
#include <storage/storage.h>
#include <expansion/expansion.h>

#include <stdlib.h>
#include <stdarg.h>
#include <stdio.h>
#include <string.h>
#include <ctype.h>

/* generated by fbt from .png files in images folder */
#include <uhf_expansion_icons.h>

#define TAG "uhf_expansion"

#define UHF_BAUD_RATE     115200U
#define UHF_FRAME_START       0xA0U
#define UHF_DEFAULT_ADDR      0x00U
#define UHF_CMD_GET_VERSION   0x72U
#define UHF_CMD_RESET         0x70U
#define UHF_CMD_SET_POWER     0x76U
#define UHF_CMD_GET_POWER     0x77U
#define UHF_CMD_GET_TEMP      0x7BU
#define UHF_CMD_START_INV     0x89U
#define UHF_CMD_STOP_INV      0x8CU
#define UHF_CMD_INV_ALT       0x8AU
#define UHF_CMD_READ_TAG      0x81U
#define UHF_CMD_WRITE_TAG     0x82U
#define UHF_CMD_LOCK_TAG      0x83U
#define UHF_CMD_SET_EPC_MATCH 0x85U
#define UHF_PAYLOAD_START_INV 0x01U
#define UHF_DEFAULT_POWER_DBM 20U
#define UHF_PROBE_TIMEOUT_MS  240U
#define UHF_STOP_SETTLE_MS     50U
#define UHF_RESET_SETTLE_MS   350U
#define UHF_POWER_OFF_MS      500U
#define UHF_POWER_BOOT_MS     100U
#define UHF_POWER_READY_MS    300U
#define UHF_RESET_LOW_MS      250U
#define UHF_RESET_BOOT_MS     600U

#define UHF_INV_CMD_COOLDOWN_MS      450U
#define UHF_RADAR_STEP_MS             65U
#define UHF_RADAR_PHASE_COUNT         96U
#define UHF_INV_HEARTBEAT_MS         250U
#define UHF_INV_SESSION_RENEW_MS   10000U
#define UHF_INV_RENEW_SETTLE_MS       10U
#define UHF_SINGLE_TAG_STABLE_MS      800U
#define UHF_EXIT_CONFIRM_MS          1600U
#define UHF_READER_QUERY_TIMEOUT_MS   150U
#define UHF_TEMP_REFRESH_MS         60000U
#define UHF_TEMP_DISPLAY_OFFSET_C     (-20)
#define UHF_LIST_VISIBLE_ROWS        4U
#define UHF_ABOUT_VISIBLE_LINES      5U
#define UHF_TAG_DATA_HEX_PER_LINE   12U
#define UHF_TAG_DATA_VISIBLE_LINES   3U
#define UHF_ASCII_EPC_BYTES         12U

#define UHF_BRIDGE_TX_EXT_PIN      13
#define UHF_BRIDGE_RX_EXT_PIN      14
#define UHF_RESET_EXT_PIN          16

#define UHF_MAX_TAGS          120U
#define UHF_EPC_HEX_MAX       96U
#define UHF_TID_HEX_MAX       64U
#define UHF_USER_HEX_MAX     128U
#define UHF_TAG_REPLY_MAX     128U
#define UHF_RX_STREAM_SIZE    1024U
#define UHF_FRAME_BUFFER_SIZE 1024U
#define UHF_RX_CHUNKS_PER_PASS 4U
#define UHF_RX_FRAMES_PER_PASS 24U
#define UHF_DIAG_LOG_LINES    48U
#define UHF_DIAG_LOG_LEN      96U

#define UHF_APP_DATA_DIR APP_DATA_PATH("uhf_expansion")
#define UHF_VIEW_STATE_PATH UHF_APP_DATA_DIR "/view_state.bin"
#define UHF_SETTINGS_PATH   UHF_APP_DATA_DIR "/settings.bin"
#define UHF_KEY_VAULT_PATH  UHF_APP_DATA_DIR "/keys.bin"
#define UHF_SETTINGS_MAGIC  0x55484632UL
#define UHF_KEY_VAULT_MAGIC 0x55484B31UL
#define UHF_KEY_SLOT_COUNT   4U

typedef struct {
    InputEvent input;
} UhfEvent;

typedef struct {
    ViewDispatcher* dispatcher;
    bool submitted;
} UhfFilenameInputCtx;

typedef enum {
    UhfListMenuItemSoundToggle = 0,
    UhfListMenuItemSave = 1,
    UhfListMenuItemAbout = 2,
} UhfListMenuItem;

typedef enum {
    UhfPageMainMenu = 0,
    UhfPageList = 1,
    UhfPageRadar = 2,
    UhfPageAbout = 3,
    UhfPageTagActions = 4,
    UhfPageTagActionMenu = 5,
    UhfPageTidDecoder = 6,
    UhfPageEpcFuzzing = 7,
    UhfPageSettings = 8,
    UhfPageTagSecurity = 9,
    UhfPageKeyVault = 10,
    UhfPageAccessKeyMenu = 11,
    UhfPageAscii = 12,
} UhfPage;

typedef enum {
    UhfTagBankTid = 0,
    UhfTagBankEpc = 1,
    UhfTagBankUser = 2,
} UhfTagBank;

typedef enum {
    UhfStartupDefault = 0,
    UhfStartupRadar,
    UhfStartupInventory,
    UhfStartupTidDecoder,
    UhfStartupEpcFuzzing,
    UhfStartupCount,
} UhfStartupApp;

typedef enum {
    UhfEpcDisplayHex = 0,
    UhfEpcDisplayAscii,
    UhfEpcDisplayCount,
} UhfEpcDisplay;

typedef struct {
    uint32_t magic;
    uint8_t sound_enabled;
    uint8_t rf_power_dbm;
    uint8_t startup_app;
    uint8_t epc_display;
} UhfSettingsData;

typedef struct {
    uint32_t magic;
    uint8_t active_slot;
    uint8_t reserved[3];
    uint8_t access_keys[UHF_KEY_SLOT_COUNT][4];
} UhfKeyVaultData;

typedef struct {
    bool used;
    char epc[UHF_EPC_HEX_MAX + 1];
    uint16_t read_count;
    uint32_t last_seen;
    uint32_t rssi;
    uint32_t frequency;
    uint8_t antenna;
} UhfTagEntry;

typedef struct {
    Gui* gui;
    ViewPort* view_port;
    NotificationApp* notifications;
    FuriMessageQueue* event_queue;
    FuriStreamBuffer* rx_stream;
    FuriMutex* data_mutex;
    Power* power;
    Expansion* expansion;

    FuriHalSerialHandle* serial;
    FuriHalSerialId serial_id;
    int8_t tx_ext_pin;
    int8_t rx_ext_pin;
    uint32_t baud_rate;
    bool otg_was_enabled;
    bool otg_enabled_by_app;

    uint8_t frame_buffer[UHF_FRAME_BUFFER_SIZE];
    size_t frame_buffer_len;

    UhfTagEntry tags[UHF_MAX_TAGS];
    size_t tag_count;

    bool inventory_running;
    bool exit_requested;
    bool exit_confirm_active;
    uint32_t exit_confirm_tick;
    bool hardware_ready;
    uint32_t rx_bytes;
    uint32_t rx_frames;
    uint32_t rx_errors;
    char last_rx_hex[41];
    char diag_log[UHF_DIAG_LOG_LINES][UHF_DIAG_LOG_LEN];
    uint8_t diag_head;
    uint8_t diag_count;
    uint32_t last_inv_cmd_tick;
    uint32_t last_inv_refresh_tick;
    uint32_t last_inv_session_tick;
    uint32_t last_tag_beep_tick;
    uint32_t rate_window_started;
    uint32_t rate_window_reads;
    uint32_t tags_per_second;
    uint32_t radar_step_tick;
    uint32_t last_temperature_query_tick;
    uint8_t radar_sweep_phase;
    uint8_t radar_trail_depth;
    /* Calibrated reader temperature; raw 0x7B values remain available in logs. */
    int16_t reader_temperature_c;
    uint8_t reader_power_dbm;
    bool temperature_valid;
    bool power_valid;
    bool temperature_query_pending;
    bool power_query_pending;
    bool hard_reset_attempted;
    bool tag_beep_enabled;
    bool baud_probed;
    UhfPage page;
    UhfPage about_return_page;
    size_t list_top_index;
    size_t list_selected_index;
    bool list_selection_manual;
    size_t about_top_line;
    uint8_t tag_action_selected;
    uint8_t tag_action_top;
    uint8_t access_key_action_selected;
    uint8_t main_menu_selected;
    uint8_t main_menu_top_row;
    uint8_t settings_selected;
    UhfStartupApp startup_app;
    UhfEpcDisplay epc_display;
    bool tid_decode_attempted;
    uint32_t fuzz_sequence;
    char selected_epc[UHF_EPC_HEX_MAX + 1];
    char access_epc[UHF_EPC_HEX_MAX + 1];
    char fuzz_base_epc[UHF_EPC_HEX_MAX + 1];
    bool ascii_tag_captured;
    uint32_t ascii_single_since;
    char ascii_source_epc[UHF_EPC_HEX_MAX + 1];
    char ascii_text[UHF_ASCII_EPC_BYTES + 1];
    char list_ascii_epc[UHF_EPC_HEX_MAX / 2U + 1U];
    char list_ascii_compact[40];
    char selected_tid[UHF_TID_HEX_MAX + 1];
    char selected_user[UHF_USER_HEX_MAX + 1];
    char pending_tid[UHF_USER_HEX_MAX + 1];
    bool selected_tid_valid;
    bool selected_user_valid;
    bool tag_access_unfiltered;
    bool security_mode;
    uint32_t security_single_since;
    UhfTagBank tag_bank;
    size_t tag_data_scroll_line;
    bool epc_filter_active;
    bool tag_reply_ready;
    bool tag_reply_checksum_ok;
    uint8_t tag_reply_cmd;
    uint8_t tag_reply[UHF_TAG_REPLY_MAX];
    size_t tag_reply_len;
    uint8_t active_key_slot;
    uint8_t key_vault_selected_slot;
    uint8_t access_keys[UHF_KEY_SLOT_COUNT][4];

    char status[64];
    bool save_popup_active;
    char version[24];
    char csv_filename[32];
    bool startup_active;
    char startup_text[32];
    char startup_subtext[40];
    uint8_t startup_dots;
    uint32_t last_redraw_tick;
} UhfApp;

typedef struct {
    ViewDispatcher* dispatcher;
    ViewPort* view_port;
    UhfApp* app;
    uint32_t selected;
    bool submitted;
    bool back_pressed;
} UhfListMenuCtx;

typedef struct {
    char epc[UHF_EPC_HEX_MAX + 1];
    uint16_t count;
} UhfTagPreview;

static void uhf_format_list_epc_compact(
    Canvas* canvas,
    const char* epc,
    int max_width,
    char* out,
    size_t out_size) {
    if(!canvas || !out || out_size == 0U) return;

    out[0] = '\0';
    if(!epc) return;
    if(max_width <= 0) return;

    const size_t epc_len = strlen(epc);
    if(epc_len < out_size) {
        strncpy(out, epc, out_size - 1U);
        out[out_size - 1U] = '\0';
        if(canvas_string_width(canvas, out) <= max_width) return;
    }

    if(epc_len <= 8U) {
        strncpy(out, epc, out_size - 1U);
        out[out_size - 1U] = '\0';
        return;
    }

    const char* dots = "...";
    size_t prefix_len = 4U;
    size_t suffix_len = 4U;

    snprintf(
        out,
        out_size,
        "%.*s%s%.*s",
        (int)prefix_len,
        epc,
        dots,
        (int)suffix_len,
        epc + (epc_len - suffix_len));

    while(prefix_len + suffix_len < epc_len) {
        size_t next_prefix = prefix_len;
        size_t next_suffix = suffix_len;

        if(next_prefix <= next_suffix) {
            next_prefix++;
        } else {
            next_suffix++;
        }

        char candidate[40];
        snprintf(
            candidate,
            sizeof(candidate),
            "%.*s%s%.*s",
            (int)next_prefix,
            epc,
            dots,
            (int)next_suffix,
            epc + (epc_len - next_suffix));

        if(canvas_string_width(canvas, candidate) > max_width) {
            break;
        }

        prefix_len = next_prefix;
        suffix_len = next_suffix;
        strncpy(out, candidate, out_size - 1U);
        out[out_size - 1U] = '\0';
    }
}

static void uhf_draw_list_epc_distributed(Canvas* canvas, const char* epc, int y) {
    if(!canvas || !epc) return;

    char compact[40];
    uhf_format_list_epc_compact(canvas, epc, 126, compact, sizeof(compact));
    char* dots = strstr(compact, "...");
    if(!dots) {
        canvas_draw_str(canvas, 1, y, compact);
        return;
    }

    *dots = '\0';
    const char* suffix = dots + 3;
    const int prefix_width = canvas_string_width(canvas, compact);
    const int suffix_width = canvas_string_width(canvas, suffix);
    const int dots_width = canvas_string_width(canvas, "...");
    const int prefix_x = 1;
    const int prefix_end = prefix_x + prefix_width;
    const int suffix_x = 127 - suffix_width;
    int dots_x = prefix_end + (suffix_x - prefix_end - dots_width) / 2;
    if(dots_x < prefix_end) dots_x = prefix_end;

    canvas_draw_str(canvas, prefix_x, y, compact);
    canvas_draw_str(canvas, dots_x, y, "...");
    canvas_draw_str(canvas, suffix_x, y, suffix);
}

static void uhf_on_rx_irq(FuriHalSerialHandle* handle, FuriHalSerialRxEvent event, void* context);
static void uhf_app_free(UhfApp* app);
static void uhf_clear_tags(UhfApp* app);
static void uhf_update_inventory_rate(UhfApp* app);
static void uhf_update_radar_animation(UhfApp* app);
static bool uhf_save_diag_log(UhfApp* app);
static void uhf_process_rx(UhfApp* app);
static bool uhf_wait_for_version(UhfApp* app, uint32_t timeout_ms);
static bool uhf_has_version(UhfApp* app);
static void uhf_request_version(UhfApp* app);
static bool uhf_query_reader_temperature(UhfApp* app, bool wait_for_response);
static bool uhf_query_reader_power(UhfApp* app, bool wait_for_response);
static bool uhf_set_reader_power(UhfApp* app, uint8_t power_dbm);
static bool uhf_probe_current_serial(UhfApp* app, uint32_t baud);
static bool uhf_try_reader_handshake(UhfApp* app, uint8_t attempts);
static bool uhf_recover_reader(UhfApp* app);
static bool uhf_power_cycle_reader(UhfApp* app);
static void uhf_hardware_reset_reader(UhfApp* app);
static void uhf_release_reset_pin(void);
static void uhf_start_inventory(UhfApp* app);
static void uhf_stop_inventory(UhfApp* app);
static void uhf_service_inventory(UhfApp* app);
static bool uhf_open_serial(UhfApp* app, FuriHalSerialId serial_id);
static void uhf_close_serial(UhfApp* app);
static bool uhf_open_bridge_uart(UhfApp* app);
static void uhf_set_startup_text(UhfApp* app, const char* text, const char* subtext, uint8_t dots);
static void uhf_save_last_page(const UhfApp* app);
static void uhf_load_settings(UhfApp* app);
static bool uhf_save_settings(const UhfApp* app);
static void uhf_load_key_vault(UhfApp* app);
static bool uhf_save_key_vault(const UhfApp* app);
static bool uhf_epc_hex_to_ascii(const char* epc_hex, char* out, size_t out_size);
static bool uhf_ascii_to_epc_hex(const char* ascii, char* out, size_t out_size);
static bool uhf_read_selected_tid(UhfApp* app);
static bool uhf_read_selected_user(UhfApp* app);
static bool uhf_write_selected_bank(UhfApp* app, UhfTagBank bank, const char* value_hex);
static bool uhf_lock_selected_bank(UhfApp* app, bool lock);
static bool uhf_erase_selected_bank(UhfApp* app);
static bool uhf_initialize_tag_access_key(UhfApp* app);
static bool uhf_reset_tag_access_key(UhfApp* app);
static void uhf_leave_tag_actions(UhfApp* app);
static const char* uhf_current_tag_bank_value(UhfApp* app, bool* valid);

static const char* const uhf_main_menu_items[] = {
    "UHF Radar",
    "Inventory",
    "TID Decoder",
    "EPC Fuzzing",
    "EPC ASCII",
    "Tag Control",
    "Access Keys",
    "Settings",
    "About Us",
};

static const char* const uhf_startup_names[] = {
    "Default", "Radar", "Inventory", "TID Decoder", "EPC Fuzzing",
};

static const char* const uhf_about_lines[] = {
    "UHF tools by MTCK",
    "AKA MTools Tec",
    "Version: 1.3",
    "Github: mtoolstec/",
    "fz-uhf-expansion",
};

static void uhf_draw_right_text(Canvas* canvas, int y, const char* text) {
    if(!canvas || !text) return;

    const int width = canvas_string_width(canvas, text);
    int x = 128 - width;
    if(x < 0) x = 0;
    canvas_draw_str(canvas, x, y, text);
}

static void uhf_draw_right_fraction(Canvas* canvas, int y, size_t current, size_t total) {
    if(!canvas) return;

    char current_text[12];
    char total_text[12];
    snprintf(current_text, sizeof(current_text), "%lu", (unsigned long)current);
    snprintf(total_text, sizeof(total_text), "%lu", (unsigned long)total);

    const int current_width = canvas_string_width(canvas, current_text);
    const int slash_width = canvas_string_width(canvas, "/");
    const int total_width = canvas_string_width(canvas, total_text);
    int x = 128 - current_width - 1 - slash_width - 1 - total_width;

    canvas_draw_str(canvas, x, y, current_text);
    x += current_width + 1;
    canvas_draw_str(canvas, x, y, "/");
    x += slash_width + 1;
    canvas_draw_str(canvas, x, y, total_text);
}

static void uhf_format_hex_bytes_spaced(
    const char* hex,
    size_t hex_chars,
    char* out,
    size_t out_size) {
    if(!hex || !out || out_size == 0U) return;

    size_t written = 0U;
    for(size_t i = 0U; i < hex_chars && hex[i]; i++) {
        if(i > 0U && (i % 2U) == 0U) {
            if(written + 1U >= out_size) break;
            out[written++] = ' ';
        }
        if(written + 1U >= out_size) break;
        out[written++] = hex[i];
    }
    out[written] = '\0';
}

static void uhf_draw_fixed_side_button(Canvas* canvas, const char* text, bool right) {
    if(!canvas || !text) return;

    const int button_x = right ? 92 : 0;
    const int text_width = canvas_string_width(canvas, text);
    const int text_x = right ? 120 - text_width : 8;

    canvas_set_color(canvas, ColorBlack);
    canvas_draw_rbox(canvas, button_x, 52, 36, 12, 3);
    /* Keep only the inner top corner rounded, matching the stock soft buttons. */
    canvas_draw_box(canvas, button_x, 61, 36, 3);
    if(right) {
        canvas_draw_box(canvas, 125, 52, 3, 12);
    } else {
        canvas_draw_box(canvas, 0, 52, 3, 12);
    }
    canvas_set_color(canvas, ColorWhite);
    canvas_draw_str(canvas, text_x, 61, text);
    canvas_draw_str(canvas, right ? 122 : 2, 61, right ? ">" : "<");
    canvas_set_color(canvas, ColorBlack);
}

static void uhf_draw_fixed_center_button(Canvas* canvas, const char* text) {
    if(!canvas || !text) return;
    const int text_width = canvas_string_width(canvas, text);
    canvas_set_color(canvas, ColorBlack);
    canvas_draw_rbox(canvas, 46, 52, 36, 12, 3);
    canvas_draw_box(canvas, 46, 61, 36, 3);
    canvas_set_color(canvas, ColorWhite);
    const int offset = strcmp(text, "Save") == 0 ? 0 : -1;
    canvas_draw_rframe(canvas, 49, 56 + offset, 5, 5, 1);
    canvas_draw_str(canvas, 56 + (24 - text_width) / 2, 62 + offset, text);
    canvas_set_color(canvas, ColorBlack);
}

static void uhf_draw_right_temperature(Canvas* canvas, int y, const char* value) {
    if(!canvas || !value) return;

    const int value_width = canvas_string_width(canvas, value);
    const int c_width = canvas_string_width(canvas, "C");
    const int degree_gap = 3;
    const int total_width = value_width + degree_gap + c_width;
    int x = 128 - total_width;
    if(x < 0) x = 0;

    canvas_draw_str(canvas, x, y, value);
    const int c_x = x + value_width + degree_gap;
    canvas_draw_str(canvas, c_x, y, "C");
    canvas_draw_box(canvas, c_x - 2, y - 7, 2, 2);
}

static void uhf_draw_scan_state_icon(Canvas* canvas, int x, int y, bool running) {
    if(!canvas) return;

    if(running) {
        // Pause icon
        canvas_draw_box(canvas, x, y, 2, 7);
        canvas_draw_box(canvas, x + 4, y, 2, 7);
    } else {
        // Play icon
        canvas_draw_line(canvas, x, y, x, y + 6);
        canvas_draw_line(canvas, x, y, x + 5, y + 3);
        canvas_draw_line(canvas, x, y + 6, x + 5, y + 3);
    }
}

static void uhf_draw_scan_hint(Canvas* canvas, bool running) {
    if(!canvas) return;

    canvas_set_font(canvas, FontSecondary);
    const char* ok_text = "OK";
    const char* action_text = "Scan";
    const int ok_width = canvas_string_width(canvas, ok_text);
    const int action_width = canvas_string_width(canvas, action_text);
    const int icon_width = 6;
    const int gap_before_icon = 3;
    const int gap_after_icon = 4;
    const int total_width = ok_width + gap_before_icon + icon_width + gap_after_icon + action_width;

    int start_x = (128 - total_width) / 2;
    if(start_x < 0) start_x = 0;

    canvas_draw_str(canvas, start_x, 63, ok_text);

    const int icon_x = start_x + ok_width + gap_before_icon;
    const int icon_y = 56;
    uhf_draw_scan_state_icon(canvas, icon_x, icon_y, running);
    canvas_draw_str(canvas, icon_x + icon_width + gap_after_icon, 63, action_text);
}

static const NotificationSequence uhf_sequence_tag_found = {
    &message_force_speaker_volume_setting_1f,
    &message_note_c6,
    &message_delay_10,
    &message_sound_off,
    NULL,
};

static void uhf_diag_log(UhfApp* app, const char* fmt, ...) {
    if(!app) return;

    char line[UHF_DIAG_LOG_LEN];
    va_list args;
    va_start(args, fmt);
    vsnprintf(line, sizeof(line), fmt, args);
    va_end(args);

    const uint8_t idx = app->diag_head;
    strncpy(app->diag_log[idx], line, UHF_DIAG_LOG_LEN - 1U);
    app->diag_log[idx][UHF_DIAG_LOG_LEN - 1U] = '\0';

    app->diag_head = (uint8_t)((idx + 1U) % UHF_DIAG_LOG_LINES);
    if(app->diag_count < UHF_DIAG_LOG_LINES) {
        app->diag_count++;
    }
}

static void uhf_force_direct_a6_a4(UhfApp* app) {
    if(!app) return;

    // Bridge wiring mode: use hardware UART lines on ext 13/14 for stable real-time RX.
    if(app->serial) {
        uhf_close_serial(app);
    }

    if(!uhf_open_bridge_uart(app)) {
        app->tx_ext_pin = -1;
        app->rx_ext_pin = -1;
        return;
    }

    app->baud_rate = UHF_BAUD_RATE;
    furi_hal_serial_set_br(app->serial, app->baud_rate);

    app->frame_buffer_len = 0;
    app->last_rx_hex[0] = '\0';
    if(app->rx_stream) {
        (void)furi_stream_buffer_reset(app->rx_stream);
    }

    uhf_diag_log(app, "Bridge UART TX:%d RX:%d", app->tx_ext_pin, app->rx_ext_pin);
}

static bool uhf_data_lock(UhfApp* app, uint32_t timeout) {
    if(!app->data_mutex) return false;
    return furi_mutex_acquire(app->data_mutex, timeout) == FuriStatusOk;
}

static void uhf_data_unlock(UhfApp* app) {
    if(app->data_mutex) {
        furi_mutex_release(app->data_mutex);
    }
}

static void uhf_set_status(UhfApp* app, const char* fmt, ...) {
    char buffer[sizeof(app->status)];

    va_list args;
    va_start(args, fmt);
    vsnprintf(buffer, sizeof(buffer), fmt, args);
    va_end(args);

    if(uhf_data_lock(app, 10)) {
        strncpy(app->status, buffer, sizeof(app->status) - 1);
        app->status[sizeof(app->status) - 1] = '\0';
        uhf_data_unlock(app);
    } else {
        strncpy(app->status, buffer, sizeof(app->status) - 1);
        app->status[sizeof(app->status) - 1] = '\0';
    }
}

#define UHF_TAG_BEEP_COOLDOWN_MS 20U

static void uhf_notify_tag_found(UhfApp* app) {
    if(!app || !app->notifications) return;
    if(!app->tag_beep_enabled) return;

    /* Match the main RX polling cadence for prompt feedback without flooding
       the asynchronous notification queue with duplicate sounds. */
    const uint32_t now = furi_get_tick();
    if((now - app->last_tag_beep_tick) < UHF_TAG_BEEP_COOLDOWN_MS) return;

    app->last_tag_beep_tick = now;
    notification_message(app->notifications, &uhf_sequence_tag_found);
}

static void uhf_notify_write_result(UhfApp* app, bool success) {
    if(!app || !app->notifications) return;
    notification_message(app->notifications, success ? &sequence_success : &sequence_error);
}

static void uhf_filename_input_done(void* context) {
    UhfFilenameInputCtx* ctx = context;
    if(!ctx) return;

    ctx->submitted = true;
    if(ctx->dispatcher) {
        view_dispatcher_stop(ctx->dispatcher);
    }
}

static bool uhf_filename_input_back(void* context) {
    UhfFilenameInputCtx* ctx = context;
    if(!ctx) return true;

    if(ctx->dispatcher) {
        view_dispatcher_stop(ctx->dispatcher);
    }
    return true;
}

static void uhf_sanitize_filename(const char* input, char* out, size_t out_size) {
    if(!out || out_size == 0) return;

    size_t j = 0;
    if(input) {
        for(size_t i = 0; input[i] && j + 1 < out_size; i++) {
            const unsigned char c = (unsigned char)input[i];
            if(isalnum(c) || c == '_' || c == '-') {
                out[j++] = (char)c;
            }
        }
    }

    if(j == 0) {
        strncpy(out, "tags", out_size - 1);
        out[out_size - 1] = '\0';
    } else {
        out[j] = '\0';
    }
}

static bool uhf_prompt_csv_filename(UhfApp* app, char* out, size_t out_size) {
    if(!app || !app->gui || !app->view_port || !out || out_size < 2) return false;

    if(!out[0]) {
        strncpy(out, "tags", out_size - 1);
        out[out_size - 1] = '\0';
    }

    TextInput* text_input = text_input_alloc();
    ViewDispatcher* dispatcher = view_dispatcher_alloc();
    if(!text_input || !dispatcher) {
        if(text_input) text_input_free(text_input);
        if(dispatcher) view_dispatcher_free(dispatcher);
        return false;
    }

    UhfFilenameInputCtx ctx = {
        .dispatcher = dispatcher,
        .submitted = false,
    };

    text_input_set_header_text(text_input, "CSV file name");
    text_input_set_minimum_length(text_input, 1);
    text_input_set_result_callback(text_input, uhf_filename_input_done, &ctx, out, out_size, false);

    view_dispatcher_set_event_callback_context(dispatcher, &ctx);
    view_dispatcher_set_navigation_event_callback(dispatcher, uhf_filename_input_back);
    view_dispatcher_add_view(dispatcher, 0, text_input_get_view(text_input));

    gui_remove_view_port(app->gui, app->view_port);
    view_dispatcher_attach_to_gui(dispatcher, app->gui, ViewDispatcherTypeFullscreen);
    view_dispatcher_switch_to_view(dispatcher, 0);
    view_dispatcher_run(dispatcher);

    view_dispatcher_remove_view(dispatcher, 0);
    view_dispatcher_free(dispatcher);
    text_input_free(text_input);

    gui_add_view_port(app->gui, app->view_port, GuiLayerFullscreen);

    if(!ctx.submitted) return false;

    char safe_name[32];
    uhf_sanitize_filename(out, safe_name, sizeof(safe_name));
    strncpy(out, safe_name, out_size - 1);
    out[out_size - 1] = '\0';
    return out[0] != '\0';
}

static bool uhf_normalize_hex(char* value, size_t max_hex_len) {
    if(!value) return false;

    size_t write = 0U;
    for(size_t read = 0U; value[read]; read++) {
        const unsigned char c = (unsigned char)value[read];
        if(c == ' ' || c == ':' || c == '-') continue;
        if(!isxdigit(c) || write >= max_hex_len) return false;
        value[write++] = (char)toupper(c);
    }
    value[write] = '\0';
    return write >= 4U && (write % 4U) == 0U;
}

static bool uhf_prompt_memory_hex(
    UhfApp* app,
    const char* header,
    char* out,
    size_t out_size,
    size_t max_hex_len) {
    if(!app || !app->gui || !app->view_port || !out || out_size < 5U) return false;

    if(!out[0]) strncpy(out, "0000", out_size - 1U);
    out[out_size - 1U] = '\0';

    TextInput* text_input = text_input_alloc();
    ViewDispatcher* dispatcher = view_dispatcher_alloc();
    if(!text_input || !dispatcher) {
        if(text_input) text_input_free(text_input);
        if(dispatcher) view_dispatcher_free(dispatcher);
        return false;
    }

    UhfFilenameInputCtx ctx = {.dispatcher = dispatcher, .submitted = false};
    text_input_set_header_text(text_input, header);
    text_input_set_minimum_length(text_input, 4U);
    text_input_set_result_callback(text_input, uhf_filename_input_done, &ctx, out, out_size, false);
    view_dispatcher_set_event_callback_context(dispatcher, &ctx);
    view_dispatcher_set_navigation_event_callback(dispatcher, uhf_filename_input_back);
    view_dispatcher_add_view(dispatcher, 0, text_input_get_view(text_input));

    gui_remove_view_port(app->gui, app->view_port);
    view_dispatcher_attach_to_gui(dispatcher, app->gui, ViewDispatcherTypeFullscreen);
    view_dispatcher_switch_to_view(dispatcher, 0);
    view_dispatcher_run(dispatcher);
    view_dispatcher_remove_view(dispatcher, 0);
    view_dispatcher_free(dispatcher);
    text_input_free(text_input);
    gui_add_view_port(app->gui, app->view_port, GuiLayerFullscreen);

    if(!ctx.submitted) return false;
    return uhf_normalize_hex(out, max_hex_len);
}

static void uhf_trim_trailing_spaces(char* value) {
    if(!value) return;

    size_t length = strlen(value);
    while(length > 0U && value[length - 1U] == ' ') {
        value[--length] = '\0';
    }
}

static bool uhf_prompt_ascii(UhfApp* app, char* out, size_t out_size) {
    if(!app || !app->gui || !app->view_port || !out || out_size < 2U) return false;

    TextInput* text_input = text_input_alloc();
    ViewDispatcher* dispatcher = view_dispatcher_alloc();
    if(!text_input || !dispatcher) {
        if(text_input) text_input_free(text_input);
        if(dispatcher) view_dispatcher_free(dispatcher);
        return false;
    }

    UhfFilenameInputCtx ctx = {.dispatcher = dispatcher, .submitted = false};
    text_input_set_header_text(text_input, "ASCII (max 12)");
    text_input_set_minimum_length(text_input, 1U);
    text_input_set_result_callback(text_input, uhf_filename_input_done, &ctx, out, out_size, false);
    view_dispatcher_set_event_callback_context(dispatcher, &ctx);
    view_dispatcher_set_navigation_event_callback(dispatcher, uhf_filename_input_back);
    view_dispatcher_add_view(dispatcher, 0, text_input_get_view(text_input));

    gui_remove_view_port(app->gui, app->view_port);
    view_dispatcher_attach_to_gui(dispatcher, app->gui, ViewDispatcherTypeFullscreen);
    view_dispatcher_switch_to_view(dispatcher, 0);
    view_dispatcher_run(dispatcher);
    view_dispatcher_remove_view(dispatcher, 0);
    view_dispatcher_free(dispatcher);
    text_input_free(text_input);
    gui_add_view_port(app->gui, app->view_port, GuiLayerFullscreen);

    if(!ctx.submitted) return false;
    uhf_trim_trailing_spaces(out);
    if(!out[0] || strlen(out) > UHF_ASCII_EPC_BYTES) return false;
    for(const char* cursor = out; *cursor; cursor++) {
        const unsigned char c = (unsigned char)*cursor;
        if(c < 0x20U || c > 0x7EU) return false;
    }
    return true;
}

static bool uhf_save_index_epc_csv(UhfApp* app, const char* filename) {
    if(!app || !filename || !filename[0]) return false;

    char base_name[32];
    uhf_sanitize_filename(filename, base_name, sizeof(base_name));

    char file_name_with_ext[40];
    snprintf(file_name_with_ext, sizeof(file_name_with_ext), "%s.csv", base_name);

    Storage* storage = furi_record_open(RECORD_STORAGE);
    if(!storage) {
        uhf_set_status(app, "Storage unavailable");
        return false;
    }

    if(!storage_dir_exists(storage, UHF_APP_DATA_DIR)) {
        const FS_Error mkdir_result = storage_common_mkdir(storage, UHF_APP_DATA_DIR);
        if(mkdir_result != FSE_OK && mkdir_result != FSE_EXIST) {
            furi_record_close(RECORD_STORAGE);
            uhf_set_status(app, "Create dir failed");
            return false;
        }
    }

    char path[128];
    snprintf(path, sizeof(path), UHF_APP_DATA_DIR "/%s", file_name_with_ext);

    File* file = storage_file_alloc(storage);
    if(!file) {
        furi_record_close(RECORD_STORAGE);
        uhf_set_status(app, "File alloc failed");
        return false;
    }

    bool ok = false;
    do {
        if(!storage_file_open(file, path, FSAM_WRITE, FSOM_CREATE_ALWAYS)) {
            uhf_set_status(app, "Open file failed");
            break;
        }

        const char* header = "index,epc\n";
        if(storage_file_write(file, header, strlen(header)) != strlen(header)) {
            uhf_set_status(app, "Write header failed");
            break;
        }

        if(!uhf_data_lock(app, 50)) {
            uhf_set_status(app, "Busy");
            break;
        }

        size_t index = 1;
        char line[UHF_EPC_HEX_MAX + 32U];
        for(size_t i = 0; i < UHF_MAX_TAGS; i++) {
            if(!app->tags[i].used) continue;

            const int len = snprintf(line, sizeof(line), "%lu,%s\n", (unsigned long)index, app->tags[i].epc);
            if(len <= 0 || (size_t)len >= sizeof(line)) continue;

            if(storage_file_write(file, line, (size_t)len) != (size_t)len) {
                uhf_data_unlock(app);
                uhf_set_status(app, "Write record failed");
                goto save_cleanup;
            }

            index++;
        }
        uhf_data_unlock(app);

        storage_file_sync(file);
        uhf_set_status(app, "Saved CSV: %s", file_name_with_ext);
        if(app->notifications) {
            notification_message(app->notifications, &sequence_success);
        }
        ok = true;
    } while(false);

save_cleanup:
    storage_file_close(file);
    storage_file_free(file);
    furi_record_close(RECORD_STORAGE);
    return ok;
}

static size_t uhf_count_tags(UhfApp* app) {
    if(!app) return 0;
    if(!uhf_data_lock(app, 20)) return 0;

    size_t total = 0;
    for(size_t i = 0; i < UHF_MAX_TAGS; i++) {
        if(!app->tags[i].used) continue;
        total++;
    }

    uhf_data_unlock(app);
    return total;
}

static bool uhf_copy_tag_at(UhfApp* app, size_t wanted, UhfTagEntry* out) {
    if(!app || !out || !uhf_data_lock(app, 20U)) return false;

    size_t index = 0U;
    bool found = false;
    for(size_t i = 0U; i < UHF_MAX_TAGS; i++) {
        if(!app->tags[i].used) continue;
        if(index++ == wanted) {
            *out = app->tags[i];
            found = true;
            break;
        }
    }
    uhf_data_unlock(app);
    return found;
}

static void uhf_move_list_selection(UhfApp* app, bool down) {
    if(!app) return;

    size_t total = uhf_count_tags(app);
    if(total == 0) {
        app->list_selected_index = 0;
        app->list_top_index = 0;
        app->list_selection_manual = false;
        uhf_set_status(app, "No tags yet");
        return;
    }

    if(!app->list_selection_manual) {
        if(app->inventory_running) {
            uhf_stop_inventory(app);
            furi_delay_ms(UHF_STOP_SETTLE_MS);
            uhf_process_rx(app);
            total = uhf_count_tags(app);
        }
        app->list_selection_manual = true;
        app->list_selected_index = down ? 0U : (total - 1U);
        if(app->list_selected_index >= UHF_LIST_VISIBLE_ROWS) {
            app->list_top_index = app->list_selected_index - UHF_LIST_VISIBLE_ROWS + 1U;
        } else {
            app->list_top_index = 0U;
        }
        uhf_set_status(
            app,
            "Tag %lu/%lu",
            (unsigned long)(app->list_selected_index + 1U),
            (unsigned long)total);
        return;
    }

    if(app->list_selected_index >= total) {
        app->list_selected_index = total - 1U;
    }

    if(down) {
        app->list_selected_index =
            app->list_selected_index + 1U < total ? app->list_selected_index + 1U : 0U;
    } else {
        app->list_selected_index =
            app->list_selected_index > 0U ? app->list_selected_index - 1U : total - 1U;
    }

    if(app->list_selected_index < app->list_top_index) {
        app->list_top_index = app->list_selected_index;
    } else if(app->list_selected_index >= app->list_top_index + UHF_LIST_VISIBLE_ROWS) {
        app->list_top_index = app->list_selected_index - UHF_LIST_VISIBLE_ROWS + 1U;
    }

    uhf_set_status(
        app,
        "Tag %lu/%lu",
        (unsigned long)(app->list_selected_index + 1U),
        (unsigned long)total);
}

static void uhf_toggle_inventory_with_cooldown(UhfApp* app) {
    if(!app) return;

    const uint32_t now = furi_get_tick();
    if((now - app->last_inv_cmd_tick) < UHF_INV_CMD_COOLDOWN_MS) {
        uhf_set_status(app, "Inventory cooldown");
        return;
    }
    app->last_inv_cmd_tick = now;

    if(app->inventory_running) {
        uhf_stop_inventory(app);
        uhf_set_status(app, "Inventory stopped");
    } else {
        uhf_start_inventory(app);
    }
}

static void uhf_enter_about_page(UhfApp* app) {
    if(!app) return;

    app->about_return_page = app->page;
    app->about_top_line = 0;
    app->page = UhfPageAbout;
    uhf_set_status(app, "About");
}

static void uhf_exit_about_page(UhfApp* app) {
    if(!app) return;

    if(app->about_return_page == UhfPageAbout) {
        app->about_return_page = UhfPageList;
    }
    app->page = app->about_return_page;
}

static void uhf_about_scroll(UhfApp* app, bool down) {
    if(!app || app->page != UhfPageAbout) return;

    const size_t total_lines = COUNT_OF(uhf_about_lines);
    if(total_lines <= UHF_ABOUT_VISIBLE_LINES) {
        app->about_top_line = 0;
        return;
    }

    const size_t max_top = total_lines - UHF_ABOUT_VISIBLE_LINES;
    size_t top = app->about_top_line;
    const size_t page_step = UHF_ABOUT_VISIBLE_LINES;

    if(down) {
        if(top < max_top) {
            const size_t next_top = top + page_step;
            top = (next_top > max_top) ? max_top : next_top;
        }
    } else {
        if(top > page_step) {
            top -= page_step;
        } else {
            top = 0U;
        }
    }

    app->about_top_line = top;
}

/* Forward declarations */
static void uhf_draw_centered_text(Canvas* canvas, int y, const char* text);
static void uhf_run_startup_sequence(UhfApp* app);
static bool uhf_ensure_hardware(UhfApp* app);
static void uhf_clear_version(UhfApp* app);
static void uhf_apply_baud(UhfApp* app, uint32_t baud_rate);

static void uhf_prepare_csv_filename(UhfApp* app) {
    if(!app) return;
    DateTime now;
    furi_hal_rtc_get_datetime(&now);

    Storage* storage = furi_record_open(RECORD_STORAGE);
    for(unsigned index = 1U; index <= 999U; index++) {
        snprintf(
            app->csv_filename,
            sizeof(app->csv_filename),
            "uhf_%04u%02u%02u_%03u",
            (unsigned)now.year,
            (unsigned)now.month,
            (unsigned)now.day,
            index);
        char path[128];
        snprintf(path, sizeof(path), UHF_APP_DATA_DIR "/%s.csv", app->csv_filename);
        if(!storage || !storage_file_exists(storage, path)) break;
    }
    if(storage) furi_record_close(RECORD_STORAGE);
}

static void uhf_show_list_menu(UhfApp* app) {
    if(!app) return;
    if(uhf_count_tags(app) == 0U) {
        uhf_set_status(app, "No tags to save");
        return;
    }
    const bool resume = app->inventory_running;
    if(resume) {
        uhf_stop_inventory(app);
        furi_delay_ms(UHF_STOP_SETTLE_MS);
        uhf_process_rx(app);
    }
    uhf_prepare_csv_filename(app);
    if(uhf_prompt_csv_filename(app, app->csv_filename, sizeof(app->csv_filename))) {
        (void)uhf_save_index_epc_csv(app, app->csv_filename);
    } else {
        uhf_set_status(app, "Save canceled");
    }
    if(resume) uhf_start_inventory(app);
}

static void uhf_set_startup_text(UhfApp* app, const char* text, const char* subtext, uint8_t dots) {
    if(!app) return;

    strncpy(app->startup_text, text ? text : "", sizeof(app->startup_text) - 1);
    app->startup_text[sizeof(app->startup_text) - 1] = '\0';

    strncpy(app->startup_subtext, subtext ? subtext : "", sizeof(app->startup_subtext) - 1);
    app->startup_subtext[sizeof(app->startup_subtext) - 1] = '\0';

    app->startup_dots = dots;
    if(app->view_port) {
        view_port_update(app->view_port);
    }
}

static void uhf_run_startup_sequence(UhfApp* app) {
    if(!app) return;

    app->startup_active = true;
    uhf_set_startup_text(app, "Initializing", "Preparing reader", 0);

    bool got_version = false;
    app->baud_rate = UHF_BAUD_RATE;
    if(!uhf_open_bridge_uart(app)) {
        uhf_diag_log(app, "Startup UART open failed");
        goto startup_done;
    }
    app->hardware_ready = true;
    uhf_diag_log(
        app,
        "Startup UART id=%u TX:%d RX:%d baud=%lu",
        (unsigned)app->serial_id,
        app->tx_ext_pin,
        app->rx_ext_pin,
        (unsigned long)app->baud_rate);

    uhf_set_startup_text(app, "Initializing", "Hardware reset", 0);
    uhf_hardware_reset_reader(app);

    if(app->rx_stream) furi_stream_buffer_reset(app->rx_stream);
    app->frame_buffer_len = 0;

    uhf_set_startup_text(app, "Initializing", "Checking reader", 0);
    got_version = uhf_try_reader_handshake(app, 1U);

    if(!got_version) {
        uhf_set_startup_text(app, "Initializing", "Power-cycle reset", 0);
        if(uhf_power_cycle_reader(app)) {
            got_version = uhf_try_reader_handshake(app, 3U);
        }
    }

startup_done:

    if(got_version) {
        char line[40];
        snprintf(
            line,
            sizeof(line),
            "Version %s @ %lu",
            app->version,
            (unsigned long)app->baud_rate);
        uhf_set_startup_text(app, "Ready", line, 0);
        uhf_set_status(app, "Ready");
        furi_delay_ms(650U);
    } else {
        char failure[40];
        snprintf(
            failure,
            sizeof(failure),
            "RX:%lu frames:%lu errors:%lu",
            (unsigned long)app->rx_bytes,
            (unsigned long)app->rx_frames,
            (unsigned long)app->rx_errors);
        uhf_diag_log(app, "Startup failed %s", failure);
        (void)uhf_save_diag_log(app);
        uhf_set_startup_text(app, "Not Ready", failure, 0);
        uhf_set_status(app, "Not Ready");
        furi_delay_ms(800U);
    }

    app->startup_active = false;
    if(app->view_port) {
        view_port_update(app->view_port);
    }
}

static bool uhf_has_version(UhfApp* app) {
    bool has = false;
    if(uhf_data_lock(app, 10)) {
        has = app->version[0] != '\0';
        uhf_data_unlock(app);
    }
    return has;
}

static void uhf_clear_version(UhfApp* app) {
    if(uhf_data_lock(app, 10)) {
        app->version[0] = '\0';
        uhf_data_unlock(app);
    }
}

static uint32_t uhf_read_be(const uint8_t* data, size_t len) {
    uint32_t value = 0;
    for(size_t i = 0; i < len; i++) {
        value = (value << 8) | data[i];
    }
    return value;
}

static bool uhf_bytes_to_hex(const uint8_t* data, size_t len, char* out, size_t out_size) {
    if(out_size < (len * 2 + 1)) return false;

    for(size_t i = 0; i < len; i++) {
        snprintf(&out[i * 2], 3, "%02X", data[i]);
    }
    out[len * 2] = '\0';
    return true;
}

static size_t uhf_format_hex_byte_groups(
    const char* hex,
    size_t hex_length,
    size_t byte_offset,
    size_t max_bytes,
    char* out,
    size_t out_size) {
    if(!hex || !out || out_size == 0U) return 0U;

    size_t written = 0U;
    size_t bytes = 0U;
    const size_t start = byte_offset * 2U;
    while(bytes < max_bytes && start + bytes * 2U + 1U < hex_length) {
        if(written && written + 1U < out_size) out[written++] = ' ';
        if(written + 2U >= out_size) break;
        out[written++] = hex[start + bytes * 2U];
        out[written++] = hex[start + bytes * 2U + 1U];
        bytes++;
    }
    out[written] = '\0';
    return bytes;
}

static void uhf_prune_stale_tags(UhfApp* app, uint32_t max_age_ms) {
    if(!app || !uhf_data_lock(app, 10)) return;

    const uint32_t now = furi_get_tick();
    size_t count = 0U;
    for(size_t i = 0U; i < UHF_MAX_TAGS; i++) {
        if(app->tags[i].used && (now - app->tags[i].last_seen) > max_age_ms) {
            memset(&app->tags[i], 0, sizeof(app->tags[i]));
        }
        if(app->tags[i].used) count++;
    }
    app->tag_count = count;
    uhf_data_unlock(app);
}

static bool uhf_is_valid_epc(const uint8_t* epc, size_t epc_len) {
    static const uint8_t reader_placeholder[] = {0xE2U, 0x80U, 0x69U, 0x00U, 0x00U};

    if(!epc || epc_len < 4U || epc_len > (UHF_EPC_HEX_MAX / 2U)) return false;

    /* All-zero EPCs are recoverable tags, not invalid frames. Keeping them
       visible lets the user assign a new EPC after an earlier clear. */
    return !(epc_len >= sizeof(reader_placeholder) &&
             memcmp(epc, reader_placeholder, sizeof(reader_placeholder)) == 0);
}

static UhfTagEntry* uhf_find_or_add_tag(UhfApp* app, const char* epc_hex, bool* is_new_tag) {
    const uint32_t now = furi_get_tick();

    for(size_t i = 0; i < UHF_MAX_TAGS; i++) {
        if(app->tags[i].used && strcmp(app->tags[i].epc, epc_hex) == 0) {
            /* Deduplicate: if this same EPC was seen very recently, don't count as new */
            const bool recent = (now - app->tags[i].last_seen) < 800U;
            if(is_new_tag) *is_new_tag = !recent;
            return &app->tags[i];
        }
    }

    for(size_t i = 0; i < UHF_MAX_TAGS; i++) {
        if(!app->tags[i].used) {
            app->tags[i].read_count = 0;
            app->tags[i].rssi = 0;
            app->tags[i].frequency = 0;
            app->tags[i].antenna = 0;
            strncpy(app->tags[i].epc, epc_hex, sizeof(app->tags[i].epc) - 1);
            app->tags[i].epc[sizeof(app->tags[i].epc) - 1] = '\0';
            app->tags[i].used = true;
            app->tags[i].last_seen = 0; /* will be set by caller */
            app->tag_count++;
            if(is_new_tag) *is_new_tag = true;
            return &app->tags[i];
        }
    }

    return NULL;
}

static bool uhf_build_frame(
    uint8_t cmd,
    const uint8_t* payload,
    size_t payload_len,
    uint8_t* out,
    size_t out_size,
    size_t* frame_size) {
    const size_t len_field = payload_len + 3U;
    const size_t total_size = len_field + 2U;
    if(total_size > out_size || len_field > UINT8_MAX) return false;

    out[0] = UHF_FRAME_START;
    out[1] = (uint8_t)len_field;
    out[2] = UHF_DEFAULT_ADDR;
    out[3] = cmd;
    if(payload_len) {
        memcpy(&out[4], payload, payload_len);
    }

    uint32_t checksum_acc = 0;
    for(size_t i = 0; i < total_size - 1U; i++) {
        checksum_acc = (checksum_acc + out[i]) & 0xFFU;
    }
    out[total_size - 1U] = (uint8_t)((~checksum_acc + 1U) & 0xFFU);

    *frame_size = total_size;
    return true;
}

static bool uhf_send_raw_frame(UhfApp* app, const uint8_t* frame, size_t frame_size) {
    if(!frame || frame_size < 5U) return false;
    if(!app->serial) return false;

    furi_hal_serial_tx(app->serial, frame, frame_size);
    furi_hal_serial_tx_wait_complete(app->serial);

    char hex[49] = "";
    const size_t shown = frame_size > 24U ? 24U : frame_size;
    if(uhf_bytes_to_hex(frame, shown, hex, sizeof(hex))) {
        uhf_diag_log(app, "TX len=%lu %s", (unsigned long)frame_size, hex);
        if(frame[3] == UHF_CMD_READ_TAG || frame[3] == UHF_CMD_WRITE_TAG ||
           frame[3] == UHF_CMD_LOCK_TAG || frame[3] == UHF_CMD_SET_EPC_MATCH) {
            FURI_LOG_I(TAG, "Tag TX %s", hex);
        }
    }

    return true;
}

static void uhf_store_last_rx_hex(UhfApp* app, const uint8_t* frame, size_t frame_size) {
    const size_t shown = frame_size > 20U ? 20U : frame_size;
    (void)uhf_bytes_to_hex(frame, shown, app->last_rx_hex, sizeof(app->last_rx_hex));
}

static bool uhf_send_command(UhfApp* app, uint8_t cmd, const uint8_t* payload, size_t payload_len) {
    uint8_t frame[272];
    size_t frame_size = 0;
    if(!uhf_build_frame(cmd, payload, payload_len, frame, sizeof(frame), &frame_size)) {
        return false;
    }

    return uhf_send_raw_frame(app, frame, frame_size);
}

static const char* uhf_tag_error_text(uint8_t code) {
    switch(code) {
    case 0x10: return "OK";
    case 0x20: return "No tag";
    case 0x22: return "Wrong password";
    case 0x23: return "Memory overrun";
    case 0x24: return "Memory locked";
    case 0x31: return "Access failed";
    case 0x32: return "Read failed";
    case 0x33: return "Write failed";
    default: return "Tag operation failed";
    }
}

static bool uhf_wait_tag_reply(
    UhfApp* app,
    uint8_t cmd,
    const uint8_t* payload,
    size_t payload_len,
    uint32_t timeout_ms) {
    app->tag_reply_ready = false;
    app->tag_reply_len = 0U;
    app->tag_reply_cmd = cmd;
    if(!uhf_send_command(app, cmd, payload, payload_len)) return false;

    const uint32_t started = furi_get_tick();
    while((furi_get_tick() - started) < timeout_ms) {
        uhf_process_rx(app);
        if(app->tag_reply_ready && app->tag_reply_cmd == cmd) {
            return app->tag_reply_checksum_ok;
        }
        furi_delay_ms(5U);
    }
    uhf_set_status(app, "Reader timeout (0x%02X)", cmd);
    return false;
}

static int8_t uhf_hex_digit_value(char c) {
    if(c >= '0' && c <= '9') return (int8_t)(c - '0');
    if(c >= 'A' && c <= 'F') return (int8_t)(c - 'A' + 10);
    if(c >= 'a' && c <= 'f') return (int8_t)(c - 'a' + 10);
    return -1;
}

static bool uhf_hex_to_bytes(const char* hex, uint8_t* out, size_t out_size, size_t* out_len) {
    if(!hex || !out || !out_len) return false;
    const size_t hex_len = strlen(hex);
    if((hex_len & 1U) || hex_len / 2U > out_size) return false;

    for(size_t i = 0U; i < hex_len / 2U; i++) {
        const int8_t high = uhf_hex_digit_value(hex[i * 2U]);
        const int8_t low = uhf_hex_digit_value(hex[i * 2U + 1U]);
        if(high < 0 || low < 0) return false;
        out[i] = (uint8_t)((high << 4U) | low);
    }
    *out_len = hex_len / 2U;
    return true;
}

static bool uhf_epc_hex_to_ascii(const char* epc_hex, char* out, size_t out_size) {
    uint8_t bytes[UHF_EPC_HEX_MAX / 2U];
    size_t length = 0U;
    if(!out || out_size < 2U || !uhf_hex_to_bytes(epc_hex, bytes, sizeof(bytes), &length) ||
       length == 0U || length >= out_size) {
        return false;
    }

    for(size_t i = 0U; i < length; i++) {
        if(bytes[i] < 0x20U || bytes[i] > 0x7EU) return false;
    }
    memcpy(out, bytes, length);
    out[length] = '\0';
    uhf_trim_trailing_spaces(out);
    return out[0] != '\0';
}

static bool uhf_ascii_to_epc_hex(const char* ascii, char* out, size_t out_size) {
    if(!ascii || !out) return false;
    const size_t length = strlen(ascii);
    if(length == 0U || length > UHF_ASCII_EPC_BYTES) return false;

    uint8_t bytes[UHF_ASCII_EPC_BYTES];
    memset(bytes, ' ', sizeof(bytes));
    for(size_t i = 0U; i < length; i++) {
        const unsigned char c = (unsigned char)ascii[i];
        if(c < 0x20U || c > 0x7EU) return false;
        bytes[i] = c;
    }
    return uhf_bytes_to_hex(bytes, sizeof(bytes), out, out_size);
}

static bool uhf_set_selected_epc_filter(UhfApp* app) {
    uint8_t epc[UHF_EPC_HEX_MAX / 2U];
    size_t epc_len = 0U;
    if(!uhf_hex_to_bytes(app->access_epc, epc, sizeof(epc), &epc_len) || epc_len == 0U) {
        uhf_set_status(app, "Invalid selected EPC");
        return false;
    }

    uint8_t payload[2U + UHF_EPC_HEX_MAX / 2U];
    payload[0] = 0x00U;
    payload[1] = (uint8_t)epc_len;
    memcpy(&payload[2], epc, epc_len);
    if(!uhf_wait_tag_reply(app, UHF_CMD_SET_EPC_MATCH, payload, epc_len + 2U, 1200U)) {
        uhf_set_status(app, "EPC filter timeout");
        return false;
    }
    if(app->tag_reply_len != 1U || app->tag_reply[0] != 0x10U) {
        const uint8_t code = app->tag_reply_len ? app->tag_reply[0] : 0xFFU;
        uhf_set_status(app, "Filter error 0x%02X", code);
        return false;
    }
    app->epc_filter_active = true;
    return true;
}

static void uhf_clear_selected_epc_filter(UhfApp* app) {
    if(!app || !app->epc_filter_active) return;
    const uint8_t clear_mode = 0x01U;
    (void)uhf_wait_tag_reply(app, UHF_CMD_SET_EPC_MATCH, &clear_mode, 1U, 600U);
    app->epc_filter_active = false;
}

static bool uhf_read_selected_bank_words(
    UhfApp* app,
    uint8_t memory_bank,
    uint8_t word_address,
    uint8_t word_count,
    char* out,
    size_t out_size,
    const char* name,
    bool use_epc_filter) {
    if(use_epc_filter && !app->epc_filter_active && !uhf_set_selected_epc_filter(app)) {
        return false;
    }

    out[0] = '\0';

    /* Newer UCM601NC firmware uses a 32-bit word address and 16-bit word count. */
    uint8_t payload[] = {
        memory_bank,
        0x00U, 0x00U, 0x00U, 0x00U,
        0x00U, word_count,
        0x00U, 0x00U, 0x00U, 0x00U,
    };
    payload[4] = word_address;
    memcpy(&payload[7], app->access_keys[app->active_key_slot], 4U);
    uhf_set_status(app, "Reading %s...", name);
    if(!uhf_wait_tag_reply(app, UHF_CMD_READ_TAG, payload, sizeof(payload), 2500U)) return false;
    if(app->tag_reply_len == 1U) {
        uhf_set_status(app, "Error 0x%02X", app->tag_reply[0]);
        return false;
    }
    if(app->tag_reply_len < 6U) {
        uhf_set_status(app, "Malformed %s reply", name);
        return false;
    }

    const size_t record_len = app->tag_reply[2];
    const size_t record_end = 3U + record_len;
    if(record_end + 3U > app->tag_reply_len) {
        uhf_set_status(app, "Malformed %s record", name);
        return false;
    }
    size_t read_len = app->tag_reply[record_end];
    /* Extended firmware returns ReadLen as a 16-bit big-endian value. */
    if(record_end + 4U <= app->tag_reply_len) {
        const size_t extended_len =
            ((size_t)app->tag_reply[record_end] << 8U) | app->tag_reply[record_end + 1U];
        if(extended_len > 0U && extended_len <= record_len) read_len = extended_len;
    }
    if(read_len == 0U || read_len * 2U + 1U > out_size || read_len > record_len) {
        uhf_set_status(app, "Invalid %s length", name);
        return false;
    }
    const uint8_t* value = &app->tag_reply[record_end - read_len];
    if(!uhf_bytes_to_hex(value, read_len, out, out_size)) {
        uhf_set_status(app, "%s too long", name);
        return false;
    }
    uhf_set_status(app, "%s read: %lu bytes", name, (unsigned long)read_len);
    return true;
}

static bool uhf_read_selected_tid(UhfApp* app) {
    /* Six words covers the common 96-bit serialized TID. */
    app->selected_tid_valid = uhf_read_selected_bank_words(
        app,
        0x02U,
        0x00U,
        6U,
        app->selected_tid,
        sizeof(app->selected_tid),
        "TID",
        !app->tag_access_unfiltered);
    return app->selected_tid_valid;
}

static bool uhf_read_selected_user(UhfApp* app) {
    app->selected_user_valid = uhf_read_selected_bank_words(
        app,
        0x03U,
        0x00U,
        16U,
        app->selected_user,
        sizeof(app->selected_user),
        "USER",
        !app->tag_access_unfiltered);
    return app->selected_user_valid;
}

static const char* uhf_tag_bank_name(UhfTagBank bank) {
    if(bank == UhfTagBankTid) return "TID";
    if(bank == UhfTagBankUser) return "User Data";
    return "EPC";
}

static UhfTagBank uhf_next_tag_bank(UhfTagBank bank) {
    if(bank == UhfTagBankEpc) return UhfTagBankTid;
    if(bank == UhfTagBankTid) return UhfTagBankUser;
    return UhfTagBankEpc;
}

static const char* uhf_tag_bank_button_name(UhfTagBank bank) {
    if(bank == UhfTagBankTid) return "TID";
    if(bank == UhfTagBankUser) return "User";
    return "EPC";
}

static bool uhf_write_selected_bank(UhfApp* app, UhfTagBank bank, const char* value_hex) {
    uint8_t value[UHF_USER_HEX_MAX / 2U];
    size_t value_len = 0U;
    const char* name = uhf_tag_bank_name(bank);
    if(!uhf_hex_to_bytes(value_hex, value, sizeof(value), &value_len) || !value_len ||
       (value_len & 1U)) {
        uhf_set_status(app, "%s must be whole words", name);
        uhf_notify_write_result(app, false);
        return false;
    }

    /* Normal tag actions stay EPC-filtered. Fuzzing explicitly opts into an
       unfiltered write because the source may be replaced by a target tag. */
    if(!app->tag_access_unfiltered && !app->epc_filter_active &&
       !uhf_set_selected_epc_filter(app)) {
        uhf_notify_write_result(app, false);
        return false;
    }
    if(app->tag_access_unfiltered) uhf_clear_selected_epc_filter(app);
    furi_delay_ms(UHF_STOP_SETTLE_MS);

    uint8_t payload[11U + UHF_USER_HEX_MAX / 2U] = {0};
    memcpy(payload, app->access_keys[app->active_key_slot], 4U);
    payload[4] = (bank == UhfTagBankEpc) ? 0x01U : (bank == UhfTagBankTid ? 0x02U : 0x03U);
    payload[8] = (bank == UhfTagBankEpc) ? 0x02U : 0x00U;
    payload[10] = (uint8_t)(value_len / 2U);
    memcpy(&payload[11], value, value_len);
    uhf_set_status(app, "Writing %s...", name);
    if(!uhf_wait_tag_reply(app, UHF_CMD_WRITE_TAG, payload, 11U + value_len, 3000U)) {
        uhf_notify_write_result(app, false);
        return false;
    }

    uint8_t status = 0xFFU;
    if(app->tag_reply_len == 1U) {
        status = app->tag_reply[0];
    } else if(app->tag_reply_len >= 6U) {
        const size_t record_end = 3U + app->tag_reply[2];
        if(record_end < app->tag_reply_len) status = app->tag_reply[record_end];
    }
    if(status != 0x10U) {
        uhf_set_status(app, "%s write: %s", name, uhf_tag_error_text(status));
        uhf_notify_write_result(app, false);
        return false;
    }

    /* Once EPC memory changes, the old EPC filter can no longer match the
       same tag. Clear it before the verification read. */
    if(bank == UhfTagBankEpc) uhf_clear_selected_epc_filter(app);

    char verify[UHF_USER_HEX_MAX + 1U] = "";
    if(!uhf_read_selected_bank_words(
                  app,
                  bank == UhfTagBankEpc ? 0x01U : (bank == UhfTagBankTid ? 0x02U : 0x03U),
                  bank == UhfTagBankEpc ? 0x02U : 0x00U,
                  (uint8_t)(value_len / 2U),
                  verify,
                  sizeof(verify),
                  name,
                  false)) {
        uhf_set_status(app, "Write OK; verify failed");
        uhf_notify_write_result(app, false);
        return false;
    }
    if(strcmp(verify, value_hex) != 0) {
        uhf_set_status(app, "Verify mismatch");
        uhf_notify_write_result(app, false);
        return false;
    }
    if(bank == UhfTagBankEpc) {
        strncpy(app->selected_epc, verify, sizeof(app->selected_epc) - 1U);
        app->selected_epc[sizeof(app->selected_epc) - 1U] = '\0';
        strncpy(app->access_epc, verify, sizeof(app->access_epc) - 1U);
        app->access_epc[sizeof(app->access_epc) - 1U] = '\0';
    } else if(bank == UhfTagBankTid) {
        strncpy(app->selected_tid, verify, sizeof(app->selected_tid) - 1U);
        app->selected_tid[sizeof(app->selected_tid) - 1U] = '\0';
        app->selected_tid_valid = true;
    } else if(bank == UhfTagBankUser) {
        strncpy(app->selected_user, verify, sizeof(app->selected_user) - 1U);
        app->selected_user[sizeof(app->selected_user) - 1U] = '\0';
        app->selected_user_valid = true;
    }
    uhf_set_status(app, "%s write verified", name);
    uhf_notify_write_result(app, true);
    return true;
}

static uint8_t uhf_tag_reply_status(const UhfApp* app) {
    if(!app || app->tag_reply_len == 0U) return 0xFFU;
    if(app->tag_reply_len == 1U) return app->tag_reply[0];
    if(app->tag_reply_len >= 6U) {
        const size_t record_end = 3U + app->tag_reply[2];
        if(record_end < app->tag_reply_len) return app->tag_reply[record_end];
    }
    return 0xFFU;
}

static bool uhf_active_key_is_zero(const UhfApp* app) {
    const uint8_t* key = app->access_keys[app->active_key_slot];
    return !(key[0] || key[1] || key[2] || key[3]);
}

static bool uhf_lock_selected_bank(UhfApp* app, bool lock) {
    if(!app || !app->access_epc[0]) return false;
    if(lock && uhf_active_key_is_zero(app)) {
        uhf_set_status(app, "Set non-zero tag key first");
        uhf_notify_write_result(app, false);
        return false;
    }
    if(!app->epc_filter_active && !uhf_set_selected_epc_filter(app)) return false;

    uint8_t payload[6];
    memcpy(payload, app->access_keys[app->active_key_slot], 4U);
    payload[4] = app->tag_bank == UhfTagBankUser ? 0x01U :
                 (app->tag_bank == UhfTagBankTid ? 0x02U : 0x03U);
    payload[5] = lock ? 0x01U : 0x00U;
    uhf_set_status(app, "%s %s...", lock ? "Locking" : "Unlocking",
                   uhf_tag_bank_name(app->tag_bank));
    if(!uhf_wait_tag_reply(app, UHF_CMD_LOCK_TAG, payload, sizeof(payload), 3000U)) {
        uhf_notify_write_result(app, false);
        return false;
    }
    const uint8_t status = uhf_tag_reply_status(app);
    const bool ok = status == 0x10U;
    uhf_set_status(app, ok ? "%s complete" : "%s: %s",
                   lock ? "Lock" : "Unlock", uhf_tag_error_text(status));
    uhf_notify_write_result(app, ok);
    return ok;
}

static bool uhf_initialize_tag_access_key(UhfApp* app) {
    if(!app || !app->access_epc[0]) return false;
    if(uhf_active_key_is_zero(app)) {
        uhf_set_status(app, "Select a non-zero key");
        return false;
    }
    if(!app->epc_filter_active && !uhf_set_selected_epc_filter(app)) return false;

    /* Recovery/initialization path for a tag whose current Access Password is
       zero. Reserved bank words 2-3 contain the new 32-bit Access Password. */
    uint8_t payload[15] = {0};
    payload[4] = 0x00U;
    payload[8] = 0x02U;
    payload[10] = 0x02U;
    memcpy(&payload[11], app->access_keys[app->active_key_slot], 4U);
    uhf_set_status(app, "Setting tag access key...");
    if(!uhf_wait_tag_reply(app, UHF_CMD_WRITE_TAG, payload, sizeof(payload), 3000U)) {
        uhf_notify_write_result(app, false);
        return false;
    }
    const uint8_t status = uhf_tag_reply_status(app);
    const bool ok = status == 0x10U;
    if(!ok) {
        uhf_set_status(app, "Set key: %s", uhf_tag_error_text(status));
        uhf_notify_write_result(app, false);
        return false;
    }

    char verify[9] = "";
    if(!uhf_read_selected_bank_words(
           app, 0x00U, 0x02U, 2U, verify, sizeof(verify), "Access key", true)) {
        uhf_set_status(app, "Key set; verify unavailable");
        uhf_notify_write_result(app, true);
        return true;
    }
    char expected[9];
    snprintf(expected, sizeof(expected), "%02X%02X%02X%02X",
             app->access_keys[app->active_key_slot][0],
             app->access_keys[app->active_key_slot][1],
             app->access_keys[app->active_key_slot][2],
             app->access_keys[app->active_key_slot][3]);
    const bool verified = strcmp(verify, expected) == 0;
    uhf_set_status(app, verified ? "Tag access key verified" : "Key set; verify mismatch");
    uhf_notify_write_result(app, verified);
    return verified;
}

static bool uhf_reset_tag_access_key(UhfApp* app) {
    if(!app || !app->access_epc[0]) return false;
    if(uhf_active_key_is_zero(app)) {
        uhf_set_status(app, "Select current non-zero key");
        uhf_notify_write_result(app, false);
        return false;
    }
    if(!app->epc_filter_active && !uhf_set_selected_epc_filter(app)) return false;

    /* Authenticate with the active key, then restore Reserved words 2-3 to
       the Gen2 default Access Password. Banks must be unlocked first. */
    uint8_t payload[15] = {0};
    memcpy(payload, app->access_keys[app->active_key_slot], 4U);
    payload[4] = 0x00U;
    payload[8] = 0x02U;
    payload[10] = 0x02U;
    uhf_set_status(app, "Resetting tag access key...");
    if(!uhf_wait_tag_reply(app, UHF_CMD_WRITE_TAG, payload, sizeof(payload), 3000U)) {
        uhf_notify_write_result(app, false);
        return false;
    }
    const uint8_t status = uhf_tag_reply_status(app);
    const bool ok = status == 0x10U;
    uhf_set_status(app, ok ? "Tag key reset to zero" : "Reset key: %s",
                   uhf_tag_error_text(status));
    uhf_notify_write_result(app, ok);
    return ok;
}

static bool uhf_erase_selected_bank(UhfApp* app) {
    if(!app || app->tag_bank == UhfTagBankTid) {
        if(app) uhf_set_status(app, "TID cannot be erased");
        return false;
    }
    bool valid = false;
    const char* current = uhf_current_tag_bank_value(app, &valid);
    if(!valid || !current[0]) {
        uhf_set_status(app, "Read bank before erase");
        return false;
    }
    const size_t len = strlen(current);
    char zeros[UHF_USER_HEX_MAX + 1U];
    if(len > UHF_USER_HEX_MAX) return false;
    memset(zeros, '0', len);
    /* A completely zero EPC is legal on some tags but is commonly hidden by
       readers and makes multiple cleared tags indistinguishable. Preserve a
       minimal non-zero identity while clearing the rest of EPC memory. */
    if(app->tag_bank == UhfTagBankEpc && len > 0U) zeros[len - 1U] = '1';
    zeros[len] = '\0';
    return uhf_write_selected_bank(app, app->tag_bank, zeros);
}

static bool uhf_ensure_hardware(UhfApp* app) {
    /* hardware_ready means the UART is configured. Reader presence is tracked
       independently by the version response. */
    if(app->hardware_ready && app->serial) return true;

    const uint32_t desired_baud = app->baud_rate;

    if(!app->serial) {
        uhf_force_direct_a6_a4(app);
    }
    if(!app->serial) {
        uhf_set_status(app, "UART 13/14 open failed");
        return false;
    }

    app->hardware_ready = true;

    bool probe_ok = false;
    if(desired_baud != 0U) {
        probe_ok = uhf_probe_current_serial(app, desired_baud);
    }
    if(!probe_ok) {
        probe_ok = uhf_probe_current_serial(app, UHF_BAUD_RATE);
    }

    uhf_diag_log(
        app,
        "HW ready TX:%d RX:%d probe=%s",
        app->tx_ext_pin,
        app->rx_ext_pin,
        probe_ok ? "ok" : "fail");
    return true;
}

static void uhf_apply_baud(UhfApp* app, uint32_t baud_rate) {
    app->baud_rate = baud_rate;
    if(!app->serial) return;

    if(app->inventory_running) {
        app->inventory_running = false;
        (void)uhf_send_command(app, UHF_CMD_STOP_INV, NULL, 0);
    }

    furi_hal_serial_async_rx_stop(app->serial);
    furi_hal_serial_set_br(app->serial, baud_rate);
    furi_hal_serial_async_rx_start(app->serial, uhf_on_rx_irq, app, true);

    app->frame_buffer_len = 0;
    if(app->rx_stream) {
        (void)furi_stream_buffer_reset(app->rx_stream);
    }
    uhf_set_status(app, "Baud: %lu", (unsigned long)baud_rate);
}
static void uhf_stop_inventory(UhfApp* app) {
    static const uint8_t stop_frame[] = {0xA0, 0x03, 0x00, 0x8C, 0xD1};
    app->inventory_running = false;
    app->tags_per_second = 0;
    app->rate_window_reads = 0;
    app->rate_window_started = furi_get_tick();
    app->radar_step_tick = furi_get_tick();
    app->last_inv_session_tick = 0U;
    if(app->hardware_ready) {
        (void)uhf_send_raw_frame(app, stop_frame, sizeof(stop_frame));
    }
}

static bool uhf_wait_for_reader_query(UhfApp* app, bool* pending) {
    const uint32_t started = furi_get_tick();
    while(*pending && (furi_get_tick() - started) < UHF_READER_QUERY_TIMEOUT_MS) {
        uhf_process_rx(app);
        if(*pending) furi_delay_ms(5U);
    }

    if(*pending) {
        *pending = false;
        return false;
    }
    return true;
}

static bool uhf_query_reader_temperature(UhfApp* app, bool wait_for_response) {
    app->temperature_query_pending = true;
    if(!uhf_send_command(app, UHF_CMD_GET_TEMP, NULL, 0U)) {
        app->temperature_query_pending = false;
        return false;
    }

    app->last_temperature_query_tick = furi_get_tick();
    return !wait_for_response ||
           uhf_wait_for_reader_query(app, &app->temperature_query_pending);
}

static bool uhf_query_reader_power(UhfApp* app, bool wait_for_response) {
    app->power_query_pending = true;
    if(!uhf_send_command(app, UHF_CMD_GET_POWER, NULL, 0U)) {
        app->power_query_pending = false;
        return false;
    }

    return !wait_for_response || uhf_wait_for_reader_query(app, &app->power_query_pending);
}

static bool uhf_set_reader_power(UhfApp* app, uint8_t power_dbm) {
    if(!app || power_dbm > 20U || !uhf_ensure_hardware(app)) return false;
    if(app->inventory_running) uhf_stop_inventory(app);

    if(!uhf_wait_tag_reply(app, UHF_CMD_SET_POWER, &power_dbm, 1U, 1000U)) {
        uhf_set_status(app, "Power command timeout");
        return false;
    }

    /* UCM601 replies with 0x10 on success. Some firmware echoes the value. */
    if(app->tag_reply_len == 0U ||
       (app->tag_reply[0] != 0x10U && app->tag_reply[0] != power_dbm)) {
        uhf_set_status(app, "Power set failed");
        return false;
    }
    app->reader_power_dbm = power_dbm;
    app->power_valid = true;
    uhf_set_status(app, "RF power: %u dBm", power_dbm);
    return true;
}

static void uhf_start_inventory(UhfApp* app) {
    static const uint8_t start_frame[] = {0xA0, 0x04, 0x00, 0x89, 0x01, 0xD2};
    if(!uhf_ensure_hardware(app)) return;

    if(!uhf_has_version(app)) {
        uhf_set_status(app, "Connecting reader...");
        bool reader_ok = uhf_try_reader_handshake(app, 2U);
        if(!reader_ok && uhf_recover_reader(app)) {
            reader_ok = uhf_try_reader_handshake(app, 5U);
        }
        if(!reader_ok) {
            uhf_set_status(app, "Not Ready");
            return;
        }
    }

    /* Read reader telemetry while RF inventory is idle so the replies cannot
       compete with a burst of tag reports. A missing reply does not prevent
       inventory from starting; the radar keeps the last valid value. */
    (void)uhf_query_reader_temperature(app, true);
    (void)uhf_query_reader_power(app, true);

    (void)furi_stream_buffer_reset(app->rx_stream);
    app->frame_buffer_len = 0;
    const bool sent = uhf_send_raw_frame(app, start_frame, sizeof(start_frame));
    uhf_process_rx(app);

    if(sent) {
        app->inventory_running = true;
        app->tags_per_second = 0;
        app->rate_window_reads = 0;
        app->rate_window_started = furi_get_tick();
        app->radar_step_tick = furi_get_tick();
        app->last_inv_refresh_tick = furi_get_tick();
        app->last_inv_session_tick = app->last_inv_refresh_tick;
        uhf_set_status(app, "Inventory running");
    } else {
        uhf_set_status(app, "Start inventory failed");
    }
}

static bool uhf_try_reader_handshake(UhfApp* app, uint8_t attempts) {
    if(!app || attempts == 0U) return false;

    for(uint8_t attempt = 0U; attempt < attempts; attempt++) {
        uhf_request_version(app);
        if(uhf_wait_for_version(app, UHF_PROBE_TIMEOUT_MS)) {
            app->baud_probed = true;
            return true;
        }
    }
    return false;
}

static bool uhf_recover_reader(UhfApp* app) {
    if(!app || !app->serial) return false;

    uhf_stop_inventory(app);
    furi_delay_ms(UHF_STOP_SETTLE_MS);
    if(app->rx_stream) furi_stream_buffer_reset(app->rx_stream);
    app->frame_buffer_len = 0U;

    static const uint8_t reset_frame[] = {0xA0, 0x03, 0x00, UHF_CMD_RESET, 0xED};
    if(!uhf_send_raw_frame(app, reset_frame, sizeof(reset_frame))) return false;

    uhf_diag_log(app, "Reader reset sent");
    furi_delay_ms(UHF_RESET_SETTLE_MS);
    uhf_process_rx(app);
    if(app->rx_stream) furi_stream_buffer_reset(app->rx_stream);
    app->frame_buffer_len = 0U;
    uhf_clear_version(app);
    return true;
}

static void uhf_release_reset_pin(void) {
    furi_hal_gpio_init_simple(&gpio_ext_pc0, GpioModeAnalog);
}

static void uhf_hardware_reset_reader(UhfApp* app) {
    /* Hardware revision 2 connects UCM601NC RST (active low) to Flipper C0,
       external header pin 16. Keep it driven high after the pulse so the
       reader cannot drift back into reset. On revision 1 C0 is unconnected,
       making this sequence harmless. */
    furi_hal_gpio_write(&gpio_ext_pc0, true);
    furi_hal_gpio_init_simple(&gpio_ext_pc0, GpioModeOutputPushPull);
    furi_delay_ms(2U);
    furi_hal_gpio_write(&gpio_ext_pc0, false);
    furi_delay_ms(UHF_RESET_LOW_MS);
    furi_hal_gpio_write(&gpio_ext_pc0, true);
    furi_delay_ms(UHF_RESET_BOOT_MS);
    if(app) {
        uhf_diag_log(app, "Hardware reset C0/pin %u", (unsigned)UHF_RESET_EXT_PIN);
    }
}

static bool uhf_power_cycle_reader(UhfApp* app) {
    if(!app || app->hard_reset_attempted) return false;
    app->hard_reset_attempted = true;

    if(app->serial) uhf_close_serial(app);
    app->hardware_ready = false;

    Storage* storage = furi_record_open(RECORD_STORAGE);
    if(!storage) {
        uhf_diag_log(app, "Hard reset: storage unavailable");
        return false;
    }

    const FS_Error unmount_error = storage_sd_unmount(storage);
    if(unmount_error != FSE_OK && unmount_error != FSE_NOT_READY) {
        uhf_diag_log(app, "Hard reset: SD unmount failed %d", (int)unmount_error);
        furi_record_close(RECORD_STORAGE);
        return false;
    }

    /* Put both UART lines low before the supply falls, keep them low while the
       reader is unpowered, and hold them low throughout its next power-up. */
    furi_hal_gpio_write(&gpio_usart_tx, false);
    furi_hal_gpio_write(&gpio_usart_rx, false);
    furi_hal_gpio_init_simple(&gpio_usart_tx, GpioModeOutputPushPull);
    furi_hal_gpio_init_simple(&gpio_usart_rx, GpioModeOutputPushPull);

    uhf_diag_log(app, "Hard reset: UART low, external 3.3V off");
    furi_hal_power_disable_external_3_3v();
    furi_delay_ms(UHF_POWER_OFF_MS);

    furi_hal_power_enable_external_3_3v();

    FS_Error mount_error = FSE_NOT_READY;
    uint32_t power_boot_elapsed_ms = 0U;
    for(uint8_t attempt = 0U; attempt < 8U && mount_error != FSE_OK; attempt++) {
        furi_delay_ms(100U);
        power_boot_elapsed_ms += 100U;
        mount_error = storage_sd_mount(storage);
    }

    if(UHF_POWER_BOOT_MS > power_boot_elapsed_ms) {
        furi_delay_ms(UHF_POWER_BOOT_MS - power_boot_elapsed_ms);
    }

    furi_hal_gpio_init_simple(&gpio_usart_tx, GpioModeAnalog);
    furi_hal_gpio_init_simple(&gpio_usart_rx, GpioModeAnalog);
    furi_delay_ms(UHF_POWER_READY_MS);
    furi_record_close(RECORD_STORAGE);

    if(mount_error != FSE_OK) {
        uhf_diag_log(app, "Hard reset: SD mount failed %d", (int)mount_error);
        return false;
    }

    app->baud_rate = UHF_BAUD_RATE;
    if(!uhf_open_bridge_uart(app)) {
        uhf_diag_log(app, "Hard reset: UART reopen failed");
        return false;
    }

    app->hardware_ready = true;
    uhf_hardware_reset_reader(app);
    app->frame_buffer_len = 0U;
    if(app->rx_stream) furi_stream_buffer_reset(app->rx_stream);
    uhf_clear_version(app);
    uhf_diag_log(app, "Hard reset complete");
    return true;
}

static void uhf_service_inventory(UhfApp* app) {
    if(!app || !app->inventory_running) return;

    const uint32_t now = furi_get_tick();
    if(app->temperature_query_pending &&
       (now - app->last_temperature_query_tick) >= UHF_READER_QUERY_TIMEOUT_MS) {
        app->temperature_query_pending = false;
        uhf_diag_log(app, "Temperature query timeout");
    }
    if(!app->temperature_query_pending &&
       (now - app->last_temperature_query_tick) >= UHF_TEMP_REFRESH_MS) {
        (void)uhf_query_reader_temperature(app, false);
        return;
    }

    const bool session_renew_due =
        (now - app->last_inv_session_tick) >= UHF_INV_SESSION_RENEW_MS;
    if(session_renew_due) {
        static const uint8_t stop_frame[] = {0xA0, 0x03, 0x00, 0x8C, 0xD1};
        static const uint8_t start_frame[] = {0xA0, 0x04, 0x00, 0x89, 0x01, 0xD2};

        (void)uhf_send_raw_frame(app, stop_frame, sizeof(stop_frame));
        furi_delay_ms(UHF_INV_RENEW_SETTLE_MS);
        uhf_process_rx(app);

        const uint32_t restarted_at = furi_get_tick();
        if(uhf_send_raw_frame(app, start_frame, sizeof(start_frame))) {
            app->last_inv_refresh_tick = restarted_at;
            app->last_inv_session_tick = restarted_at;
            uhf_set_status(app, "Inventory running");
            uhf_diag_log(app, "Inventory session renewed");
        } else {
            app->last_inv_session_tick = restarted_at;
            uhf_set_status(app, "Inventory restart failed");
        }
        return;
    }

    const bool heartbeat_due =
        (now - app->last_inv_refresh_tick) >= UHF_INV_HEARTBEAT_MS;
    if(!heartbeat_due) return;

    /* The reader's completion response is not a reliable pacing signal and
       immediately chaining on it can overrun the reader. Match the proven
       Cardputer cadence: start one repeat every 250 ms without inserting a
       stop command or clearing buffered reports between rounds. */
    static const uint8_t start_frame[] = {0xA0, 0x04, 0x00, 0x89, 0x01, 0xD2};

    if(uhf_send_raw_frame(app, start_frame, sizeof(start_frame))) {
        app->last_inv_refresh_tick = now;
        uhf_set_status(app, "Inventory running");
    } else {
        app->last_inv_refresh_tick = now;
        uhf_set_status(app, "Inventory restart failed");
    }
}

static void uhf_request_version(UhfApp* app) {
    if(!uhf_ensure_hardware(app)) return;
    app->frame_buffer_len = 0;
    app->rx_bytes = 0;
    app->rx_frames = 0;
    app->rx_errors = 0;
    app->last_rx_hex[0] = '\0';
    uhf_clear_version(app);
    if(app->rx_stream) {
        (void)furi_stream_buffer_reset(app->rx_stream);
    }

    static const uint8_t version_frame[] = {0xA0, 0x03, 0x00, 0x72, 0xEB};
    bool sent = false;
    for(size_t attempt = 0; attempt < 2; attempt++) {
        if(uhf_send_raw_frame(app, version_frame, sizeof(version_frame))) {
            sent = true;
        }
        uhf_process_rx(app);
        furi_delay_ms(8);
    }

    if(sent) {
        uhf_set_status(app, "Version checking...");
        uhf_diag_log(app, "Version req TX:%d RX:%d", app->tx_ext_pin, app->rx_ext_pin);
    } else {
        uhf_set_status(app, "Version tx failed");
        uhf_diag_log(app, "Version tx failed");
    }
}

static bool uhf_add_inventory_tag(
    UhfApp* app,
    const uint8_t* epc,
    size_t epc_len,
    uint8_t antenna,
    uint32_t rssi,
    uint32_t frequency,
    uint32_t hit_count) {
    if(!uhf_is_valid_epc(epc, epc_len)) return false;
    if(hit_count == 0U) hit_count = 1U;

    char epc_hex[UHF_EPC_HEX_MAX + 1];
    if(!uhf_bytes_to_hex(epc, epc_len, epc_hex, sizeof(epc_hex))) return false;

    bool is_new_tag = false;
    if(!uhf_data_lock(app, 10)) return false;

    UhfTagEntry* tag = uhf_find_or_add_tag(app, epc_hex, &is_new_tag);
    if(!tag) {
        uhf_data_unlock(app);
        uhf_set_status(app, "Tag cache full");
        return false;
    }

    const uint32_t updated_count = (uint32_t)tag->read_count + hit_count;
    tag->read_count = updated_count > UINT16_MAX ? UINT16_MAX : (uint16_t)updated_count;
    app->rate_window_reads += hit_count;
    tag->last_seen = furi_get_tick();
    tag->antenna = antenna;
    tag->rssi = rssi;
    tag->frequency = frequency;
    uhf_data_unlock(app);

    uhf_notify_tag_found(app);

    if(is_new_tag) {
        const size_t total = uhf_count_tags(app);
        if(!app->list_selection_manual) {
            if(total > UHF_LIST_VISIBLE_ROWS) {
                app->list_top_index = total - UHF_LIST_VISIBLE_ROWS;
            } else {
                app->list_top_index = 0;
            }
            app->list_selected_index = total ? (total - 1U) : 0;
        }
        uhf_set_status(app, "Tag Found: %lu", (unsigned long)total);
    }

    return true;
}

static bool uhf_parse_pc_epc_at(UhfApp* app, const uint8_t* data, size_t data_len, size_t pc_offset, uint8_t antenna) {
    if(data_len < pc_offset + 4U) return false;

    const uint16_t pc = (uint16_t)((data[pc_offset] << 8) | data[pc_offset + 1U]);
    const size_t epc_words = (pc >> 11) & 0x1F;
    const size_t epc_len = epc_words * 2U;
    const size_t epc_offset = pc_offset + 2U;
    const size_t meta_offset = epc_offset + epc_len;

    if(epc_len == 0 || epc_len > (UHF_EPC_HEX_MAX / 2U) || data_len < meta_offset) return false;

    uint32_t rssi = 0;
    uint32_t frequency = 0;
    if(data_len >= meta_offset + 7U) {
        rssi = uhf_read_be(&data[meta_offset], 4);
        frequency = uhf_read_be(&data[meta_offset + 4U], 3);
    }

    return uhf_add_inventory_tag(app, &data[epc_offset], epc_len, antenna, rssi, frequency, 1U);
}

static bool uhf_parse_inventory_buffer_frame(UhfApp* app, const uint8_t* data, size_t data_len) {
    if(data_len < 11U) return false;

    const size_t inv_data_len = data[0];
    const size_t required_len = 1U + inv_data_len + 4U + 3U + 1U + 1U;
    if(inv_data_len < 4U || data_len < required_len) return false;

    const uint8_t* inv_data = &data[1];
    const size_t epc_len = inv_data_len - 4U;
    const size_t offset = 1U + inv_data_len;
    const uint8_t antenna = data[offset + 7U];
    uint32_t hit_count = data[offset + 8U];
    if(hit_count == 0U) hit_count = 1U;
    const uint32_t rssi = uhf_read_be(&data[offset], 4);
    const uint32_t frequency = uhf_read_be(&data[offset + 4U], 3);

    return uhf_add_inventory_tag(
        app, &inv_data[2], epc_len, antenna, rssi, frequency, hit_count);
}

static bool uhf_parse_inventory_frame(UhfApp* app, const uint8_t* data, size_t data_len, uint8_t cmd) {
    if(cmd == UHF_CMD_INV_ALT && uhf_parse_inventory_buffer_frame(app, data, data_len)) {
        return true;
    }
    if(uhf_parse_pc_epc_at(app, data, data_len, 1U, data_len ? data[0] : 0U)) return true;
    if(cmd != UHF_CMD_INV_ALT && uhf_parse_inventory_buffer_frame(app, data, data_len)) {
        return true;
    }

    for(size_t offset = 0; offset < 3U && offset < data_len; offset++) {
        if(uhf_parse_pc_epc_at(app, data, data_len, offset, 0)) return true;
    }

    return false;
}

static void uhf_handle_frame(UhfApp* app, const uint8_t* frame, size_t frame_size) {
    if(frame_size < 5U || frame[0] != UHF_FRAME_START) return;

    uhf_store_last_rx_hex(app, frame, frame_size);

    uint8_t checksum_acc = 0;
    for(size_t i = 0; i < frame_size; i++) {
        checksum_acc = (uint8_t)(checksum_acc + frame[i]);
    }
    if(checksum_acc != 0U) {
        app->rx_errors++;
    }

    app->rx_frames++;

    const uint8_t cmd = frame[3];
    const size_t data_len = (frame[1] >= 3U) ? (size_t)(frame[1] - 3U) : 0U;
    const uint8_t* data = &frame[4];

    uhf_diag_log(
        app,
        "RX cmd=%02X len=%lu cs=%s",
        cmd,
        (unsigned long)data_len,
        (checksum_acc == 0U) ? "ok" : "bad");

    if(cmd == UHF_CMD_READ_TAG || cmd == UHF_CMD_WRITE_TAG || cmd == UHF_CMD_LOCK_TAG ||
       cmd == UHF_CMD_SET_EPC_MATCH || cmd == UHF_CMD_SET_POWER) {
        FURI_LOG_I(
            TAG,
            "Tag RX cmd=%02X len=%lu cs=%s raw=%s",
            cmd,
            (unsigned long)data_len,
            checksum_acc == 0U ? "ok" : "bad",
            app->last_rx_hex);
    }

    if(cmd == UHF_CMD_READ_TAG || cmd == UHF_CMD_WRITE_TAG || cmd == UHF_CMD_LOCK_TAG ||
       cmd == UHF_CMD_SET_EPC_MATCH || cmd == UHF_CMD_SET_POWER) {
        const size_t copied = data_len > sizeof(app->tag_reply) ? sizeof(app->tag_reply) : data_len;
        if(copied) memcpy(app->tag_reply, data, copied);
        app->tag_reply_len = copied;
        app->tag_reply_cmd = cmd;
        app->tag_reply_checksum_ok = checksum_acc == 0U;
        app->tag_reply_ready = true;
        return;
    }

    if(cmd == UHF_CMD_GET_VERSION && data_len >= 3U) {
        if(uhf_data_lock(app, 10)) {
            snprintf(app->version, sizeof(app->version), "%u.%u.%u", data[0], data[1], data[2]);
            uhf_data_unlock(app);
        }
        uhf_set_status(app, "Version %s", app->version);
        uhf_diag_log(app, "Version=%s", app->version);
    } else if(cmd == UHF_CMD_GET_TEMP) {
        app->temperature_query_pending = false;
        FURI_LOG_I(
            TAG,
            "Temperature response: len=%lu sign=%u value=%u checksum=%s",
            (unsigned long)data_len,
            data_len >= 1U ? data[0] : 0U,
            data_len >= 2U ? data[1] : 0U,
            checksum_acc == 0U ? "ok" : "bad");
        if(checksum_acc == 0U && data_len >= 2U && data[0] <= 1U) {
            int16_t raw_temperature = (int16_t)data[1];
            if(data[0] == 0U) raw_temperature = -raw_temperature;
            const int16_t display_temperature =
                raw_temperature + UHF_TEMP_DISPLAY_OFFSET_C;
            if(uhf_data_lock(app, 10)) {
                app->reader_temperature_c = display_temperature;
                app->temperature_valid = true;
                uhf_data_unlock(app);
            }
            uhf_diag_log(
                app,
                "Temperature raw=%dC display=%dC",
                (int)raw_temperature,
                (int)display_temperature);
            FURI_LOG_I(
                TAG,
                "Reader temperature: raw=%d C display=%d C",
                (int)raw_temperature,
                (int)display_temperature);
        } else {
            uhf_diag_log(app, "Temperature query failed");
            FURI_LOG_W(TAG, "Reader temperature query failed");
        }
    } else if(cmd == UHF_CMD_GET_POWER) {
        app->power_query_pending = false;
        if(checksum_acc == 0U && data_len >= 1U && data[0] <= 33U) {
            if(uhf_data_lock(app, 10)) {
                /* This expansion uses antenna 1; multi-antenna readers return
                   additional power bytes after the first one. */
                app->reader_power_dbm = data[0];
                app->power_valid = true;
                uhf_data_unlock(app);
            }
            uhf_diag_log(app, "Power=%udBm", data[0]);
            FURI_LOG_I(TAG, "Reader output power: %u dBm", data[0]);
        } else {
            uhf_diag_log(app, "Power query failed");
            FURI_LOG_W(TAG, "Reader output power query failed");
        }
    } else if(cmd == UHF_CMD_START_INV || cmd == UHF_CMD_INV_ALT || app->inventory_running) {
        const bool parsed_tag = uhf_parse_inventory_frame(app, data, data_len, cmd);
        if(!parsed_tag &&
            checksum_acc == 0U && (cmd == UHF_CMD_START_INV || cmd == UHF_CMD_INV_ALT) &&
            data_len <= 7U) {
            /* A short 0x89/0x8A reply is completion/error status, not tag data.
               The fixed inventory heartbeat starts the next round. */
            uhf_diag_log(app, "Inventory ended cmd=%02X len=%lu", cmd, (unsigned long)data_len);
        }
    } else if(cmd == UHF_CMD_STOP_INV) {
        if(!app->inventory_running) {
            uhf_set_status(app, "Inventory stopped");
        }
    }
}

static void uhf_process_rx(UhfApp* app) {
    uint8_t chunk[64];
    size_t got = 0;
    size_t chunk_budget = UHF_RX_CHUNKS_PER_PASS;
    size_t frame_budget = UHF_RX_FRAMES_PER_PASS;

    while(chunk_budget && frame_budget &&
          (got = furi_stream_buffer_receive(app->rx_stream, chunk, sizeof(chunk), 0)) > 0U) {
        chunk_budget--;
        app->rx_bytes += got;
        if(app->frame_buffer_len + got > sizeof(app->frame_buffer)) {
            app->rx_errors++;
            app->frame_buffer_len = 0;
        }

        memcpy(&app->frame_buffer[app->frame_buffer_len], chunk, got);
        app->frame_buffer_len += got;

        size_t index = 0;
        while(index < app->frame_buffer_len) {
            while(index < app->frame_buffer_len && app->frame_buffer[index] != UHF_FRAME_START) {
                index++;
            }
            if((app->frame_buffer_len - index) < 2U) break;

            const size_t frame_size = (size_t)app->frame_buffer[index + 1U] + 2U;
            if(frame_size < 5U) {
                app->rx_errors++;
                index++;
                continue;
            }
            if((app->frame_buffer_len - index) < frame_size) break;

            uhf_handle_frame(app, &app->frame_buffer[index], frame_size);
            index += frame_size;

            frame_budget--;
            if(frame_budget == 0U) {
                break;
            }
        }

        if(index > 0U) {
            const size_t remain = app->frame_buffer_len - index;
            if(remain) {
                memmove(app->frame_buffer, &app->frame_buffer[index], remain);
            }
            app->frame_buffer_len = remain;
        }

        if(frame_budget == 0U) {
            break;
        }
    }

}

static bool uhf_wait_for_version(UhfApp* app, uint32_t timeout_ms) {
    const uint32_t started = furi_get_tick();
    while((furi_get_tick() - started) < timeout_ms) {
        uhf_process_rx(app);
        if(uhf_has_version(app)) {
            return true;
        }
        furi_delay_ms(12U);
    }
    return false;
}

static bool uhf_probe_current_serial(UhfApp* app, uint32_t baud) {
    if(!app->serial) return false;

    uhf_apply_baud(app, baud);
    uhf_clear_version(app);
    if(!uhf_has_version(app)) {
        uhf_request_version(app);
    }
    return uhf_wait_for_version(app, UHF_PROBE_TIMEOUT_MS);
}

static bool uhf_save_diag_log(UhfApp* app) {
    Storage* storage = furi_record_open(RECORD_STORAGE);
    if(!storage) {
        uhf_set_status(app, "Storage unavailable");
        return false;
    }

    if(!storage_dir_exists(storage, UHF_APP_DATA_DIR)) {
        const FS_Error mkdir_result = storage_common_mkdir(storage, UHF_APP_DATA_DIR);
        if(mkdir_result != FSE_OK && mkdir_result != FSE_EXIST) {
            furi_record_close(RECORD_STORAGE);
            uhf_set_status(app, "Create dir failed");
            return false;
        }
    }

    char path[128];
    const uint32_t now = furi_get_tick();
    snprintf(path, sizeof(path), UHF_APP_DATA_DIR "/diag_%lu.log", (unsigned long)now);

    File* file = storage_file_alloc(storage);
    if(!file) {
        furi_record_close(RECORD_STORAGE);
        uhf_set_status(app, "File alloc failed");
        return false;
    }

    bool ok = false;
    do {
        if(!storage_file_open(file, path, FSAM_WRITE, FSOM_CREATE_ALWAYS)) {
            uhf_set_status(app, "Open log failed");
            break;
        }

        char header[128];
        const int header_len = snprintf(
            header,
            sizeof(header),
            "diag tick=%lu tx=%d rx=%d baud=%lu\\n",
            (unsigned long)now,
            app->tx_ext_pin,
            app->rx_ext_pin,
            (unsigned long)app->baud_rate);
        if(header_len > 0) {
            (void)storage_file_write(file, header, (size_t)header_len);
        }

        const size_t count = app->diag_count;
        const size_t start = (app->diag_head + UHF_DIAG_LOG_LINES - count) % UHF_DIAG_LOG_LINES;
        for(size_t i = 0; i < count; i++) {
            const size_t idx = (start + i) % UHF_DIAG_LOG_LINES;
            const char* line = app->diag_log[idx];
            if(!line[0]) continue;
            const size_t len = strlen(line);
            if(len) {
                (void)storage_file_write(file, line, len);
                (void)storage_file_write(file, "\\n", 1);
            }

            // Yield periodically to keep UI/task scheduler responsive on long writes.
            if((i & 0x07U) == 0x07U) {
                furi_delay_ms(1);
            }
        }

        storage_file_sync(file);
        uhf_set_status(app, "Diag saved: %s", path);
        ok = true;
    } while(false);

    storage_file_close(file);
    storage_file_free(file);
    furi_record_close(RECORD_STORAGE);
    return ok;
}

static void uhf_clear_tags(UhfApp* app) {
    if(uhf_data_lock(app, 10)) {
        memset(app->tags, 0, sizeof(app->tags));
        app->tag_count = 0;
        app->list_top_index = 0;
        app->list_selected_index = 0;
        app->list_selection_manual = false;
        uhf_data_unlock(app);
    }
    uhf_set_status(app, "Records cleared");
}

static void uhf_update_inventory_rate(UhfApp* app) {
    if(!app) return;

    const uint32_t now = furi_get_tick();
    if(app->rate_window_started == 0U) {
        app->rate_window_started = now;
        return;
    }

    const uint32_t elapsed = now - app->rate_window_started;
    if(elapsed < 1000U) return;

    if(uhf_data_lock(app, 10)) {
        app->tags_per_second = app->inventory_running ?
                                   (uint32_t)(((uint64_t)app->rate_window_reads * 1000U) / elapsed) :
                                   0U;
        app->rate_window_reads = 0U;
        app->rate_window_started = now;
        uhf_data_unlock(app);
    }
}

static void uhf_update_radar_animation(UhfApp* app) {
    if(!app) return;

    const uint32_t now = furi_get_tick();
    if(!app->inventory_running) {
        /* Prevent a paused radar from catching up when inventory resumes. */
        app->radar_step_tick = now;
        return;
    }

    if(app->radar_step_tick == 0U) {
        app->radar_step_tick = now;
        return;
    }

    const uint32_t elapsed = now - app->radar_step_tick;
    if(elapsed < UHF_RADAR_STEP_MS) return;

    const uint32_t steps = elapsed / UHF_RADAR_STEP_MS;
    app->radar_sweep_phase =
        (uint8_t)((app->radar_sweep_phase + steps) % UHF_RADAR_PHASE_COUNT);
    if(app->page == UhfPageRadar && app->radar_trail_depth < 8U) {
        const uint32_t depth = app->radar_trail_depth + steps;
        app->radar_trail_depth = (uint8_t)(depth > 8U ? 8U : depth);
    }
    app->radar_step_tick += steps * UHF_RADAR_STEP_MS;
}

static size_t uhf_collect_tag_previews(
    UhfApp* app,
    size_t start,
    UhfTagPreview* out,
    size_t max_items,
    size_t* total) {
    if(!app || !out || !max_items || !total) return 0;
    if(!uhf_data_lock(app, 20)) return 0;

    size_t copied = 0;
    size_t index = 0;
    size_t used_total = 0;

    for(size_t i = 0; i < UHF_MAX_TAGS; i++) {
        if(!app->tags[i].used) continue;

        if(index >= start && copied < max_items) {
            strncpy(out[copied].epc, app->tags[i].epc, sizeof(out[copied].epc) - 1);
            out[copied].epc[sizeof(out[copied].epc) - 1] = '\0';
            out[copied].count = app->tags[i].read_count;
            copied++;
        }

        index++;
        used_total++;
    }

    *total = used_total;
    uhf_data_unlock(app);
    return copied;
}

static void uhf_draw_centered_text(Canvas* canvas, int y, const char* text) {
    if(!canvas || !text) return;

    const int width = canvas_string_width(canvas, text);
    int x = (128 - width) / 2;
    if(x < 0) x = 0;
    canvas_draw_str(canvas, x, y, text);
}

static void uhf_draw_radar_ring(
    Canvas* canvas,
    int32_t center_x,
    int32_t center_y,
    const int8_t* ring_x,
    const int8_t* ring_y,
    int32_t scale) {
    for(uint8_t i = 0; i < 24U; i++) {
        const uint8_t next = (uint8_t)((i + 1U) % 24U);
        canvas_draw_line(
            canvas,
            center_x + ((int32_t)ring_x[i] * scale) / 27,
            center_y + ((int32_t)ring_y[i] * scale) / 27,
            center_x + ((int32_t)ring_x[next] * scale) / 27,
            center_y + ((int32_t)ring_y[next] * scale) / 27);
    }
}

static int32_t uhf_radar_sin(uint8_t phase) {
    static const uint8_t quarter_wave[25] = {
        0, 8, 17, 25, 33, 41, 49, 56, 63, 71, 77, 84, 90,
        95, 101, 106, 110, 114, 117, 120, 123, 125, 126, 127, 127,
    };

    phase %= UHF_RADAR_PHASE_COUNT;
    const uint8_t quadrant = phase / 24U;
    const uint8_t offset = phase % 24U;

    if(quadrant == 0U) return quarter_wave[offset];
    if(quadrant == 1U) return quarter_wave[24U - offset];
    if(quadrant == 2U) return -(int32_t)quarter_wave[offset];
    return -(int32_t)quarter_wave[24U - offset];
}

static void uhf_radar_vector(uint8_t phase, int32_t radius, int32_t* x, int32_t* y) {
    *x = (uhf_radar_sin(phase) * radius * 29) / (127 * 27);
    *y = -(uhf_radar_sin((uint8_t)(phase + 24U)) * radius) / 127;
}

static void uhf_draw_radar_page(Canvas* canvas, UhfApp* app) {
    static const int8_t sweep_x[24] = {
        0, 8, 15, 21, 25, 28, 29, 28, 25, 21, 15, 8,
        0, -8, -15, -21, -25, -28, -29, -28, -25, -21, -15, -8,
    };
    static const int8_t sweep_y[24] = {
        -27, -26, -23, -19, -14, -7, 0, 7, 14, 19, 23, 26,
        27, 26, 23, 19, 14, 7, 0, -7, -14, -19, -23, -26,
    };

    const int32_t center_x = 31;
    const int32_t center_y = 36;
    uint8_t target_x[UHF_MAX_TAGS];
    uint8_t target_y[UHF_MAX_TAGS];
    size_t target_count = 0;
    uint32_t rate = 0;
    size_t unique = 0;
    int16_t temperature = 0;
    uint8_t power_dbm = 0;
    bool temperature_valid = false;
    bool power_valid = false;
    uint8_t sweep_phase = 0;
    uint8_t trail_depth = 0;

    if(uhf_data_lock(app, 10)) {
        rate = app->tags_per_second;
        unique = app->tag_count;
        temperature = app->reader_temperature_c;
        power_dbm = app->reader_power_dbm;
        temperature_valid = app->temperature_valid;
        power_valid = app->power_valid;
        sweep_phase = app->radar_sweep_phase;
        trail_depth = app->radar_trail_depth;

        for(size_t i = 0; i < UHF_MAX_TAGS && target_count < UHF_MAX_TAGS; i++) {
            if(!app->tags[i].used) continue;

            /* Stable FNV-1a placement keeps each EPC at the same radar
               position while avoiding any artificial distance claim. */
            uint32_t hash = 2166136261U;
            for(const char* p = app->tags[i].epc; *p; p++) {
                hash ^= (uint8_t)*p;
                hash *= 16777619U;
            }

            /* Place targets across the upper semicircle (left horizon through
               top to right horizon), where they remain easiest to see. */
            const uint8_t upper_slot = (uint8_t)(hash % 13U);
            const uint8_t direction = (uint8_t)((18U + upper_slot) % 24U);
            const int32_t distance = 5 + (int32_t)((hash >> 8U) % 20U);
            const int32_t x = center_x + ((int32_t)sweep_x[direction] * distance) / 27;
            const int32_t y = center_y + ((int32_t)sweep_y[direction] * distance) / 27;
            target_x[target_count] = (uint8_t)x;
            target_y[target_count] = (uint8_t)y;
            target_count++;
        }
        uhf_data_unlock(app);
    }

    canvas_set_font(canvas, FontPrimary);
    const char* radar_title = "UHF Radar";
    const int32_t title_width = canvas_string_width(canvas, radar_title);
    canvas_draw_str(canvas, (65 - title_width) / 2, 8, radar_title);

    uhf_draw_radar_ring(canvas, center_x, center_y, sweep_x, sweep_y, 27);
    uhf_draw_radar_ring(canvas, center_x, center_y, sweep_x, sweep_y, 18);
    uhf_draw_radar_ring(canvas, center_x, center_y, sweep_x, sweep_y, 9);
    canvas_draw_dot(canvas, center_x, center_y);
    for(int32_t offset = -25; offset <= 25; offset += 5) {
        canvas_draw_dot(canvas, center_x + offset, center_y);
    }
    for(int32_t offset = -25; offset <= 25; offset += 5) {
        canvas_draw_dot(canvas, center_x, center_y + offset);
    }

    /* All trail segments keep their full length. Older segments use fewer
       pixels, creating a stable pseudo-gray fade on the 1-bit display. */
    for(uint8_t age = trail_depth; age > 0U; age--) {
        const uint8_t trail_phase =
            (uint8_t)((sweep_phase + UHF_RADAR_PHASE_COUNT - age) %
                      UHF_RADAR_PHASE_COUNT);
        for(int32_t step = 4; step <= 27; step++) {
            if(((step + age) % (age + 1U)) != 0U) continue;
            int32_t trail_x = 0;
            int32_t trail_y = 0;
            uhf_radar_vector(trail_phase, step, &trail_x, &trail_y);
            canvas_draw_dot(canvas, center_x + trail_x, center_y + trail_y);
        }
    }

    int32_t sweep_dx = 0;
    int32_t sweep_dy = 0;
    uhf_radar_vector(sweep_phase, 27, &sweep_dx, &sweep_dy);
    canvas_draw_line(canvas, center_x, center_y, center_x + sweep_dx, center_y + sweep_dy);

    /* Draw a parallel one-pixel offset to make the leading sweep two pixels
       thick at every angle. */
    const int32_t abs_dx = sweep_dx < 0 ? -sweep_dx : sweep_dx;
    const int32_t abs_dy = sweep_dy < 0 ? -sweep_dy : sweep_dy;
    const int32_t offset_x =
        (abs_dy > abs_dx) ? ((sweep_dy > 0) ? -1 : 1) : 0;
    const int32_t offset_y =
        (abs_dy > abs_dx) ? 0 : ((sweep_dx >= 0) ? 1 : -1);
    canvas_draw_line(
        canvas,
        center_x + offset_x,
        center_y + offset_y,
        center_x + sweep_dx + offset_x,
        center_y + sweep_dy + offset_y);

    /* Draw targets last so they remain solid above the sweep and trail. */
    for(size_t i = 0; i < target_count; i++) {
        canvas_draw_box(canvas, (int32_t)target_x[i] - 1, (int32_t)target_y[i] - 1, 3, 3);
    }

    canvas_draw_line(canvas, 65, 0, 65, 63);

    canvas_set_font(canvas, FontSecondary);
    char value[24];

    canvas_draw_str(canvas, 70, 10, "RATE");
    if(rate > 9999U) {
        snprintf(value, sizeof(value), "9999+");
    } else {
        snprintf(value, sizeof(value), "%lu/s", (unsigned long)rate);
    }
    uhf_draw_right_text(canvas, 10, value);

    canvas_draw_str(canvas, 70, 26, "TAGS");
    snprintf(value, sizeof(value), "%lu", (unsigned long)unique);
    uhf_draw_right_text(canvas, 26, value);

    canvas_draw_str(canvas, 70, 42, "TEMP");
    if(temperature_valid) {
        snprintf(value, sizeof(value), "%d", (int)temperature);
    } else {
        snprintf(value, sizeof(value), "--");
    }
    uhf_draw_right_temperature(canvas, 42, value);

    canvas_draw_str(canvas, 70, 58, "PWR");
    if(power_valid) {
        snprintf(value, sizeof(value), "%udBm", power_dbm);
    } else {
        snprintf(value, sizeof(value), "--");
    }
    uhf_draw_right_text(canvas, 58, value);
}

static void uhf_input_callback(InputEvent* event, void* context) {
    if(!context || !event) return;
    UhfApp* app = context;
    UhfEvent app_event = {.input = *event};
    if(app->event_queue) {
        furi_message_queue_put(app->event_queue, &app_event, 0);
    }
}

static void uhf_draw_tag_bank_cycle_button(Canvas* canvas, UhfTagBank current_bank) {
    const char* next_name = uhf_tag_bank_button_name(uhf_next_tag_bank(current_bank));
    const int32_t cycle_width = canvas_string_width(canvas, "Cycle");
    const int32_t label_width = canvas_string_width(canvas, next_name);
    const int32_t height = canvas_height(canvas);

    /* Keep the standard left button and its Cycle-sized background, then replace
       only the label inside it with the centered name of the next bank. */
    elements_button_left(canvas, "Cycle");
    canvas_set_color(canvas, ColorBlack);
    canvas_draw_box(canvas, 9, height - 11, cycle_width + 2U, 11);
    canvas_set_color(canvas, ColorWhite);
    canvas_draw_str(canvas, 10 + (cycle_width - label_width) / 2, height - 3, next_name);
    canvas_set_color(canvas, ColorBlack);
}

static bool uhf_select_first_seen_tag(UhfApp* app) {
    UhfTagEntry tag;
    if(!app || !uhf_copy_tag_at(app, 0U, &tag)) return false;
    if(app->inventory_running) {
        uhf_stop_inventory(app);
        furi_delay_ms(UHF_STOP_SETTLE_MS);
        uhf_process_rx(app);
    }
    strncpy(app->selected_epc, tag.epc, sizeof(app->selected_epc) - 1U);
    app->selected_epc[sizeof(app->selected_epc) - 1U] = '\0';
    strncpy(app->access_epc, tag.epc, sizeof(app->access_epc) - 1U);
    app->access_epc[sizeof(app->access_epc) - 1U] = '\0';
    return true;
}

static void uhf_make_fuzz_epc(UhfApp* app) {
    if(!app || !app->fuzz_base_epc[0]) return;
    strncpy(app->selected_epc, app->fuzz_base_epc, sizeof(app->selected_epc) - 1U);
    app->selected_epc[sizeof(app->selected_epc) - 1U] = '\0';
    const size_t len = strlen(app->selected_epc);
    const size_t digits = len < 8U ? len : 8U;
    uint32_t tail = 0U;
    for(size_t i = len - digits; i < len; i++) {
        const char c = app->selected_epc[i];
        tail = (tail << 4U) | (uint32_t)(c <= '9' ? c - '0' : 10 + c - 'A');
    }
    tail += app->fuzz_sequence;
    static const char hex[] = "0123456789ABCDEF";
    for(size_t i = 0; i < digits; i++) {
        app->selected_epc[len - 1U - i] = hex[(tail >> (i * 4U)) & 0x0FU];
    }
}

static void uhf_enter_feature(UhfApp* app, uint8_t feature) {
    if(!app) return;
    switch(feature) {
    case 0:
        app->page = UhfPageRadar;
        app->radar_trail_depth = 0U;
        app->radar_step_tick = furi_get_tick();
        uhf_start_inventory(app);
        break;
    case 1:
        app->page = UhfPageList;
        uhf_set_status(app, "OK Scan; Right Radar");
        break;
    case 2:
        uhf_clear_tags(app);
        app->selected_tid_valid = false;
        app->tid_decode_attempted = false;
        app->tag_data_scroll_line = 0U;
        app->page = UhfPageTidDecoder;
        uhf_start_inventory(app);
        uhf_set_status(app, "Present exactly one tag");
        break;
    case 3:
        uhf_clear_tags(app);
        app->access_epc[0] = '\0';
        app->fuzz_base_epc[0] = '\0';
        app->fuzz_sequence = 0U;
        app->page = UhfPageEpcFuzzing;
        uhf_start_inventory(app);
        uhf_set_status(app, "Read one source tag");
        break;
    case 4:
        uhf_clear_tags(app);
        app->ascii_tag_captured = false;
        app->ascii_single_since = 0U;
        app->ascii_source_epc[0] = '\0';
        app->ascii_text[0] = '\0';
        app->page = UhfPageAscii;
        uhf_start_inventory(app);
        uhf_set_status(app, "Present one tag");
        break;
    case 5:
        uhf_clear_tags(app);
        app->security_mode = true;
        app->security_single_since = 0U;
        app->page = UhfPageTagSecurity;
        uhf_start_inventory(app);
        uhf_set_status(app, "Present exactly one tag");
        break;
    case 6:
        app->page = UhfPageKeyVault;
        app->key_vault_selected_slot = app->active_key_slot;
        uhf_set_status(app, "Select key slot");
        break;
    case 7:
        app->page = UhfPageSettings;
        (void)uhf_query_reader_power(app, true);
        break;
    default:
        uhf_enter_about_page(app);
        break;
    }
}

static void uhf_enter_main_feature(UhfApp* app) {
    if(!app) return;
    uhf_enter_feature(app, app->main_menu_selected);
}

static void uhf_service_feature_page(UhfApp* app) {
    if(!app || !app->inventory_running) return;

    if((app->page == UhfPageTidDecoder && !app->selected_tid_valid) ||
       app->page == UhfPageTagSecurity ||
       (app->page == UhfPageAscii && !app->ascii_tag_captured)) {
        /* Inventory keeps a history of EPCs. Expire tags no longer in the RF
           field so removing all but one tag can continue without re-entering. */
        uhf_prune_stale_tags(app, 800U);
    }
    const size_t feature_tag_count = uhf_count_tags(app);
    if(app->page == UhfPageAscii && !app->ascii_tag_captured) {
        if(feature_tag_count != 1U) {
            app->ascii_single_since = 0U;
            return;
        }
        const uint32_t now = furi_get_tick();
        if(app->ascii_single_since == 0U) {
            app->ascii_single_since = now;
            return;
        }
        if((now - app->ascii_single_since) < UHF_SINGLE_TAG_STABLE_MS) return;
    } else if(app->page == UhfPageTagSecurity) {
        if(feature_tag_count != 1U) {
            app->security_single_since = 0U;
            return;
        }
        const uint32_t now = furi_get_tick();
        if(app->security_single_since == 0U) {
            app->security_single_since = now;
            return;
        }
        if((now - app->security_single_since) < UHF_SINGLE_TAG_STABLE_MS) return;
    } else if(feature_tag_count != 1U) {
        return;
    }

    if(app->page == UhfPageAscii && !app->ascii_tag_captured) {
        if(uhf_select_first_seen_tag(app)) {
            strncpy(
                app->ascii_source_epc,
                app->access_epc,
                sizeof(app->ascii_source_epc) - 1U);
            app->ascii_source_epc[sizeof(app->ascii_source_epc) - 1U] = '\0';
            if(!uhf_epc_hex_to_ascii(
                   app->ascii_source_epc, app->ascii_text, sizeof(app->ascii_text))) {
                app->ascii_text[0] = '\0';
            }
            app->ascii_tag_captured = true;
            uhf_set_status(
                app,
                app->ascii_text[0] ? "Tag captured; edit or write" :
                                    "Tag captured; press Edit");
        }
    } else if(app->page == UhfPageTagSecurity) {
        if(uhf_select_first_seen_tag(app)) {
            app->tag_bank = UhfTagBankEpc;
            app->tag_action_selected = 0U;
            app->tag_action_top = 0U;
            app->page = UhfPageTagActions;
            uhf_set_status(app, "Choose bank; hold OK");
        }
    } else if(app->page == UhfPageTidDecoder && !app->tid_decode_attempted) {
        app->tid_decode_attempted = true;
        if(uhf_select_first_seen_tag(app)) {
            app->tag_access_unfiltered = false;
            app->epc_filter_active = false;
            app->tag_data_scroll_line = 0U;
            (void)uhf_read_selected_tid(app);
        }
    } else if(app->page == UhfPageEpcFuzzing && !app->fuzz_base_epc[0]) {
        if(uhf_select_first_seen_tag(app)) {
            strncpy(app->fuzz_base_epc, app->access_epc, sizeof(app->fuzz_base_epc) - 1U);
            app->fuzz_base_epc[sizeof(app->fuzz_base_epc) - 1U] = '\0';
            app->fuzz_sequence = 0U;
            uhf_make_fuzz_epc(app);
            uhf_set_status(app, "Source EPC captured");
        }
    }
}

/* Three-pixel glyphs with one-pixel spacing fit full names in a 62px tile. */
static void uhf_draw_menu_label(Canvas* canvas, int x, int y, const char* text) {
    static const uint16_t glyphs[] = {
        0x5BEA, 0x3AEB, 0x624E, 0x3B6B, 0x72CF, 0x12CF, 0x6B4E, 0x5BED, 0x7497, 0x2B24, 0x5AED, 0x7249, 0x5BFD, 0x5B6B, 0x2B6A, 0x12EB, 0x4D6A, 0x5AEB, 0x388E, 0x2497, 0x7B6D, 0x2B6D, 0x5FED, 0x5AAD, 0x24AD, 0x72A7,
    };
    for(; *text; text++, x += 4) {
        const char c = (char)toupper((unsigned char)*text);
        static const uint16_t digits[] = {0x7b6f, 0x749a, 0x72a3, 0x38a3, 0x49ed, 0x38cf, 0x7bce, 0x24a7, 0x7bef, 0x39ef};
        uint16_t glyph;
        if(c >= 'A' && c <= 'Z') glyph = glyphs[c - 'A'];
        else if(c >= '0' && c <= '9') glyph = digits[c - '0'];
        else continue;
        for(unsigned row = 0; row < 5; row++) {
            for(unsigned col = 0; col < 3; col++) {
                if(glyph & (1U << (row * 3U + col))) canvas_draw_dot(canvas, x + col, y + row);
            }
        }
    }
}

static void uhf_draw_main_menu(Canvas* canvas, UhfApp* app) {
    canvas_set_font(canvas, FontPrimary);
    uhf_draw_centered_text(canvas, 10, "UHF Expansion");

    canvas_set_font(canvas, FontKeyboard);
    const size_t first = (size_t)app->main_menu_top_row * 2U;
    const size_t end = first + 6U < COUNT_OF(uhf_main_menu_items) ?
                           first + 6U : COUNT_OF(uhf_main_menu_items);
    for(size_t i = first; i < end; i++) {
        const size_t visible = i - first;
        const int x = (int)(visible % 2U) * 64;
        const int y = 13 + (int)(visible / 2U) * 17;
        const bool selected = i == app->main_menu_selected;
        if(selected) {
            canvas_draw_rbox(canvas, x + 1, y + 1, 62, 16, 3);
            canvas_set_color(canvas, ColorWhite);
        } else {
            canvas_draw_rframe(canvas, x + 1, y + 1, 62, 16, 3);
        }

        /* Compact, code-drawn icons keep the grid legible without extra assets. */
        const int ix = x + 4;
        const int iy = y + 5;
        static const uint8_t icons[9][7] = {
            {0x1c, 0x22, 0x51, 0x59, 0x45, 0x22, 0x1c},
            {0x7d, 0x0, 0x0, 0x7d, 0x0, 0x0, 0x7d},
            {0x2a, 0x7f, 0x22, 0x6b, 0x22, 0x7f, 0x2a},
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            {0x1c, 0x22, 0x49, 0x41, 0x49, 0x2a, 0x1c},
        };
        for(unsigned row = 0; row < 7U; row++) {
            for(unsigned col = 0; col < 7U; col++) {
                if(icons[i][row] & (1U << col)) {
                    canvas_draw_dot(canvas, ix + 1 + col, iy + 1 + row);
                }
            }
        }
        uhf_draw_menu_label(canvas, x + 16, y + 7, uhf_main_menu_items[i]);
        if(selected) canvas_set_color(canvas, ColorBlack);
    }
}

static const char* uhf_tid_vendor(uint16_t mdid) {
    switch(mdid) {
    case 0x001: return "Impinj";
    case 0x003: return "Alien";
    case 0x006: return "NXP";
    case 0x007: return "STMicro";
    case 0x00B: return "EM Micro";
    case 0x01B: return "Invengo";
    case 0x01D: return "Kiloway";
    default: return "Unknown";
    }
}

static const char* uhf_tid_model(uint16_t mdid, uint16_t tmn) {
    if(mdid == 0x001U) {
        switch(tmn) {
        case 0x100: return "Monza 4D";
        case 0x105: return "Monza 4QT";
        case 0x10C: return "Monza 4E";
        case 0x114: return "Monza 4i";
        case 0x160: return "Monza R6";
        case 0x170: return "Monza R6-P";
        case 0x171: return "Monza R6-A/B";
        default: break;
        }
    } else if(mdid == 0x003U) {
        if(tmn == 0x412U) return "Higgs-3";
        if(tmn == 0x414U) return "Higgs-4";
    } else if(mdid == 0x006U) {
        switch(tmn) {
        case 0x003: return "UCODE G2XM";
        case 0x004: return "UCODE G2XL";
        case 0x806: case 0x906: case 0xB06: return "UCODE G2iL";
        case 0x807: case 0x907: case 0xB07: return "UCODE G2iL+";
        case 0x80A: return "UCODE G2iM";
        case 0x80B: return "UCODE G2iM+";
        case 0x890: return "UCODE 7";
        case 0x915: case 0x995: return "UCODE 9";
        case 0xA16: case 0xA96: return "UCODE 9xe";
        default: break;
        }
    }
    return "Unknown";
}

static void uhf_draw_tid_decoder(Canvas* canvas, UhfApp* app) {
    uhf_draw_centered_text(canvas, 9, "TID Decoder");
    canvas_set_font(canvas, FontSecondary);
    if(!app->selected_tid_valid) {
        const size_t count = uhf_count_tags(app);
        uhf_draw_centered_text(canvas, 29,
            app->tid_decode_attempted ? "TID read failed" :
            (count > 1U ? "Too many tags" : "Reading tag..."));
        uhf_draw_centered_text(canvas, 42,
            app->tid_decode_attempted ? "OK to retry" : "Present one tag");
        return;
    }

    const char* tid = app->selected_tid;
    const size_t length = strlen(tid);
    uint8_t bytes[4] = {0};
    size_t byte_count = 0U;
    char prefix[9] = {0};
    if(length >= 8U) memcpy(prefix, tid, 8U);
    const bool decoded = length >= 8U && strncmp(tid, "E2", 2U) == 0 &&
        uhf_hex_to_bytes(prefix, bytes, sizeof(bytes), &byte_count) && byte_count == 4U;

    /* Chip silhouette and two compact identity fields share a single card. */
    canvas_draw_rframe(canvas, 0, 11, 128, 25, 3);
    canvas_draw_rbox(canvas, 7, 16, 17, 15, 2);
    for(int pin = 0; pin < 3; pin++) {
        canvas_draw_line(canvas, 4, 18 + pin * 5, 6, 18 + pin * 5);
        canvas_draw_line(canvas, 25, 18 + pin * 5, 27, 18 + pin * 5);
    }
    canvas_set_color(canvas, ColorWhite);
    canvas_draw_frame(canvas, 11, 19, 9, 9);
    canvas_set_color(canvas, ColorBlack);
    canvas_draw_line(canvas, 33, 14, 33, 33);
    char field[28];
    uint16_t mdid = 0U;
    uint16_t tmn = 0U;
    if(decoded) {
        mdid = (uint16_t)(((bytes[1] & 0x1FU) << 4U) | (bytes[2] >> 4U));
        tmn = (uint16_t)(((bytes[2] & 0x0FU) << 8U) | bytes[3]);
        snprintf(field, sizeof(field), "%s  %03X", uhf_tid_vendor(mdid), mdid);
    } else {
        snprintf(field, sizeof(field), "MDID  Unknown");
    }
    canvas_draw_str(canvas, 39, 21, field);
    if(decoded) {
        snprintf(field, sizeof(field), "%s  %03X", uhf_tid_model(mdid, tmn), tmn);
    } else {
        snprintf(field, sizeof(field), "Model Unknown");
    }
    canvas_draw_str(canvas, 39, 32, field);

    const size_t bytes_per_row = 8U;
    const size_t bytes_per_page = bytes_per_row * 2U;
    const size_t byte_length = length / 2U;
    const size_t pages = (byte_length + bytes_per_page - 1U) / bytes_per_page;
    const size_t page = pages && app->tag_data_scroll_line >= pages ?
        pages - 1U : app->tag_data_scroll_line;
    canvas_draw_rframe(canvas, 0, 40, 128, 24, 3);
    canvas_set_color(canvas, ColorWhite);
    canvas_draw_box(canvas, 6, 37, 19, 8);
    canvas_set_color(canvas, ColorBlack);
    canvas_draw_str(canvas, 9, 44, "TID");
    if(pages > 1U) {
        snprintf(field, sizeof(field), "%lu/%lu", (unsigned long)(page + 1U), (unsigned long)pages);
        uhf_draw_right_text(canvas, 44, field);
    }
    canvas_set_font(canvas, FontKeyboard);
    for(size_t row = 0; row < 2U; row++) {
        const size_t byte_offset = page * bytes_per_page + row * bytes_per_row;
        if(byte_offset >= byte_length) break;
        char part[24];
        uhf_format_hex_byte_groups(
            tid, length, byte_offset, bytes_per_row, part, sizeof(part));
        canvas_draw_str(canvas, 3, 53 + (int)row * 9, part);
    }
}

static void uhf_draw_epc_fuzzing(Canvas* canvas, UhfApp* app) {
    uhf_draw_centered_text(canvas, 9, "EPC Fuzzing");
    canvas_set_font(canvas, FontSecondary);
    if(!app->fuzz_base_epc[0]) {
        const size_t count = uhf_count_tags(app);
        uhf_draw_centered_text(
            canvas,
            30,
            count > 1U ? "Too many tags" : (count == 1U ? "Source found - press OK" : "Present source tag..."));
    } else {
        char line[24];
        snprintf(line, sizeof(line), "#: %lu", (unsigned long)app->fuzz_sequence);
        canvas_draw_str(canvas, 2, 20, line);
        const size_t length = strlen(app->selected_epc);
        const size_t byte_length = length / 2U;
        if(byte_length <= 24U) {
            canvas_set_font(canvas, FontKeyboard);
            for(size_t row = 0U; row < 3U; row++) {
                const size_t byte_offset = row * 8U;
                if(byte_offset >= byte_length) break;
                char part[24];
                uhf_format_hex_byte_groups(
                    app->selected_epc, length, byte_offset, 8U, part, sizeof(part));
                canvas_draw_str(canvas, 2, 30 + (int)row * 9, part);
            }
        } else {
            /* The compact glyphs are also fixed-width and keep a full 48-byte
               EPC visible while preserving byte grouping. */
            for(size_t row = 0U; row < 5U; row++) {
                const size_t byte_offset = row * 10U;
                if(byte_offset >= byte_length) break;
                char part[30];
                uhf_format_hex_byte_groups(
                    app->selected_epc, length, byte_offset, 10U, part, sizeof(part));
                uhf_draw_menu_label(canvas, 2, 23 + (int)row * 7, part);
            }
        }
        canvas_set_font(canvas, FontSecondary);
    }
    if(app->fuzz_base_epc[0]) {
        uhf_draw_fixed_side_button(canvas, "Clear", false);
        uhf_draw_fixed_center_button(canvas, "Edit");
        uhf_draw_fixed_side_button(canvas, "Write", true);
    } else {
        uhf_draw_fixed_center_button(canvas, "Read");
    }
}

static void uhf_draw_ascii(Canvas* canvas, UhfApp* app) {
    uhf_draw_centered_text(canvas, 9, "EPC ASCII");
    canvas_set_font(canvas, FontSecondary);

    if(!app->ascii_tag_captured) {
        const size_t count = uhf_count_tags(app);
        uhf_draw_centered_text(
            canvas,
            29,
            count > 1U ? "Too many tags" :
            (count == 1U ? "Tag found..." : "Present one tag"));
        uhf_draw_centered_text(canvas, 42, "Then edit ASCII");
        uhf_draw_fixed_center_button(canvas, app->inventory_running ? "Stop" : "Scan");
        return;
    }

    canvas_draw_rframe(canvas, 0, 14, 128, 35, 3);
    char compact[40];
    uhf_format_list_epc_compact(
        canvas, app->ascii_source_epc, 120, compact, sizeof(compact));
    canvas_set_font(canvas, FontKeyboard);
    canvas_draw_str(canvas, 4, 23, compact);

    canvas_set_font(canvas, FontSecondary);
    char length[32];
    snprintf(length, sizeof(length), "ASCII %lu/%u",
             (unsigned long)strlen(app->ascii_text), (unsigned)UHF_ASCII_EPC_BYTES);
    canvas_draw_str(canvas, 4, 36, length);
    canvas_draw_str(canvas, 4, 47, app->ascii_text[0] ? app->ascii_text : "<empty>");

    uhf_draw_fixed_side_button(canvas, "Clear", false);
    uhf_draw_fixed_center_button(canvas, "Edit");
    uhf_draw_fixed_side_button(canvas, "Write", true);
}

static void uhf_draw_settings(Canvas* canvas, UhfApp* app) {
    uhf_draw_centered_text(canvas, 9, "Settings");
    canvas_set_font(canvas, FontSecondary);
    static const char* const labels[] = {"Sound", "RF Power", "Startup App", "EPC Display"};
    char values[4][20];
    snprintf(values[0], sizeof(values[0]), "< %s >", app->tag_beep_enabled ? "ON" : "OFF");
    snprintf(values[1], sizeof(values[1]), "< %u dBm >", app->reader_power_dbm);
    snprintf(values[2], sizeof(values[2]), "< %s >", uhf_startup_names[app->startup_app]);
    snprintf(values[3], sizeof(values[3]), "< %s >",
             app->epc_display == UhfEpcDisplayAscii ? "ASCII" : "HEX");
    const size_t total_rows = COUNT_OF(labels);
    const size_t visible_rows = 3U;
    const size_t top = app->settings_selected >= visible_rows ?
                           app->settings_selected - visible_rows + 1U :
                           0U;
    for(size_t row = 0U; row < visible_rows; row++) {
        const size_t item = top + row;
        const int y = 12 + (int)row * 13;
        if(item == app->settings_selected) {
            canvas_draw_box(canvas, 0, y, 123, 13);
            canvas_set_color(canvas, ColorWhite);
        }
        canvas_draw_str(canvas, 3, y + 9, labels[item]);
        canvas_draw_str(
            canvas,
            120 - canvas_string_width(canvas, values[item]),
            y + 9,
            values[item]);
        if(item == app->settings_selected) canvas_set_color(canvas, ColorBlack);
    }
    elements_scrollbar_pos(canvas, 125, 12, 39, app->settings_selected, total_rows);
    uhf_draw_fixed_center_button(canvas, "Save");
}

static void uhf_draw_tag_security(Canvas* canvas, UhfApp* app) {
    uhf_draw_centered_text(canvas, 9, "Tag Control");
    canvas_set_font(canvas, FontSecondary);
    const size_t count = uhf_count_tags(app);
    uhf_draw_centered_text(
        canvas,
        32,
        count > 1U ? "Too many tags" :
        (count == 1U ? "Tag found..." : "Present one tag"));
    uhf_draw_fixed_center_button(canvas, app->inventory_running ? "Stop" : "Scan");
}

static void uhf_draw_key_vault(Canvas* canvas, UhfApp* app) {
    uhf_draw_centered_text(canvas, 9, "Access Keys");
    canvas_set_font(canvas, FontSecondary);
    for(uint8_t slot = 0U; slot < UHF_KEY_SLOT_COUNT; slot++) {
        const int y = 21 + (int)slot * 10;
        const uint8_t* key = app->access_keys[slot];
        const bool set = key[0] || key[1] || key[2] || key[3];
        if(slot == app->key_vault_selected_slot) {
            canvas_draw_box(canvas, 7, y - 8, 114, 10);
            canvas_set_color(canvas, ColorWhite);
        }
        canvas_draw_circle(canvas, 13, y - 3, 3);
        if(slot == app->active_key_slot) canvas_draw_disc(canvas, 13, y - 3, 1);
        char line[24];
        snprintf(line, sizeof(line), "Slot %u  %s", slot + 1U, set ? "********" : "00000000");
        canvas_draw_str(canvas, 21, y, line);
        if(slot == app->key_vault_selected_slot) canvas_set_color(canvas, ColorBlack);
    }
    uhf_draw_fixed_center_button(canvas, "Use");
    uhf_draw_fixed_side_button(canvas, "Edit", true);
}

static void uhf_draw_callback(Canvas* canvas, void* context) {
    if(!context) return;
    UhfApp* app = context;

    char status[64] = "";
    char version[24] = "";
    size_t tag_count = app->tag_count;
    UhfPage page = app->page;
    size_t list_top = app->list_top_index;

    if(app->save_popup_active) {
        canvas_clear(canvas);
        canvas_draw_rframe(canvas, 3, 14, 122, 36, 5);
        canvas_set_font(canvas, FontSecondary);
        uhf_draw_centered_text(canvas, 35, app->status);
        return;
    }

    strncpy(status, app->status, sizeof(status) - 1);
    status[sizeof(status) - 1] = '\0';
    strncpy(version, app->version, sizeof(version) - 1);
    version[sizeof(version) - 1] = '\0';

    canvas_clear(canvas);
    canvas_set_font(canvas, FontPrimary);

    if(page == UhfPageMainMenu) {
        /* Header is drawn together with the five feature rows below. */
    } else if(page == UhfPageAbout) {
        uhf_draw_centered_text(canvas, 11, "About UHF Expansion");
    } else if(page == UhfPageTagActions) {
        char title[32];
        snprintf(
            title,
            sizeof(title),
            "Tag Operation #%lu",
            (unsigned long)(app->list_selected_index + 1U));
        uhf_draw_centered_text(canvas, 8, title);
    } else if(page == UhfPageTagActionMenu) {
        char title[24];
        snprintf(title, sizeof(title), "%s Actions", uhf_tag_bank_button_name(app->tag_bank));
        uhf_draw_centered_text(canvas, 9, title);
    } else if(page == UhfPageAccessKeyMenu) {
        uhf_draw_centered_text(canvas, 9, "Access Key");
    } else if(page != UhfPageRadar && page != UhfPageList &&
              page != UhfPageTidDecoder && page != UhfPageEpcFuzzing &&
              page != UhfPageAscii &&
              page != UhfPageSettings && page != UhfPageTagSecurity &&
              page != UhfPageKeyVault && page != UhfPageAccessKeyMenu) {
        uhf_draw_centered_text(canvas, 11, "UHF Expansion");
    }

    if(app->startup_active) {
        char dots[5] = "";
        const uint8_t count = app->startup_dots > 3U ? 3U : app->startup_dots;
        for(uint8_t i = 0; i < count; i++) dots[i] = '.';
        dots[count] = '\0';

        char line[40];
        snprintf(line, sizeof(line), "%s%s", app->startup_text, dots);

        canvas_set_font(canvas, FontPrimary);
        uhf_draw_centered_text(canvas, 32, line);
        canvas_set_font(canvas, FontSecondary);
        if(app->startup_subtext[0]) {
            uhf_draw_centered_text(canvas, 48, app->startup_subtext);
        }
        return;
    }

    if(page == UhfPageMainMenu) {
        uhf_draw_main_menu(canvas, app);
    } else if(page == UhfPageTidDecoder) {
        uhf_draw_tid_decoder(canvas, app);
    } else if(page == UhfPageEpcFuzzing) {
        uhf_draw_epc_fuzzing(canvas, app);
    } else if(page == UhfPageAscii) {
        uhf_draw_ascii(canvas, app);
    } else if(page == UhfPageTagSecurity) {
        uhf_draw_tag_security(canvas, app);
    } else if(page == UhfPageKeyVault) {
        uhf_draw_key_vault(canvas, app);
    } else if(page == UhfPageSettings) {
        uhf_draw_settings(canvas, app);
    } else if(page == UhfPageAbout) {

        canvas_set_font(canvas, FontSecondary);
        const size_t total_lines = COUNT_OF(uhf_about_lines);
        size_t top = app->about_top_line;
        if(total_lines <= UHF_ABOUT_VISIBLE_LINES) {
            top = 0;
        } else {
            const size_t max_top = total_lines - UHF_ABOUT_VISIBLE_LINES;
            if(top > max_top) top = max_top;
        }

        int y = 22;
        for(size_t i = 0; i < UHF_ABOUT_VISIBLE_LINES; i++) {
            const size_t line_idx = top + i;
            if(line_idx >= total_lines) break;
            canvas_draw_str(canvas, 0, y, uhf_about_lines[line_idx]);
            y += 10;
        }
    } else if(page == UhfPageTagActions) {
        canvas_set_font(canvas, FontSecondary);
        const char* value = app->selected_epc;
        bool valid = true;
        if(app->tag_bank == UhfTagBankTid) {
            value = app->selected_tid;
            valid = app->selected_tid_valid;
        } else if(app->tag_bank == UhfTagBankUser) {
            value = app->selected_user;
            valid = app->selected_user_valid;
        }

        const char* bank_name = uhf_tag_bank_name(app->tag_bank);
        const int bank_name_width = canvas_string_width(canvas, bank_name);
        canvas_draw_rframe(canvas, 0, 14, 128, 37, 3);
        canvas_set_color(canvas, ColorWhite);
        canvas_draw_box(canvas, 5, 11, (size_t)bank_name_width + 6U, 8);
        canvas_set_color(canvas, ColorBlack);
        canvas_draw_str(canvas, 8, 18, bank_name);

        if(valid && value[0]) {
            char length[12];
            snprintf(length, sizeof(length), "%luB", (unsigned long)(strlen(value) / 2U));
            const int length_width = canvas_string_width(canvas, length);
            const int length_x = 120 - length_width;
            canvas_set_color(canvas, ColorWhite);
            canvas_draw_box(canvas, length_x - 3, 11, (size_t)length_width + 6U, 8);
            canvas_set_color(canvas, ColorBlack);
            canvas_draw_str(canvas, length_x, 18, length);

            const size_t chars_per_line = UHF_TAG_DATA_HEX_PER_LINE;
            const size_t first = app->tag_data_scroll_line * chars_per_line;
            const size_t total_lines =
                (strlen(value) + chars_per_line - 1U) / chars_per_line;
            canvas_set_font(canvas, FontKeyboard);
            for(size_t row = 0U; row < UHF_TAG_DATA_VISIBLE_LINES; row++) {
                const size_t offset = first + row * chars_per_line;
                if(offset >= strlen(value)) break;
                char data_line[21];
                const size_t remaining = strlen(value) - offset;
                const size_t line_chars =
                    remaining < chars_per_line ? remaining : chars_per_line;
                uhf_format_hex_bytes_spaced(
                    value + offset, line_chars, data_line, sizeof(data_line));
                canvas_draw_str(canvas, 6, 28 + (int)row * 9, data_line);
            }
            canvas_set_font(canvas, FontSecondary);
            if(total_lines > UHF_TAG_DATA_VISIBLE_LINES) {
                elements_scrollbar_pos(
                    canvas,
                    123,
                    21,
                    27,
                    app->tag_data_scroll_line,
                    total_lines - UHF_TAG_DATA_VISIBLE_LINES + 1U);
            }
        } else {
            char compact[40];
            uhf_format_list_epc_compact(canvas, status, 118, compact, sizeof(compact));
            uhf_draw_centered_text(canvas, 37, compact);
        }

        uhf_draw_tag_bank_cycle_button(canvas, app->tag_bank);
        elements_button_center(canvas, app->security_mode ? "Actions" : "Edit");
        if(!app->security_mode || app->tag_bank != UhfTagBankTid) {
            elements_button_right(canvas, app->security_mode ? "Erase" : "Write");
        }
    } else if(page == UhfPageTagActionMenu) {
        canvas_set_font(canvas, FontSecondary);
        const char* actions[] = {"Access key...", "Lock bank", "Unlock bank"};
        const size_t visible_rows = 3U;
        size_t top = app->tag_action_top;
        if(top + visible_rows > COUNT_OF(actions)) top = COUNT_OF(actions) - visible_rows;
        for(size_t row = 0U; row < visible_rows; row++) {
            const size_t item = top + row;
            const int y = 24 + (int)row * 11;
            if(item == app->tag_action_selected) {
                canvas_draw_rbox(canvas, 7, y - 8, 114, 10, 2);
                canvas_set_color(canvas, ColorWhite);
            }
            canvas_draw_str(canvas, 13, y, actions[item]);
            if(item == app->tag_action_selected) canvas_set_color(canvas, ColorBlack);
        }
        if(top > 0U) {
            canvas_draw_triangle(canvas, 124, 14, 2, 2, CanvasDirectionBottomToTop);
        }
        if(top + visible_rows < COUNT_OF(actions)) {
            canvas_draw_triangle(canvas, 124, 47, 2, 2, CanvasDirectionTopToBottom);
        }
        elements_button_center(canvas, "Select");
    } else if(page == UhfPageAccessKeyMenu) {
        canvas_set_font(canvas, FontSecondary);
        const char* actions[] = {"Set from 00000000", "Reset to 00000000"};
        for(size_t row = 0U; row < COUNT_OF(actions); row++) {
            const int y = 27 + (int)row * 14;
            if(row == app->access_key_action_selected) {
                canvas_draw_rbox(canvas, 7, y - 9, 114, 12, 2);
                canvas_set_color(canvas, ColorWhite);
            }
            canvas_draw_str(canvas, 13, y, actions[row]);
            if(row == app->access_key_action_selected) canvas_set_color(canvas, ColorBlack);
        }
        elements_button_center(
            canvas, app->access_key_action_selected == 1U ? "Hold" : "Select");
    } else if(page == UhfPageList) {
        UhfTagPreview previews[UHF_LIST_VISIBLE_ROWS];
        size_t total = 0;

        if(tag_count <= UHF_LIST_VISIBLE_ROWS) {
            list_top = 0;
        } else if(list_top + UHF_LIST_VISIBLE_ROWS > tag_count) {
            list_top = tag_count - UHF_LIST_VISIBLE_ROWS;
        }

        const size_t visible_count =
            uhf_collect_tag_previews(app, list_top, previews, COUNT_OF(previews), &total);

        if(total <= UHF_LIST_VISIBLE_ROWS) {
            list_top = 0;
        } else if(list_top + UHF_LIST_VISIBLE_ROWS > total) {
            list_top = total - UHF_LIST_VISIBLE_ROWS;
        }

        canvas_set_font(canvas, FontPrimary);
        char list_title[32];
        if(app->list_selection_manual) {
            strncpy(list_title, "Tag Selection", sizeof(list_title) - 1U);
            list_title[sizeof(list_title) - 1U] = '\0';
        } else {
            strncpy(list_title, "UHF Expansion", sizeof(list_title) - 1U);
            list_title[sizeof(list_title) - 1U] = '\0';
        }
        canvas_draw_str(canvas, 0, 10, list_title);

        if(app->list_selection_manual) {
            uhf_draw_right_fraction(canvas, 10, app->list_selected_index + 1U, total);
        } else {
            char count_text[16];
            snprintf(count_text, sizeof(count_text), "%lu", (unsigned long)total);
            uhf_draw_right_text(canvas, 10, count_text);
        }

        canvas_set_font(canvas, FontSecondary);
        if(total == 0) {
            uhf_draw_centered_text(canvas, 36, "No tags yet");
        } else {
            int y = 22;
            for(size_t row = 0; row < visible_count; row++) {
                const size_t idx = list_top + row;
                if(idx >= total) break;

                if(app->list_selection_manual && idx == app->list_selected_index) {
                    canvas_draw_box(canvas, 0, y - 8, 128, 9);
                    canvas_set_color(canvas, ColorWhite);
                }
                const bool show_ascii =
                    app->epc_display == UhfEpcDisplayAscii &&
                    uhf_epc_hex_to_ascii(
                        previews[row].epc,
                        app->list_ascii_epc,
                        sizeof(app->list_ascii_epc));
                if(show_ascii) {
                    uhf_format_list_epc_compact(
                        canvas,
                        app->list_ascii_epc,
                        126,
                        app->list_ascii_compact,
                        sizeof(app->list_ascii_compact));
                    canvas_draw_str(canvas, 1, y, app->list_ascii_compact);
                } else {
                    uhf_draw_list_epc_distributed(canvas, previews[row].epc, y);
                }
                if(app->list_selection_manual && idx == app->list_selected_index) {
                    canvas_set_color(canvas, ColorBlack);
                }
                y += 9;
            }
        }

        uhf_draw_fixed_side_button(canvas, "Clear", false);
        if(app->list_selection_manual) {
            elements_button_center(canvas, "Open");
        } else {
            elements_button_center(canvas, app->inventory_running ? "Pause" : "Scan");
        }
        uhf_draw_fixed_side_button(canvas, "Radar", true);
    } else if(page == UhfPageRadar) {
        uhf_draw_radar_page(canvas, app);
    } else {
        canvas_set_font(canvas, FontBigNumbers);
        char line[32];
        snprintf(line, sizeof(line), "%lu", (unsigned long)tag_count);
        uhf_draw_centered_text(canvas, 40, line);

        canvas_set_font(canvas, FontSecondary);
        const char* found_label = (tag_count == 1U) ? "Tag Found" : "Tags Found";
        uhf_draw_centered_text(canvas, 52, found_label);
        uhf_draw_scan_hint(canvas, app->inventory_running);
    }

    if(app->exit_confirm_active && page == UhfPageMainMenu) {
        canvas_set_color(canvas, ColorWhite);
        canvas_draw_rbox(canvas, 13, 21, 102, 22, 4);
        canvas_set_color(canvas, ColorBlack);
        canvas_draw_rframe(canvas, 13, 21, 102, 22, 4);
        canvas_set_font(canvas, FontSecondary);
        uhf_draw_centered_text(canvas, 35, "Back again to exit");
        canvas_set_color(canvas, ColorBlack);
    }
}

static void uhf_on_rx_irq(
    FuriHalSerialHandle* handle,
    FuriHalSerialRxEvent event,
    void* context) {
    UhfApp* app = context;
    if(!app || !app->rx_stream) return;

    if(event & FuriHalSerialRxEventData) {
        while(furi_hal_serial_async_rx_available(handle)) {
            const uint8_t b = furi_hal_serial_async_rx(handle);
            furi_stream_buffer_send(app->rx_stream, &b, 1, 0);
        }
    }
}

static bool uhf_open_serial(UhfApp* app, FuriHalSerialId serial_id) {
    /* The firmware's Expansion service normally owns its configured UART.
       A module that is present before this app starts can therefore make the
       acquire below fail unless the service explicitly yields the port. */
    if(app->expansion) {
        expansion_disable(app->expansion);
    }

    FuriHalSerialHandle* serial = furi_hal_serial_control_acquire(serial_id);
    if(!serial) {
        if(app->expansion) {
            expansion_enable(app->expansion);
        }
        return false;
    }

    furi_hal_serial_init(serial, app->baud_rate);
    furi_hal_serial_configure_framing(
        serial,
        FuriHalSerialDataBits8,
        FuriHalSerialParityNone,
        FuriHalSerialStopBits1);
    furi_hal_serial_enable_direction(serial, FuriHalSerialDirectionTx);
    furi_hal_serial_enable_direction(serial, FuriHalSerialDirectionRx);

    const GpioPin* tx_pin = furi_hal_serial_get_gpio_pin(serial, FuriHalSerialDirectionTx);
    const GpioPin* rx_pin = furi_hal_serial_get_gpio_pin(serial, FuriHalSerialDirectionRx);

    app->tx_ext_pin = tx_pin ? furi_hal_resources_get_ext_pin_number(tx_pin) : -1;
    app->rx_ext_pin = rx_pin ? furi_hal_resources_get_ext_pin_number(rx_pin) : -1;
    app->serial = serial;
    app->serial_id = serial_id;

    furi_hal_serial_async_rx_start(serial, uhf_on_rx_irq, app, true);
    return true;
}

static bool uhf_open_bridge_uart(UhfApp* app) {
    /* C0/pin 16 is reserved for the reader's hardware reset on revision 2,
       so LPUART must never be opened as a fallback. */
    if(uhf_open_serial(app, FuriHalSerialIdUsart)) {
        if((app->tx_ext_pin == UHF_BRIDGE_TX_EXT_PIN) &&
           (app->rx_ext_pin == UHF_BRIDGE_RX_EXT_PIN)) {
            return true;
        }
        uhf_close_serial(app);
    }

    /* Never report success on an unrelated UART. Doing so made the startup
       recovery frames go to the wrong GPIOs when the target port was busy. */
    app->tx_ext_pin = -1;
    app->rx_ext_pin = -1;
    return false;
}

static void uhf_close_serial(UhfApp* app) {
    if(!app->serial) return;

    furi_hal_serial_async_rx_stop(app->serial);
    furi_hal_serial_disable_direction(app->serial, FuriHalSerialDirectionTx);
    furi_hal_serial_disable_direction(app->serial, FuriHalSerialDirectionRx);
    furi_hal_serial_deinit(app->serial);
    furi_hal_serial_control_release(app->serial);
    app->serial = NULL;

    uhf_release_reset_pin();

    if(app->expansion) {
        expansion_enable(app->expansion);
    }
}

static void uhf_toggle_serial_port(UhfApp* app) {
    if(!uhf_ensure_hardware(app)) return;

    // Keep LEFT-long as a deterministic recovery action: always re-apply fixed direct wiring.
    uhf_force_direct_a6_a4(app);
    uhf_set_status(app, "UART reset 115200");
}

static void uhf_load_settings(UhfApp* app) {
    if(!app) return;
    app->tag_beep_enabled = true;
    app->reader_power_dbm = UHF_DEFAULT_POWER_DBM;
    app->startup_app = UhfStartupDefault;
    app->epc_display = UhfEpcDisplayHex;

    Storage* storage = furi_record_open(RECORD_STORAGE);
    if(!storage) return;
    File* file = storage_file_alloc(storage);
    UhfSettingsData data = {0};
    if(file && storage_file_open(file, UHF_SETTINGS_PATH, FSAM_READ, FSOM_OPEN_EXISTING) &&
       storage_file_read(file, &data, sizeof(data)) == sizeof(data) &&
       data.magic == UHF_SETTINGS_MAGIC) {
        app->tag_beep_enabled = data.sound_enabled != 0U;
        if(data.rf_power_dbm <= 20U) app->reader_power_dbm = data.rf_power_dbm;
        if(data.startup_app < UhfStartupCount) app->startup_app = (UhfStartupApp)data.startup_app;
        if(data.epc_display < UhfEpcDisplayCount) {
            app->epc_display = (UhfEpcDisplay)data.epc_display;
        }
    }
    if(file) {
        storage_file_close(file);
        storage_file_free(file);
    }
    furi_record_close(RECORD_STORAGE);
}

static bool uhf_save_settings(const UhfApp* app) {
    if(!app) return false;
    Storage* storage = furi_record_open(RECORD_STORAGE);
    if(!storage) return false;
    if(!storage_dir_exists(storage, UHF_APP_DATA_DIR)) {
        const FS_Error result = storage_common_mkdir(storage, UHF_APP_DATA_DIR);
        if(result != FSE_OK && result != FSE_EXIST) {
            furi_record_close(RECORD_STORAGE);
            return false;
        }
    }
    bool saved = false;
    File* file = storage_file_alloc(storage);
    if(file && storage_file_open(file, UHF_SETTINGS_PATH, FSAM_WRITE, FSOM_CREATE_ALWAYS)) {
        const UhfSettingsData data = {
            .magic = UHF_SETTINGS_MAGIC,
            .sound_enabled = app->tag_beep_enabled ? 1U : 0U,
            .rf_power_dbm = app->reader_power_dbm,
            .startup_app = (uint8_t)app->startup_app,
            .epc_display = (uint8_t)app->epc_display,
        };
        saved = storage_file_write(file, &data, sizeof(data)) == sizeof(data);
        saved = storage_file_sync(file) && saved;
    }
    if(file) {
        storage_file_close(file);
        storage_file_free(file);
    }
    furi_record_close(RECORD_STORAGE);
    return saved;
}

static void uhf_load_key_vault(UhfApp* app) {
    if(!app) return;
    app->active_key_slot = 0U;
    memset(app->access_keys, 0, sizeof(app->access_keys));
    Storage* storage = furi_record_open(RECORD_STORAGE);
    if(!storage) return;
    File* file = storage_file_alloc(storage);
    UhfKeyVaultData data = {0};
    if(file && storage_file_open(file, UHF_KEY_VAULT_PATH, FSAM_READ, FSOM_OPEN_EXISTING) &&
       storage_file_read(file, &data, sizeof(data)) == sizeof(data) &&
       data.magic == UHF_KEY_VAULT_MAGIC) {
        memcpy(app->access_keys, data.access_keys, sizeof(app->access_keys));
        if(data.active_slot < UHF_KEY_SLOT_COUNT) app->active_key_slot = data.active_slot;
    }
    if(file) {
        storage_file_close(file);
        storage_file_free(file);
    }
    furi_record_close(RECORD_STORAGE);
}

static bool uhf_save_key_vault(const UhfApp* app) {
    if(!app) return false;
    Storage* storage = furi_record_open(RECORD_STORAGE);
    if(!storage) return false;
    if(!storage_dir_exists(storage, UHF_APP_DATA_DIR)) {
        const FS_Error result = storage_common_mkdir(storage, UHF_APP_DATA_DIR);
        if(result != FSE_OK && result != FSE_EXIST) {
            furi_record_close(RECORD_STORAGE);
            return false;
        }
    }
    const UhfKeyVaultData data = {
        .magic = UHF_KEY_VAULT_MAGIC,
        .active_slot = app->active_key_slot,
        .reserved = {0},
        .access_keys = {{0}},
    };
    UhfKeyVaultData writable = data;
    memcpy(writable.access_keys, app->access_keys, sizeof(app->access_keys));
    bool saved = false;
    File* file = storage_file_alloc(storage);
    if(file && storage_file_open(file, UHF_KEY_VAULT_PATH, FSAM_WRITE, FSOM_CREATE_ALWAYS)) {
        saved = storage_file_write(file, &writable, sizeof(writable)) == sizeof(writable);
        saved = storage_file_sync(file) && saved;
    }
    if(file) {
        storage_file_close(file);
        storage_file_free(file);
    }
    furi_record_close(RECORD_STORAGE);
    return saved;
}

static void uhf_save_last_page(const UhfApp* app) {
    if(!app) return;

    UhfPage page = app->page;
    if(page == UhfPageAbout) page = app->about_return_page;
    if(page == UhfPageMainMenu || page > UhfPageRadar) page = UhfPageList;

    Storage* storage = furi_record_open(RECORD_STORAGE);
    if(!storage) return;

    if(!storage_dir_exists(storage, UHF_APP_DATA_DIR)) {
        const FS_Error mkdir_result = storage_common_mkdir(storage, UHF_APP_DATA_DIR);
        if(mkdir_result != FSE_OK && mkdir_result != FSE_EXIST) {
            furi_record_close(RECORD_STORAGE);
            return;
        }
    }

    File* file = storage_file_alloc(storage);
    if(file) {
        const uint8_t stored_page = (uint8_t)page;
        if(storage_file_open(file, UHF_VIEW_STATE_PATH, FSAM_WRITE, FSOM_CREATE_ALWAYS)) {
            (void)storage_file_write(file, &stored_page, sizeof(stored_page));
            storage_file_sync(file);
        }
        storage_file_close(file);
        storage_file_free(file);
    }

    furi_record_close(RECORD_STORAGE);
}

static void uhf_toggle_page(UhfApp* app) {
    if(!app) return;

    if(app->page == UhfPageList) {
        app->page = UhfPageRadar;
        app->radar_trail_depth = 0U;
        app->radar_step_tick = furi_get_tick();
        uhf_set_status(app, "Radar page");
    } else {
        const size_t total = uhf_count_tags(app);
        app->page = UhfPageList;
        app->list_selection_manual = false;

        if(total > 0U) {
            app->list_selected_index = total - 1U;
        } else {
            app->list_selected_index = 0U;
        }

        if(total > UHF_LIST_VISIBLE_ROWS) {
            app->list_top_index = total - UHF_LIST_VISIBLE_ROWS;
        } else {
            app->list_top_index = 0;
        }
        uhf_set_status(app, "List page");
    }
}

static bool uhf_enter_selected_tag(UhfApp* app) {
    if(!app || app->page != UhfPageList) return false;
    if(!app->list_selection_manual) return false;

    UhfTagEntry tag;
    if(!uhf_copy_tag_at(app, app->list_selected_index, &tag)) {
        uhf_set_status(app, "No selected tag");
        return false;
    }
    if(app->inventory_running) {
        uhf_stop_inventory(app);
        furi_delay_ms(UHF_STOP_SETTLE_MS);
        uhf_process_rx(app);
    }

    strncpy(app->selected_epc, tag.epc, sizeof(app->selected_epc) - 1U);
    app->selected_epc[sizeof(app->selected_epc) - 1U] = '\0';
    strncpy(app->access_epc, tag.epc, sizeof(app->access_epc) - 1U);
    app->access_epc[sizeof(app->access_epc) - 1U] = '\0';
    app->selected_tid[0] = '\0';
    app->selected_user[0] = '\0';
    app->pending_tid[0] = '\0';
    app->selected_tid_valid = false;
    app->selected_user_valid = false;
    app->tag_access_unfiltered = false;
    app->security_mode = false;
    app->epc_filter_active = false;
    app->tag_bank = UhfTagBankEpc;
    app->tag_data_scroll_line = 0U;
    app->page = UhfPageTagActions;
    uhf_set_status(app, "Inventory paused");
    return true;
}

static void uhf_leave_tag_actions(UhfApp* app) {
    if(!app) return;
    uhf_clear_selected_epc_filter(app);
    app->page = app->security_mode ? UhfPageMainMenu : UhfPageList;
    app->security_mode = false;
    app->list_selection_manual = false;
    uhf_set_status(app, "OK Scan; arrows select");
}

static const char* uhf_current_tag_bank_value(UhfApp* app, bool* valid) {
    if(app->tag_bank == UhfTagBankTid) {
        *valid = app->selected_tid_valid;
        return app->selected_tid;
    }
    if(app->tag_bank == UhfTagBankUser) {
        *valid = app->selected_user_valid;
        return app->selected_user;
    }
    *valid = true;
    return app->selected_epc;
}

static void uhf_switch_tag_bank(UhfApp* app, bool right) {
    if(right) {
        app->tag_bank =
            app->tag_bank == UhfTagBankUser ? UhfTagBankTid : (UhfTagBank)(app->tag_bank + 1U);
    } else {
        app->tag_bank = uhf_next_tag_bank(app->tag_bank);
    }
    app->tag_data_scroll_line = 0U;

    if(app->tag_bank == UhfTagBankTid && !app->selected_tid_valid) {
        (void)uhf_read_selected_tid(app);
    } else if(app->tag_bank == UhfTagBankUser && !app->selected_user_valid) {
        (void)uhf_read_selected_user(app);
    } else {
        uhf_set_status(app, "%s", uhf_tag_bank_name(app->tag_bank));
    }
}

static void uhf_scroll_tag_bank(UhfApp* app, bool down) {
    bool valid = false;
    const char* value = uhf_current_tag_bank_value(app, &valid);
    if(!valid || !value[0]) return;

    const size_t total_lines =
        (strlen(value) + UHF_TAG_DATA_HEX_PER_LINE - 1U) / UHF_TAG_DATA_HEX_PER_LINE;
    const size_t max_top = total_lines > UHF_TAG_DATA_VISIBLE_LINES ?
                               total_lines - UHF_TAG_DATA_VISIBLE_LINES :
                               0U;
    if(down) {
        if(app->tag_data_scroll_line < max_top) app->tag_data_scroll_line++;
    } else if(app->tag_data_scroll_line > 0U) {
        app->tag_data_scroll_line--;
    }
}

static void uhf_edit_ascii_epc(UhfApp* app) {
    if(!app || !app->ascii_tag_captured) return;

    char pending[UHF_ASCII_EPC_BYTES + 1U];
    strncpy(pending, app->ascii_text, sizeof(pending) - 1U);
    pending[sizeof(pending) - 1U] = '\0';
    if(uhf_prompt_ascii(app, pending, sizeof(pending))) {
        strncpy(app->ascii_text, pending, sizeof(app->ascii_text) - 1U);
        app->ascii_text[sizeof(app->ascii_text) - 1U] = '\0';
        uhf_set_status(app, "ASCII edited; right writes");
    } else {
        uhf_set_status(app, "ASCII edit canceled");
    }
}

static void uhf_write_ascii_epc(UhfApp* app) {
    if(!app || !app->ascii_tag_captured || !app->ascii_source_epc[0]) {
        uhf_set_status(app, "Present one tag first");
        uhf_notify_write_result(app, false);
        return;
    }

    char epc_hex[UHF_ASCII_EPC_BYTES * 2U + 1U];
    if(!uhf_ascii_to_epc_hex(app->ascii_text, epc_hex, sizeof(epc_hex))) {
        uhf_set_status(app, "ASCII must be 1-12 chars");
        uhf_notify_write_result(app, false);
        return;
    }

    uhf_clear_selected_epc_filter(app);
    strncpy(app->selected_epc, app->ascii_source_epc, sizeof(app->selected_epc) - 1U);
    app->selected_epc[sizeof(app->selected_epc) - 1U] = '\0';
    strncpy(app->access_epc, app->ascii_source_epc, sizeof(app->access_epc) - 1U);
    app->access_epc[sizeof(app->access_epc) - 1U] = '\0';
    app->tag_access_unfiltered = false;

    if(uhf_write_selected_bank(app, UhfTagBankEpc, epc_hex)) {
        strncpy(app->ascii_source_epc, app->selected_epc, sizeof(app->ascii_source_epc) - 1U);
        app->ascii_source_epc[sizeof(app->ascii_source_epc) - 1U] = '\0';
        uhf_set_status(app, "ASCII write verified");
    }
}

static void uhf_edit_current_tag_bank(UhfApp* app) {
    bool valid = false;
    const char* value = uhf_current_tag_bank_value(app, &valid);
    strncpy(
        app->pending_tid,
        valid && value[0] ? value : "0000",
        sizeof(app->pending_tid) - 1U);
    app->pending_tid[sizeof(app->pending_tid) - 1U] = '\0';

    char header[32];
    snprintf(
        header,
        sizeof(header),
        "%s hex (16-bit words)",
        uhf_tag_bank_name(app->tag_bank));
    const size_t max_hex = app->tag_bank == UhfTagBankEpc ? UHF_EPC_HEX_MAX :
                           (app->tag_bank == UhfTagBankTid ? UHF_TID_HEX_MAX : UHF_USER_HEX_MAX);
    if(uhf_prompt_memory_hex(app, header, app->pending_tid, sizeof(app->pending_tid), max_hex)) {
        if(app->tag_bank == UhfTagBankEpc) {
            strncpy(app->selected_epc, app->pending_tid, sizeof(app->selected_epc) - 1U);
            app->selected_epc[sizeof(app->selected_epc) - 1U] = '\0';
        } else if(app->tag_bank == UhfTagBankTid) {
            strncpy(app->selected_tid, app->pending_tid, sizeof(app->selected_tid) - 1U);
            app->selected_tid[sizeof(app->selected_tid) - 1U] = '\0';
            app->selected_tid_valid = true;
        } else {
            strncpy(app->selected_user, app->pending_tid, sizeof(app->selected_user) - 1U);
            app->selected_user[sizeof(app->selected_user) - 1U] = '\0';
            app->selected_user_valid = true;
        }
        app->tag_data_scroll_line = 0U;
        uhf_set_status(app, "%s edited; not written", uhf_tag_bank_name(app->tag_bank));
    } else {
        uhf_set_status(app, "Edit canceled or invalid");
    }
}

static void uhf_write_current_tag_bank(UhfApp* app) {
    bool valid = false;
    const char* value = uhf_current_tag_bank_value(app, &valid);
    if(valid && value[0]) {
        (void)uhf_write_selected_bank(app, app->tag_bank, value);
    } else {
        uhf_set_status(app, "No data to write");
        uhf_notify_write_result(app, false);
    }
}

static void uhf_edit_active_key(UhfApp* app) {
    const uint8_t slot = app->key_vault_selected_slot;
    char key_hex[9];
    snprintf(key_hex, sizeof(key_hex), "%02X%02X%02X%02X",
             app->access_keys[slot][0],
             app->access_keys[slot][1],
             app->access_keys[slot][2],
             app->access_keys[slot][3]);
    if(!uhf_prompt_memory_hex(app, "Access key (8 hex)", key_hex, sizeof(key_hex), 8U) ||
       strlen(key_hex) != 8U) {
        uhf_set_status(app, "Key edit canceled");
        return;
    }
    size_t key_len = 0U;
    uint8_t key[4];
    if(!uhf_hex_to_bytes(key_hex, key, sizeof(key), &key_len) || key_len != 4U) {
        uhf_set_status(app, "Key must be 8 hex");
        return;
    }
    memcpy(app->access_keys[slot], key, sizeof(key));
    uhf_set_status(app, uhf_save_key_vault(app) ? "Key slot saved" : "Key save failed");
}

static UhfApp* uhf_app_alloc(void) {
    UhfApp* app = malloc(sizeof(UhfApp));
    if(!app) return NULL;

    memset(app, 0, sizeof(UhfApp));

    app->baud_probed = false;
    app->tx_ext_pin = -1;
    app->rx_ext_pin = -1;
    app->serial_id = FuriHalSerialIdUsart;
    app->baud_rate = UHF_BAUD_RATE;
    app->page = UhfPageMainMenu;
    app->about_return_page = app->page;
    uhf_load_settings(app);
    uhf_load_key_vault(app);
    uhf_set_status(app, "Init");

    app->data_mutex = furi_mutex_alloc(FuriMutexTypeRecursive);
    if(!app->data_mutex) {
        free(app);
        return NULL;
    }

    app->event_queue = furi_message_queue_alloc(16, sizeof(UhfEvent));
    app->rx_stream = furi_stream_buffer_alloc(UHF_RX_STREAM_SIZE, 1);
    if(!app->event_queue || !app->rx_stream) {
        uhf_app_free(app);
        return NULL;
    }

    app->gui = furi_record_open(RECORD_GUI);
    if(!app->gui) {
        uhf_app_free(app);
        return NULL;
    }

    app->notifications = furi_record_open(RECORD_NOTIFICATION);
    app->expansion = furi_record_open(RECORD_EXPANSION);

    app->view_port = view_port_alloc();
    if(!app->view_port) {
        uhf_app_free(app);
        return NULL;
    }

    view_port_draw_callback_set(app->view_port, uhf_draw_callback, app);
    view_port_input_callback_set(app->view_port, uhf_input_callback, app);
    gui_add_view_port(app->gui, app->view_port, GuiLayerFullscreen);

    uhf_set_status(app, "OK Scan RList DClear UReset");

    return app;
}

static void uhf_app_free(UhfApp* app) {
    if(!app) return;

    if(app->inventory_running && app->hardware_ready && app->serial) {
        uhf_stop_inventory(app);
        /* Flush any remaining RX data so the module's state is clean */
        if(app->rx_stream) {
            furi_stream_buffer_reset(app->rx_stream);
        }
        app->frame_buffer_len = 0;
        furi_delay_ms(20);
    }

    if(app->serial) {
        uhf_close_serial(app);
    }

    if(app->hardware_ready && app->otg_enabled_by_app && !app->otg_was_enabled) {
        if(app->power) {
            power_enable_otg(app->power, false);
        } else {
            furi_hal_power_disable_otg();
        }
    }

    if(app->hardware_ready) {
        furi_hal_gpio_init_simple(&gpio_ext_pa7, GpioModeAnalog);
    }

    if(app->gui && app->view_port) {
        gui_remove_view_port(app->gui, app->view_port);
    }
    if(app->view_port) {
        view_port_free(app->view_port);
    }
    if(app->gui) {
        furi_record_close(RECORD_GUI);
    }
    if(app->notifications) {
        furi_record_close(RECORD_NOTIFICATION);
    }
    if(app->power) {
        furi_record_close(RECORD_POWER);
    }
    if(app->expansion) {
        furi_record_close(RECORD_EXPANSION);
    }

    if(app->rx_stream) {
        furi_stream_buffer_free(app->rx_stream);
    }
    if(app->event_queue) {
        furi_message_queue_free(app->event_queue);
    }
    if(app->data_mutex) {
        furi_mutex_free(app->data_mutex);
    }
    free(app);
}

static void uhf_handle_input(UhfApp* app, const InputEvent* input) {
    const bool fire = (input->type == InputTypeShort) || (input->type == InputTypeLong);
    if(!fire) return;

    if(app->view_port) {
        view_port_update(app->view_port);
    }
    if(app->page == UhfPageMainMenu && input->key != InputKeyBack) {
        app->exit_confirm_active = false;
    }

    switch(input->key) {
    case InputKeyOk: {
        if(input->type == InputTypeLong) {
            if(app->page == UhfPageList || app->page == UhfPageRadar) {
                uhf_show_list_menu(app);
            } else if(app->page == UhfPageTagActions && app->security_mode) {
                app->tag_action_selected = 0U;
                app->tag_action_top = 0U;
                app->page = UhfPageTagActionMenu;
                uhf_set_status(app, "Tag operations");
            } else if(app->page == UhfPageAccessKeyMenu &&
                      app->access_key_action_selected == 1U) {
                app->page = UhfPageTagActions;
                (void)uhf_reset_tag_access_key(app);
            }
            break;
        }

        if(input->type != InputTypeShort) {
            uhf_set_status(app, "Use short OK");
            break;
        }
        if(app->page == UhfPageMainMenu) {
            uhf_enter_main_feature(app);
        } else if(app->page == UhfPageTidDecoder) {
            if(app->selected_tid_valid) {
                app->selected_tid_valid = false;
                app->tid_decode_attempted = false;
                app->tag_data_scroll_line = 0U;
                uhf_clear_tags(app);
                uhf_start_inventory(app);
                uhf_set_status(app, "Present exactly one tag");
            } else {
                app->tid_decode_attempted = false;
                if(!app->inventory_running) uhf_start_inventory(app);
                uhf_set_status(app, "Reading when one tag found");
            }
        } else if(app->page == UhfPageEpcFuzzing) {
            if(app->fuzz_base_epc[0]) {
                strncpy(app->pending_tid, app->selected_epc, sizeof(app->pending_tid) - 1U);
                app->pending_tid[sizeof(app->pending_tid) - 1U] = '\0';
                if(uhf_prompt_memory_hex(app, "EPC hex (16-bit words)", app->pending_tid,
                                         sizeof(app->pending_tid), UHF_EPC_HEX_MAX)) {
                    strcpy(app->selected_epc, app->pending_tid);
                    strcpy(app->fuzz_base_epc, app->pending_tid);
                    app->fuzz_sequence = 0U;
                    uhf_set_status(app, "EPC edited; not written");
                }
            } else {
                if(!app->inventory_running) uhf_start_inventory(app);
                uhf_set_status(app, "Reading source tag");
            }
        } else if(app->page == UhfPageAscii) {
            if(app->ascii_tag_captured) {
                uhf_edit_ascii_epc(app);
            } else {
                if(app->inventory_running) {
                    uhf_stop_inventory(app);
                    uhf_set_status(app, "Scan stopped");
                } else {
                    uhf_start_inventory(app);
                    uhf_set_status(app, "Present one tag");
                }
            }
        } else if(app->page == UhfPageKeyVault) {
            app->active_key_slot = app->key_vault_selected_slot;
            uhf_set_status(app, uhf_save_key_vault(app) ? "Active key: slot %u" : "Key save failed",
                           app->active_key_slot + 1U);
        } else if(app->page == UhfPageSettings) {
            const bool power_ok = uhf_set_reader_power(app, app->reader_power_dbm);
            const bool saved = uhf_save_settings(app);
            uhf_set_status(app, !saved ? "Save failed" :
                           (power_ok ? "Settings saved" : "Saved; power not applied"));
            app->save_popup_active = true;
            view_port_update(app->view_port);
            uhf_notify_write_result(app, saved && power_ok);
            furi_delay_ms(1200U);
            app->save_popup_active = false;
            if(saved) app->page = UhfPageMainMenu;
            view_port_update(app->view_port);
        } else if(app->page == UhfPageAbout) {
            uhf_exit_about_page(app);
        } else if(app->page == UhfPageList) {
            if(uhf_count_tags(app) == 0U || !app->list_selection_manual) {
                uhf_toggle_inventory_with_cooldown(app);
            } else {
                (void)uhf_enter_selected_tag(app);
            }
        } else if(app->page == UhfPageTagActions) {
            if(app->security_mode) {
                app->tag_action_selected = 0U;
                app->page = UhfPageTagActionMenu;
            } else {
                uhf_edit_current_tag_bank(app);
            }
        } else if(app->page == UhfPageTagActionMenu) {
            if(app->tag_action_selected == 0U) {
                app->access_key_action_selected = 0U;
                app->page = UhfPageAccessKeyMenu;
            } else if(app->tag_action_selected == 1U) {
                app->page = UhfPageTagActions;
                (void)uhf_lock_selected_bank(app, true);
            } else if(app->tag_action_selected == 2U) {
                app->page = UhfPageTagActions;
                (void)uhf_lock_selected_bank(app, false);
            }
        } else if(app->page == UhfPageAccessKeyMenu) {
            if(app->access_key_action_selected == 0U) {
                app->page = UhfPageTagActions;
                (void)uhf_initialize_tag_access_key(app);
            } else {
                uhf_set_status(app, "Hold OK to reset key");
            }
        } else {
            uhf_toggle_inventory_with_cooldown(app);
        }
        break;
    }
    case InputKeyLeft:
        if(app->page == UhfPageMainMenu) {
            app->main_menu_selected ^= 1U;
        } else if(app->page == UhfPageSettings && input->type == InputTypeShort) {
            if(app->settings_selected == 0U) {
                app->tag_beep_enabled = !app->tag_beep_enabled;
            } else if(app->settings_selected == 1U) {
                if(app->reader_power_dbm > 0U) app->reader_power_dbm--;
            } else if(app->settings_selected == 2U) {
                app->startup_app = app->startup_app == UhfStartupDefault ?
                                       (UhfStartupApp)(UhfStartupCount - 1U) :
                                       (UhfStartupApp)(app->startup_app - 1U);
            } else {
                app->epc_display = app->epc_display == UhfEpcDisplayHex ?
                                       UhfEpcDisplayAscii :
                                       UhfEpcDisplayHex;
            }
        } else if(app->page == UhfPageAscii && app->ascii_tag_captured) {
            uhf_clear_tags(app);
            app->ascii_tag_captured = false;
            app->ascii_single_since = 0U;
            app->ascii_source_epc[0] = '\0';
            app->ascii_text[0] = '\0';
            if(!app->inventory_running) uhf_start_inventory(app);
            uhf_set_status(app, "Present one tag");
        } else if(app->page == UhfPageEpcFuzzing && app->fuzz_base_epc[0]) {
            app->fuzz_sequence = 0U;
            app->selected_epc[0] = '\0';
            app->fuzz_base_epc[0] = '\0';
            app->access_epc[0] = '\0';
            uhf_clear_tags(app);
            uhf_set_status(app, "EPC cleared");
        } else if(app->page == UhfPageTagActions && input->type == InputTypeShort) {
            uhf_switch_tag_bank(app, false);
        } else if((app->page == UhfPageList || app->page == UhfPageRadar) &&
           input->type == InputTypeShort) {
            uhf_clear_tags(app);
        }
        break;
    case InputKeyUp:
        if(app->page == UhfPageMainMenu) {
            const uint8_t column = app->main_menu_selected & 1U;
            const uint8_t rows = (uint8_t)((COUNT_OF(uhf_main_menu_items) + 1U) / 2U);
            uint8_t row = app->main_menu_selected / 2U;
            row = row == 0U ? (uint8_t)(rows - 1U) : (uint8_t)(row - 1U);
            app->main_menu_selected = (uint8_t)(row * 2U + column);
            if(app->main_menu_selected >= COUNT_OF(uhf_main_menu_items)) {
                app->main_menu_selected = (uint8_t)(row * 2U);
            }
            if(row < app->main_menu_top_row) app->main_menu_top_row = row;
            if(row >= app->main_menu_top_row + 3U) app->main_menu_top_row = row - 2U;
        } else if(app->page == UhfPageSettings) {
            if(app->settings_selected > 0U) app->settings_selected--;
        } else if(app->page == UhfPageKeyVault) {
            if(app->key_vault_selected_slot > 0U) app->key_vault_selected_slot--;
        } else if(app->page == UhfPageTidDecoder) {
            if(app->selected_tid_valid && app->tag_data_scroll_line > 0U) {
                app->tag_data_scroll_line--;
            }
        } else if(app->page == UhfPageEpcFuzzing && app->fuzz_base_epc[0]) {
            app->fuzz_sequence++;
            uhf_make_fuzz_epc(app);
        } else if(app->page == UhfPageAbout) {
            if(input->type == InputTypeShort) {
                uhf_about_scroll(app, false);
            }
        } else if(app->page == UhfPageList) {
            if(input->type == InputTypeShort) {
                uhf_move_list_selection(app, false);
            }
        } else if(app->page == UhfPageTagActions) {
            uhf_scroll_tag_bank(app, false);
        } else if(app->page == UhfPageTagActionMenu) {
            if(app->tag_action_selected > 0U) app->tag_action_selected--;
            if(app->tag_action_selected < app->tag_action_top) {
                app->tag_action_top = app->tag_action_selected;
            }
        } else if(app->page == UhfPageAccessKeyMenu) {
            app->access_key_action_selected = 0U;
        } else {
            uhf_toggle_serial_port(app);
        }
        break;
    case InputKeyRight:
        if(app->page == UhfPageMainMenu) {
            app->main_menu_selected ^= 1U;
        } else if(app->page == UhfPageSettings && input->type == InputTypeShort) {
            if(app->settings_selected == 0U) {
                app->tag_beep_enabled = !app->tag_beep_enabled;
            } else if(app->settings_selected == 1U) {
                if(app->reader_power_dbm < 20U) app->reader_power_dbm++;
            } else if(app->settings_selected == 2U) {
                app->startup_app = (UhfStartupApp)(((uint8_t)app->startup_app + 1U) % UhfStartupCount);
            } else {
                app->epc_display = app->epc_display == UhfEpcDisplayHex ?
                                       UhfEpcDisplayAscii :
                                       UhfEpcDisplayHex;
            }
        } else if(app->page == UhfPageAscii && app->ascii_tag_captured &&
                  input->type == InputTypeShort) {
            uhf_write_ascii_epc(app);
        } else if(app->page == UhfPageKeyVault && input->type == InputTypeShort) {
            uhf_edit_active_key(app);
        } else if(app->page == UhfPageEpcFuzzing && app->fuzz_base_epc[0] && input->type == InputTypeShort) {
            app->tag_access_unfiltered = true;
            if(uhf_write_selected_bank(app, UhfTagBankEpc, app->selected_epc)) {
                app->fuzz_sequence++;
                uhf_make_fuzz_epc(app);
            }
        } else if(app->page == UhfPageTagActions) {
            if(input->type == InputTypeShort) {
                if(app->security_mode) {
                    (void)uhf_erase_selected_bank(app);
                } else {
                    uhf_write_current_tag_bank(app);
                }
            }
        } else if(app->page == UhfPageList || app->page == UhfPageRadar) {
            uhf_toggle_page(app);
        }
        break;
    case InputKeyDown:
        if(app->page == UhfPageMainMenu) {
            const uint8_t column = app->main_menu_selected & 1U;
            const uint8_t rows = (uint8_t)((COUNT_OF(uhf_main_menu_items) + 1U) / 2U);
            uint8_t row = app->main_menu_selected / 2U;
            row = (uint8_t)((row + 1U) % rows);
            app->main_menu_selected = (uint8_t)(row * 2U + column);
            if(app->main_menu_selected >= COUNT_OF(uhf_main_menu_items)) {
                app->main_menu_selected = (uint8_t)(row * 2U);
            }
            if(row < app->main_menu_top_row) app->main_menu_top_row = row;
            if(row >= app->main_menu_top_row + 3U) app->main_menu_top_row = row - 2U;
        } else if(app->page == UhfPageSettings) {
            if(app->settings_selected < 3U) app->settings_selected++;
        } else if(app->page == UhfPageKeyVault) {
            if(app->key_vault_selected_slot + 1U < UHF_KEY_SLOT_COUNT) {
                app->key_vault_selected_slot++;
            }
        } else if(app->page == UhfPageTidDecoder && app->selected_tid_valid) {
            const size_t tid_bytes = strlen(app->selected_tid) / 2U;
            const size_t pages = (tid_bytes + 15U) / 16U;
            if(app->tag_data_scroll_line + 1U < pages) app->tag_data_scroll_line++;
        } else if(app->page == UhfPageEpcFuzzing && app->fuzz_base_epc[0]) {
            if(app->fuzz_sequence > 0U) app->fuzz_sequence--;
            uhf_make_fuzz_epc(app);
        } else if(app->page == UhfPageAbout) {
            if(input->type == InputTypeShort) {
                uhf_about_scroll(app, true);
            }
        } else if(app->page == UhfPageList) {
            if(input->type == InputTypeShort) {
                uhf_move_list_selection(app, true);
            }
        } else if(app->page == UhfPageTagActions) {
            uhf_scroll_tag_bank(app, true);
        } else if(app->page == UhfPageTagActionMenu) {
            if(app->tag_action_selected < 2U) app->tag_action_selected++;
            if(app->tag_action_selected >= app->tag_action_top + 3U) {
                app->tag_action_top = app->tag_action_selected - 2U;
            }
        } else if(app->page == UhfPageAccessKeyMenu) {
            app->access_key_action_selected = 1U;
        }
        break;
    case InputKeyBack:
        if(app->page == UhfPageAbout) {
            uhf_exit_about_page(app);
        } else if(app->page == UhfPageAccessKeyMenu) {
            app->page = UhfPageTagActionMenu;
            uhf_set_status(app, "Tag operations");
        } else if(app->page == UhfPageTagActionMenu) {
            app->page = UhfPageTagActions;
            uhf_set_status(app, "%s", uhf_tag_bank_name(app->tag_bank));
        } else if(app->page == UhfPageTagActions) {
            uhf_leave_tag_actions(app);
        } else if(app->page != UhfPageMainMenu) {
            if(app->inventory_running) uhf_stop_inventory(app);
            uhf_clear_selected_epc_filter(app);
            app->page = UhfPageMainMenu;
            app->exit_confirm_active = false;
            uhf_set_status(app, "Select a feature");
        } else {
            const uint32_t now = furi_get_tick();
            if(app->exit_confirm_active &&
               (now - app->exit_confirm_tick) <= UHF_EXIT_CONFIRM_MS) {
                app->exit_requested = true;
            } else {
                app->exit_confirm_active = true;
                app->exit_confirm_tick = now;
                view_port_update(app->view_port);
            }
        }
        break;
    default:
        break;
    }
}

int32_t uhf_expansion_app(void* p) {
    UNUSED(p);

    UhfApp* app = uhf_app_alloc();
    if(!app) return -1;

    uhf_run_startup_sequence(app);

    if(uhf_has_version(app)) {
        (void)uhf_set_reader_power(app, app->reader_power_dbm);
        if(app->startup_app != UhfStartupDefault) {
            const uint8_t startup_feature = (uint8_t)app->startup_app - 1U;
            uhf_enter_feature(app, startup_feature);
        }
    }

    while(!app->exit_requested) {
        UhfEvent event;
        if(furi_message_queue_get(app->event_queue, &event, 20U) == FuriStatusOk) {
            uhf_handle_input(app, &event.input);
        }

        if(app->hardware_ready) {
            uhf_process_rx(app);
            uhf_service_inventory(app);
            uhf_service_feature_page(app);
        }

        uhf_update_inventory_rate(app);
        uhf_update_radar_animation(app);

        const uint32_t now = furi_get_tick();

        if(app->exit_confirm_active &&
           (now - app->exit_confirm_tick) > UHF_EXIT_CONFIRM_MS) {
            app->exit_confirm_active = false;
            view_port_update(app->view_port);
        }

        if(now - app->last_redraw_tick > 180U) {
            app->last_redraw_tick = now;
            view_port_update(app->view_port);
        }
    }

    uhf_save_last_page(app);
    uhf_app_free(app);
    return 0;
}
