#include <ble/core/auto/ble_types.h>

#define BLE_SVC_SEOS_READER_UUID      \
    {0x02, 0x00, 0x00, 0x7a, 0x17, 0x00, 0x00, 0x80, 0x00, 0x10, 0x00, 0x00, 0x00, 0x98, 0x00, 0x00 }

#define BLE_SVC_SEOS_READER_CHAR_UUID      \
    {0x02, 0x00, 0x00, 0x7a, 0x17, 0x00, 0x00, 0x80, 0x00, 0x10, 0x00, 0x00, 0x00, 0xaa, 0x00, 0x00}

static const Service_UUID_t reader_service_uuid = { .Service_UUID_128 = BLE_SVC_SEOS_READER_UUID };

#define BLE_SVC_SEOS_CRED_UUID      \
    {0x02, 0x00, 0x00, 0x7a, 0x17, 0x00, 0x00, 0x80, 0x00, 0x10, 0x00, 0x00, 0x01, 0x98, 0x00, 0x00 }

#define BLE_SVC_SEOS_CRED_CHAR_UUID      \
    {0x02, 0x00, 0x00, 0x7a, 0x17, 0x00, 0x00, 0x80, 0x00, 0x10, 0x00, 0x00, 0x01, 0xaa, 0x00, 0x00}

static const Service_UUID_t cred_service_uuid = { .Service_UUID_128 = BLE_SVC_SEOS_CRED_UUID };
