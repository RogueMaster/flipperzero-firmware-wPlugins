## applications/external/dfc_flipper/lib/tiny_crypto_c/examples/esp32-p4/sdkconfig.defaults
```kconfig
# SPDX-License-Identifier: GPL-2.0-or-later
CONFIG_COMPILER_OPTIMIZATION_PERF=y
CONFIG_ESP_MAIN_TASK_STACK_SIZE=8192
CONFIG_ESPTOOLPY_FLASHSIZE_2MB=y
```

## applications/external/tagtinker/esp32_wifi_fw/main/Kconfig.projbuild
```kconfig
menu "TagTinker"

config TT_CLOUD_URL
    string "Cloud worker base URL"
    default "https://tagtinker.jhackerr.workers.dev"
    help
        Base URL of the Cloudflare Worker that serves /plugins and /render
        for the WiFi Plugins feature.

        Point this at your own deployment (see cloud-plugins/) if you would
        rather not send plugin parameters to someone else's worker. Set it
        with `idf.py menuconfig` under TagTinker, or put
        CONFIG_TT_CLOUD_URL="https://your-worker.example.workers.dev" in
        sdkconfig.defaults, then rebuild and reflash the board.

        No trailing slash.

endmenu
```
