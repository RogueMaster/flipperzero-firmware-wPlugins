/* Generated by tools/gen_figure_table.py from RPCS3's infinity_dialog.cpp. */
    {0x0F4241, 1, "Mr. Incredible"},
    {0x0F4242, 1, "Sulley"},
    {0x0F4243, 1, "Jack Sparrow"},
    {0x0F4244, 1, "Lone Ranger"},
    {0x0F4245, 1, "Tonto"},
    {0x0F4246, 1, "Lightning McQueen"},
    {0x0F4247, 1, "Holley Shiftwell"},
    {0x0F4248, 1, "Buzz Lightyear"},
    {0x0F4249, 1, "Jessie"},
    {0x0F424A, 1, "Mike"},
    {0x0F424B, 1, "Mrs. Incredible"},
    {0x0F424C, 1, "Hector Barbossa"},
    {0x0F424D, 1, "Davy Jones"},
    {0x0F424E, 1, "Randy"},
    {0x0F424F, 1, "Syndrome"},
    {0x0F4250, 1, "Woody"},
    {0x0F4251, 1, "Mater"},
    {0x0F4252, 1, "Dash"},
    {0x0F4253, 1, "Violet"},
    {0x0F4254, 1, "Francesco Bernoulli"},
    {0x0F4255, 1, "Sorcerer's Apprentice Mickey"},
    {0x0F4256, 1, "Jack Skellington"},
    {0x0F4257, 1, "Rapunzel"},
    {0x0F4258, 1, "Anna"},
    {0x0F4259, 1, "Elsa"},
    {0x0F425A, 1, "Phineas"},
    {0x0F425B, 1, "Agent P"},
    {0x0F425C, 1, "Wreck-It Ralph"},
    {0x0F425D, 1, "Vanellope"},
    {0x0F425E, 1, "Mr. Incredible (Crystal)"},
    {0x0F425F, 1, "Jack Sparrow (Crystal)"},
    {0x0F4260, 1, "Sulley (Crystal)"},
    {0x0F4261, 1, "Lightning McQueen (Crystal)"},
    {0x0F4262, 1, "Lone Ranger (Crystal)"},
    {0x0F4263, 1, "Buzz Lightyear (Crystal)"},
    {0x0F4264, 1, "Agent P (Crystal)"},
    {0x0F4265, 1, "Sorcerer's Apprentice Mickey (Crystal)"},
    {0x0F4266, 1, "Buzz Lightyear (Glowing)"},
    {0x0F42A4, 2, "Captain America"},
    {0x0F42A5, 2, "Hulk"},
    {0x0F42A6, 2, "Iron Man"},
    {0x0F42A7, 2, "Thor"},
    {0x0F42A8, 2, "Groot"},
    {0x0F42A9, 2, "Rocket Raccoon"},
    {0x0F42AA, 2, "Star-Lord"},
    {0x0F42AB, 2, "Spider-Man"},
    {0x0F42AC, 2, "Nick Fury"},
    {0x0F42AD, 2, "Black Widow"},
    {0x0F42AE, 2, "Hawkeye"},
    {0x0F42AF, 2, "Drax"},
    {0x0F42B0, 2, "Gamora"},
    {0x0F42B1, 2, "Iron Fist"},
    {0x0F42B2, 2, "Nova"},
    {0x0F42B3, 2, "Venom"},
    {0x0F42B4, 2, "Donald Duck"},
    {0x0F42B5, 2, "Aladdin"},
    {0x0F42B6, 2, "Stitch"},
    {0x0F42B7, 2, "Merida"},
    {0x0F42B8, 2, "Tinker Bell"},
    {0x0F42B9, 2, "Maleficent"},
    {0x0F42BA, 2, "Hiro"},
    {0x0F42BB, 2, "Baymax"},
    {0x0F42BC, 2, "Loki"},
    {0x0F42BD, 2, "Ronan"},
    {0x0F42BE, 2, "Green Goblin"},
    {0x0F42BF, 2, "Falcon"},
    {0x0F42C0, 2, "Yondu"},
    {0x0F42C1, 2, "Jasmine"},
    {0x0F42C6, 2, "Black Suit Spider-Man"},
    {0x0F42D6, 3, "Sam Flynn"},
    {0x0F42D7, 3, "Quorra"},
    {0x0F4308, 3, "Anakin Skywalker"},
    {0x0F4309, 3, "Obi-Wan Kenobi"},
    {0x0F430A, 3, "Yoda"},
    {0x0F430B, 3, "Ahsoka Tano"},
    {0x0F430C, 3, "Darth Maul"},
    {0x0F430E, 3, "Luke Skywalker"},
    {0x0F430F, 3, "Han Solo"},
    {0x0F4310, 3, "Princess Leia"},
    {0x0F4311, 3, "Chewbacca"},
    {0x0F4312, 3, "Darth Vader"},
    {0x0F4313, 3, "Boba Fett"},
    {0x0F4314, 3, "Ezra Bridger"},
    {0x0F4315, 3, "Kanan Jarrus"},
    {0x0F4316, 3, "Sabine Wren"},
    {0x0F4317, 3, "Zeb Orrelios"},
    {0x0F4318, 3, "Joy"},
    {0x0F4319, 3, "Anger"},
    {0x0F431A, 3, "Fear"},
    {0x0F431B, 3, "Sadness"},
    {0x0F431C, 3, "Disgust"},
    {0x0F431D, 3, "Mickey Mouse"},
    {0x0F431E, 3, "Minnie Mouse"},
    {0x0F431F, 3, "Mulan"},
    {0x0F4320, 3, "Olaf"},
    {0x0F4321, 3, "Vision"},
    {0x0F4322, 3, "Ultron"},
    {0x0F4323, 3, "Ant-Man"},
    {0x0F4325, 3, "Captain America - The First Avenger"},
    {0x0F4326, 3, "Finn"},
    {0x0F4327, 3, "Kylo Ren"},
    {0x0F4328, 3, "Poe Dameron"},
    {0x0F4329, 3, "Rey"},
    {0x0F432B, 3, "Spot"},
    {0x0F432C, 3, "Nick Wilde"},
    {0x0F432D, 3, "Judy Hopps"},
    {0x0F432E, 3, "Hulkbuster"},
    {0x0F432F, 3, "Anakin Skywalker (Light FX)"},
    {0x0F4330, 3, "Obi-Wan Kenobi (Light FX)"},
    {0x0F4331, 3, "Yoda (Light FX)"},
    {0x0F4332, 3, "Luke Skywalker (Light FX)"},
    {0x0F4333, 3, "Darth Vader (Light FX)"},
    {0x0F4334, 3, "Kanan Jarrus (Light FX)"},
    {0x0F4335, 3, "Kylo Ren (Light FX)"},
    {0x0F4336, 3, "Black Panther"},
    {0x0F436C, 3, "Nemo"},
    {0x0F436D, 3, "Dory"},
    {0x0F436E, 3, "Baloo"},
    {0x0F436F, 3, "Alice"},
    {0x0F4370, 3, "Mad Hatter"},
    {0x0F4371, 3, "Time"},
    {0x0F4372, 3, "Peter Pan"},
    {0x1E8481, 1, "Starter Play Set"},
    {0x1E8482, 1, "Lone Ranger Play Set"},
    {0x1E8483, 1, "Cars Play Set"},
    {0x1E8484, 1, "Toy Story in Space Play Set"},
    {0x1E84E4, 2, "Marvel's The Avengers Play Set"},
    {0x1E84E5, 2, "Marvel's Spider-Man Play Set"},
    {0x1E84E6, 2, "Marvel's Guardians of the Galaxy Play Set"},
    {0x1E84E7, 2, "Assault on Asgard"},
    {0x1E84E8, 2, "Escape from the Kyln"},
    {0x1E84E9, 2, "Stitch's Tropical Rescue"},
    {0x1E84EA, 2, "Brave Forest Siege"},
    {0x1E8548, 3, "Inside Out Play Set"},
    {0x1E854A, 3, "Star Wars: Twilight of the Republic Play Set"},
    {0x1E854B, 3, "Star Wars: Rise Against the Empire Play Set"},
    {0x1E854C, 3, "Star Wars: The Force Awakens Play Set"},
    {0x1E854D, 3, "Marvel Battlegrounds Play Set"},
    {0x1E854E, 3, "Toy Box Speedway"},
    {0x1E854F, 3, "Toy Box Takeover"},
    {0x1E85AC, 3, "Finding Dory Play Set"},
    {0x2DC6C3, 1, "Bolt's Super Strength"},
    {0x2DC6C4, 1, "Ralph's Power of Destruction"},
    {0x2DC6C5, 1, "Chernabog's Power"},
    {0x2DC6C6, 1, "C.H.R.O.M.E. Damage Increaser"},
    {0x2DC6C7, 1, "Dr. Doofenshmirtz's Damage-Inator!"},
    {0x2DC6C8, 1, "Electro-Charge"},
    {0x2DC6C9, 1, "Fix-It Felix's Repair Power"},
    {0x2DC6CA, 1, "Rapunzel's Healing"},
    {0x2DC6CB, 1, "C.H.R.O.M.E. Armor Shield"},
    {0x2DC6CC, 1, "Star Command Shield"},
    {0x2DC6CD, 1, "Violet's Force Field"},
    {0x2DC6CE, 1, "Pieces of Eight"},
    {0x2DC6CF, 1, "Scrooge McDuck's Lucky Dime"},
    {0x2DC6D0, 1, "User Control"},
    {0x2DC6D1, 1, "Sorcerer Mickey's Hat"},
    {0x2DC6FE, 1, "Emperor Zurg's Wrath"},
    {0x2DC6FF, 1, "Merlin's Summon"},
    {0x2DC765, 2, "Enchanted Rose"},
    {0x2DC766, 2, "Mulan's Training Uniform"},
    {0x2DC767, 2, "Flubber"},
    {0x2DC768, 2, "S.H.I.E.L.D. Helicarrier Strike"},
    {0x2DC769, 2, "Zeus' Thunderbolts"},
    {0x2DC76A, 2, "King Louie's Monkeys"},
    {0x2DC76B, 2, "Infinity Gauntlet"},
    {0x2DC76D, 2, "Sorcerer Supreme"},
    {0x2DC76E, 2, "Maleficent's Spell Cast"},
    {0x2DC76F, 2, "Chernabog's Spirit Cyclone"},
    {0x2DC770, 2, "Marvel Team-Up: Capt. Marvel"},
    {0x2DC771, 2, "Marvel Team-Up: Iron Patriot"},
    {0x2DC772, 2, "Marvel Team-Up: Ant-Man"},
    {0x2DC773, 2, "Marvel Team-Up: White Tiger"},
    {0x2DC774, 2, "Marvel Team-Up: Yondu"},
    {0x2DC775, 2, "Marvel Team-Up: Winter Soldier"},
    {0x2DC776, 2, "Stark Arc Reactor"},
    {0x2DC777, 2, "Gamma Rays"},
    {0x2DC778, 2, "Alien Symbiote"},
    {0x2DC779, 2, "All for One"},
    {0x2DC77A, 2, "Sandy Claws Surprise"},
    {0x2DC77B, 2, "Glory Days"},
    {0x2DC77C, 2, "Cursed Pirate Gold"},
    {0x2DC77D, 2, "Sentinel of Liberty"},
    {0x2DC77E, 2, "The Immortal Iron Fist"},
    {0x2DC77F, 2, "Space Armor"},
    {0x2DC780, 2, "Rags to Riches"},
    {0x2DC781, 2, "Ultimate Falcon"},
    {0x2DC788, 3, "Tomorrowland Time Bomb"},
    {0x2DC78E, 3, "Galactic Team-Up: Mace Windu"},
    {0x2DC791, 3, "Luke's Rebel Alliance Flight Suit Costume"},
    {0x2DC798, 3, "Finn's Stormtrooper Costume"},
    {0x2DC799, 3, "Poe's Resistance Jacket"},
    {0x2DC79A, 3, "Resistance Tactical Strike"},
    {0x2DC79E, 3, "Officer Nick Wilde"},
    {0x2DC79F, 3, "Meter Maid Judy"},
    {0x2DC7A2, 3, "Darkhawk's Blast"},
    {0x2DC7A3, 3, "Cosmic Cube Blast"},
    {0x2DC7A4, 3, "Princess Leia's Boushh Disguise"},
    {0x2DC7A6, 3, "Nova Corps Strike"},
    {0x2DC7A7, 3, "King Mickey"},
    {0x3D0912, 1, "Mickey's Car"},
    {0x3D0913, 1, "Cinderella's Coach"},
    {0x3D0914, 1, "Electric Mayhem Bus"},
    {0x3D0915, 1, "Cruella De Vil's Car"},
    {0x3D0916, 1, "Pizza Planet Delivery Truck"},
    {0x3D0917, 1, "Mike's New Car"},
    {0x3D0919, 1, "Parking Lot Tram"},
    {0x3D091A, 1, "Captain Hook's Ship"},
    {0x3D091B, 1, "Dumbo"},
    {0x3D091C, 1, "Calico Helicopter"},
    {0x3D091D, 1, "Maximus"},
    {0x3D091E, 1, "Angus"},
    {0x3D091F, 1, "Abu the Elephant"},
    {0x3D0920, 1, "Headless Horseman's Horse"},
    {0x3D0921, 1, "Phillipe"},
    {0x3D0922, 1, "Khan"},
    {0x3D0923, 1, "Tantor"},
    {0x3D0924, 1, "Dragon Firework Cannon"},
    {0x3D0925, 1, "Stitch's Blaster"},
    {0x3D0926, 1, "Toy Story Mania Blaster"},
    {0x3D0927, 1, "Flamingo Croquet Mallet"},
    {0x3D0928, 1, "Carl Fredricksen's Cane"},
    {0x3D0929, 1, "Hangin' Ten Stitch With Surfboard"},
    {0x3D092A, 1, "Condorman Glider"},
    {0x3D092B, 1, "WALL-E's Fire Extinguisher"},
    {0x3D092C, 1, "On the Grid"},
    {0x3D092D, 1, "WALL-E's Collection"},
    {0x3D092E, 1, "King Candy's Dessert Toppings"},
    {0x3D0930, 1, "Victor's Experiments"},
    {0x3D0931, 1, "Jack's Scary Decorations"},
    {0x3D0933, 1, "Frozen Flourish"},
    {0x3D0934, 1, "Rapunzel's Kingdom"},
    {0x3D0935, 1, "TRON Interface"},
    {0x3D0936, 1, "Buy N Large Atmosphere"},
    {0x3D0937, 1, "Sugar Rush Sky"},
    {0x3D0939, 1, "New Holland Skyline"},
    {0x3D093A, 1, "Halloween Town Sky"},
    {0x3D093C, 1, "Chill in the Air"},
    {0x3D093D, 1, "Rapunzel's Birthday Sky"},
    {0x3D0940, 1, "Astro Blasters Space Cruiser"},
    {0x3D0941, 1, "Marlin's Reef"},
    {0x3D0942, 1, "Nemo's Seascape"},
    {0x3D0943, 1, "Alice's Wonderland"},
    {0x3D0944, 1, "Tulgey Wood"},
    {0x3D0945, 1, "Tri-State Area Terrain"},
    {0x3D0946, 1, "Danville Sky"},
    {0x3D0965, 2, "Stark Tech"},
    {0x3D0966, 2, "Spider-Streets"},
    {0x3D0967, 2, "World War Hulk"},
    {0x3D0968, 2, "Gravity Falls Forest"},
    {0x3D0969, 2, "Neverland"},
    {0x3D096A, 2, "Simba's Pridelands"},
    {0x3D096C, 2, "Calhoun's Command"},
    {0x3D096D, 2, "Star-Lord's Galaxy"},
    {0x3D096E, 2, "Dinosaur World"},
    {0x3D096F, 2, "Groot's Roots"},
    {0x3D0970, 2, "Mulan's Countryside"},
    {0x3D0971, 2, "The Sands of Agrabah"},
    {0x3D0974, 2, "A Small World"},
    {0x3D0975, 2, "View from the Suit"},
    {0x3D0976, 2, "Spider-Sky"},
    {0x3D0977, 2, "World War Hulk Sky"},
    {0x3D0978, 2, "Gravity Falls Sky"},
    {0x3D0979, 2, "Second Star to the Right"},
    {0x3D097A, 2, "The King's Domain"},
    {0x3D097C, 2, "CyBug Swarm"},
    {0x3D097D, 2, "The Rip"},
    {0x3D097E, 2, "Forgotten Skies"},
    {0x3D097F, 2, "Groot's View"},
    {0x3D0980, 2, "The Middle Kingdom"},
    {0x3D0984, 2, "Skies of the World"},
    {0x3D0985, 2, "S.H.I.E.L.D. Containment Truck"},
    {0x3D0986, 2, "Main Street Electrical Parade Float"},
    {0x3D0987, 2, "Mr. Toad's Motorcar"},
    {0x3D0988, 2, "Le Maximum"},
    {0x3D0989, 2, "Alice in Wonderland's Caterpillar"},
    {0x3D098A, 2, "Eglantine's Motorcycle"},
    {0x3D098B, 2, "Medusa's Swamp Mobile"},
    {0x3D098C, 2, "Hydra Motorcycle"},
    {0x3D098D, 2, "Darkwing Duck's Ratcatcher"},
    {0x3D098F, 2, "The USS Swinetrek"},
    {0x3D0991, 2, "Spider-Copter"},
    {0x3D0992, 2, "Aerial Area Rug"},
    {0x3D0993, 2, "Jack-O-Lantern's Glider"},
    {0x3D0994, 2, "Spider-Buggy"},
    {0x3D0995, 2, "Jack Skellington's Reindeer"},
    {0x3D0996, 2, "Fantasyland Carousel Horse"},
    {0x3D0997, 2, "Odin's Horse"},
    {0x3D0998, 2, "Gus the Mule"},
    {0x3D099A, 2, "Darkwing Duck's Grappling Gun"},
    {0x3D099C, 2, "Ghost Rider's Chain Whip"},
    {0x3D099D, 2, "Lew Zealand's Boomerang Fish"},
    {0x3D099E, 2, "Sergeant Calhoun's Blaster"},
    {0x3D09A0, 2, "Falcon's Wings"},
    {0x3D09A1, 2, "Mabel's Kittens for Fists"},
    {0x3D09A2, 2, "Jim Hawkins' Solar Board"},
    {0x3D09A3, 2, "Black Panther's Vibranium Knives"},
    {0x3D09A4, 2, "Cloak of Levitation"},
    {0x3D09A5, 2, "Aladdin's Magic Carpet"},
    {0x3D09A6, 2, "Honey Lemon's Ice Capsules"},
    {0x3D09A7, 2, "Jasmine's Palace View"},
    {0x3D09C1, 2, "Lola"},
    {0x3D09C2, 2, "Spider-Cycle"},
    {0x3D09C3, 2, "The Avenjet"},
    {0x3D09C4, 2, "Spider-Glider"},
    {0x3D09C5, 2, "Light Cycle"},
    {0x3D09C6, 2, "Light Jet"},
    {0x3D09C9, 3, "Retro Ray Gun"},
    {0x3D09CA, 3, "Tomorrowland Futurescape"},
    {0x3D09CB, 3, "Tomorrowland Stratosphere"},
    {0x3D09CC, 3, "Skies Over Felucia"},
    {0x3D09CD, 3, "Forests of Felucia"},
    {0x3D09CF, 3, "General Grievous' Wheel Bike"},
    {0x3D09D2, 3, "Slave I Flyer"},
    {0x3D09D3, 3, "Y-Wing Fighter"},
    {0x3D09D4, 3, "Arlo"},
    {0x3D09D5, 3, "Nash"},
    {0x3D09D6, 3, "Butch"},
    {0x3D09D7, 3, "Ramsey"},
    {0x3D09DC, 3, "Stars Over Sahara Square"},
    {0x3D09DD, 3, "Sahara Square Sands"},
    {0x3D09E0, 3, "Ghost Rider's Motorcycle"},
    {0x3D09E5, 3, "Quad Jumper"},
